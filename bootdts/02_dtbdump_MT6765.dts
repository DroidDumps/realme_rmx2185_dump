/dts-v1/;

/ {
	#address-cells = <0x02>;
	#size-cells = <0x02>;
	compatible = "mediatek,MT6765";
	interrupt-parent = <0x01>;
	model = "MT6765";

	__symbols__ {
		DPIDLE = "/cpus/idle-states/dpidle";
		MCDI_CLUSTER = "/cpus/idle-states/mcdi-cluster";
		MCDI_CPU = "/cpus/idle-states/mcdi-cpu";
		SODI = "/cpus/idle-states/sodi";
		SODI3 = "/cpus/idle-states/sodi3";
		STANDBY = "/cpus/idle-states/standby";
		SUSPEND = "/cpus/idle-states/suspend";
		accdet = "/accdet";
		apdma = "/dma-controller@11000580";
		apmixed = "/apmixed@1000c000";
		audgpio = "/mt_soc_dl1_pcm@11220000";
		audio = "/audio@11220000";
		auxadc = "/auxadc@11001000";
		bat_gm30 = "/battery";
		btcvsd_snd = "/mtk-btcvsd-snd@18050000";
		camsys = "/camsys@1a000000";
		charger = "/charger";
		chosen = "/chosen";
		clk26m = "/clocks/clk26m";
		clk32k = "/clocks/clk32k";
		consys = "/consys@18002000";
		cpu0 = "/cpus/cpu@000";
		cpu1 = "/cpus/cpu@001";
		cpu2 = "/cpus/cpu@002";
		cpu3 = "/cpus/cpu@003";
		cpu4 = "/cpus/cpu@100";
		cpu5 = "/cpus/cpu@101";
		cpu6 = "/cpus/cpu@102";
		cpu7 = "/cpus/cpu@103";
		cpu_dbgapb = "/cpu_dbgapb@0d410000";
		disp_color0 = "/disp_color0@1400f000";
		disp_mutex0 = "/disp_mutex0@14001000";
		dsi_te = "/dsi_te";
		dynamic_options = "/dynamic_options";
		egis_fp = "/egis_fp";
		flashlight_core = "/flashlight_core";
		flashlights_pascal = "/flashlights_pascal";
		fpsensor_finger = "/fpsensor_finger";
		gce = "/gce@10238000";
		gce_mbox = "/gce_mbox@10238000";
		gce_mbox_svp = "/gce_mbox_svp@10238000";
		gic = "/interrupt-controller@0c000000";
		gpio = "/gpio@10005000";
		gpio_usage_mapping = "/gpio";
		i2c0 = "/i2c0@11007000";
		i2c1 = "/i2c1@11008000";
		i2c2 = "/i2c2@11009000";
		i2c3 = "/i2c3@1100f000";
		i2c4 = "/i2c4@11011000";
		i2c5 = "/i2c5@11016000";
		i2c6 = "/i2c6@1100d000";
		i2c7 = "/i2c7";
		i2c8 = "/i2c8";
		i2c9 = "/i2c9";
		i2c_common = "/i2c_common";
		iddig_high = "/pinctrl@1000b000/iddig_high";
		iddig_low = "/pinctrl@1000b000/iddig_low";
		imgsys = "/imgsys@15020000";
		infracfg_ao = "/infracfg_ao@10001000";
		iommu = "/m4u@10205000";
		irq_nfc = "/irq_nfc";
		irtx_pwm = "/irtx_pwm";
		kd_camera_hw1 = "/kd_camera_hw1@1a040000";
		keypad = "/kp@10010000";
		lk_charger = "/lk_charger";
		main_pmic = "/mt-pmic";
		md1_sim1_hot_plug_eint = "/md1_sim1_hot_plug_eint";
		md1_sim2_hot_plug_eint = "/md1_sim2_hot_plug_eint";
		mdcldma = "/mdcldma@10014000";
		mdp_ccorr = "/mdp_ccorr0@14005000";
		mdp_rdma0 = "/mdp_rdma0@14004000";
		mdp_rsz0 = "/mdp_rsz0@14006000";
		mdp_rsz1 = "/mdp_rsz1@14007000";
		mdp_tdshp0 = "/mdp_tdshp0@1400a000";
		mdp_wdma0 = "/mdp_wdma0@14008000";
		mdp_wrot0 = "/mdp_wrot0@14009000";
		memory_ssmr_features = "/memory-ssmr-features";
		mfg_cfg = "/mfg_cfg@13ffe000";
		mipi_rx_ana_csi0a = "/mipi_rx_ana_csi0a@11c10000";
		mipi_rx_ana_csi0b = "/mipi_rx_ana_csi0b@11c11000";
		mipi_rx_ana_csi1a = "/mipi_rx_ana_csi1a@11c12000";
		mipi_rx_ana_csi1b = "/mipi_rx_ana_csi1b@11c13000";
		mipi_rx_ana_csi2a = "/mipi_rx_ana_csi2a@11c14000";
		mipi_rx_ana_csi2b = "/mipi_rx_ana_csi2b@11c15000";
		mmsys_config = "/mmsys_config@14000000";
		mrdump_ext_rst = "/mrdump_ext_rst";
		msdc0 = "/msdc@11230000";
		msdc0_pins_default = "/pinctrl@1000b000/msdc0@default";
		msdc0_pins_hs200 = "/pinctrl@1000b000/msdc0@hs200";
		msdc0_pins_hs400 = "/pinctrl@1000b000/msdc0@hs400";
		msdc0_register_setting_default = "/pinctrl@1000b000/msdc0@register_default";
		msdc1 = "/msdc@11240000";
		msdc1_ins = "/msdc1_ins@0";
		msdc1_pins_ddr50 = "/pinctrl@1000b000/msdc1@ddr50";
		msdc1_pins_default = "/pinctrl@1000b000/msdc1@default";
		msdc1_pins_sdr104 = "/pinctrl@1000b000/msdc1@sdr104";
		msdc1_pins_sdr50 = "/pinctrl@1000b000/msdc1@sdr50";
		msdc1_register_setting_default = "/pinctrl@1000b000/msdc1@register_default";
		msdc2 = "/msdc@11250000";
		msdc3 = "/msdc@11260000";
		msdc3_pins_default = "/pinctrl@1000b000/msdc3@default";
		msdc3_register_setting_default = "/pinctrl@1000b000/msdc3@register_default";
		mt6370_pmu = "/mt6370_pmu_dts";
		mt6370_typec = "/type_c_port0";
		mt_charger = "/mt_charger";
		mt_pmic_vaud28_ldo_reg = "/mt-pmic/ldo_regulators/ldo_vaud28";
		mt_pmic_vaux18_ldo_reg = "/mt-pmic/ldo_regulators/ldo_vaux18";
		mt_pmic_vcama_ldo_reg = "/mt-pmic/ldo_regulators/ldo_vcama";
		mt_pmic_vcamd_ldo_reg = "/mt-pmic/ldo_regulators/ldo_vcamd";
		mt_pmic_vcamio_ldo_reg = "/mt-pmic/ldo_regulators/ldo_vcamio";
		mt_pmic_vcn18_ldo_reg = "/mt-pmic/ldo_regulators/ldo_vcn18";
		mt_pmic_vcn28_ldo_reg = "/mt-pmic/ldo_regulators/ldo_vcn28";
		mt_pmic_vcn33_bt_ldo_reg = "/mt-pmic/ldo_regulators/ldo_vcn33_bt";
		mt_pmic_vcn33_wifi_ldo_reg = "/mt-pmic/ldo_regulators/ldo_vcn33_wifi";
		mt_pmic_vcore_buck_reg = "/mt-pmic/buck_regulators/buck_vcore";
		mt_pmic_vdram_ldo_reg = "/mt-pmic/ldo_regulators/ldo_vdram";
		mt_pmic_vefuse_ldo_reg = "/mt-pmic/ldo_regulators/ldo_vefuse";
		mt_pmic_vemc_ldo_reg = "/mt-pmic/ldo_regulators/ldo_vemc";
		mt_pmic_vfe28_ldo_reg = "/mt-pmic/ldo_regulators/ldo_vfe28";
		mt_pmic_vibr_ldo_reg = "/mt-pmic/ldo_regulators/ldo_vibr";
		mt_pmic_vio18_ldo_reg = "/mt-pmic/ldo_regulators/ldo_vio18";
		mt_pmic_vio28_ldo_reg = "/mt-pmic/ldo_regulators/ldo_vio28";
		mt_pmic_vldo28_ldo_reg = "/mt-pmic/ldo_regulators/ldo_vldo28";
		mt_pmic_vmc_ldo_reg = "/mt-pmic/ldo_regulators/ldo_vmc";
		mt_pmic_vmch_ldo_reg = "/mt-pmic/ldo_regulators/ldo_vmch";
		mt_pmic_vmodem_buck_reg = "/mt-pmic/buck_regulators/buck_vmodem";
		mt_pmic_vpa_buck_reg = "/mt-pmic/buck_regulators/buck_vpa";
		mt_pmic_vproc_buck_reg = "/mt-pmic/buck_regulators/buck_vproc";
		mt_pmic_vrf12_ldo_reg = "/mt-pmic/ldo_regulators/ldo_vrf12";
		mt_pmic_vrf18_ldo_reg = "/mt-pmic/ldo_regulators/ldo_vrf18";
		mt_pmic_vs1_buck_reg = "/mt-pmic/buck_regulators/buck_vs1";
		mt_pmic_vsim1_ldo_reg = "/mt-pmic/ldo_regulators/ldo_vsim1";
		mt_pmic_vsim2_ldo_reg = "/mt-pmic/ldo_regulators/ldo_vsim2";
		mt_pmic_vsram_others_ldo_reg = "/mt-pmic/ldo_regulators/ldo_vsram_others";
		mt_pmic_vsram_proc_ldo_reg = "/mt-pmic/ldo_regulators/ldo_vsram_proc";
		mt_pmic_vusb33_ldo_reg = "/mt-pmic/ldo_regulators/ldo_vusb33";
		mt_pmic_vxo22_ldo_reg = "/mt-pmic/ldo_regulators/ldo_vxo22";
		mtkfb = "/mtkfb@0";
		nfc553 = "/nfc553";
		nfc_clk_req = "/pinctrl@1000b000/nfc_clk_req";
		nfc_default = "/pinctrl@1000b000/nfc_default";
		nfc_dwn_high = "/pinctrl@1000b000/nfc_dwn_high";
		nfc_dwn_low = "/pinctrl@1000b000/nfc_dwn_low";
		nfc_eint_as_int = "/pinctrl@1000b000/nfc_eint_as_int";
		nfc_ven_high = "/pinctrl@1000b000/nfc_ven_high";
		nfc_ven_low = "/pinctrl@1000b000/nfc_ven_low";
		odm = "/odm";
		oppo_fp_common = "/oppo_fp_common";
		oppo_secure_common = "/oppo_secure_common";
		otg_iddig = "/otg_iddig";
		pd_adapter = "/pd_adapter";
		pericfg = "/pericfg@10003000";
		pio = "/pinctrl@1000b000";
		pmic_auxadc = "/mt-pmic/mt635x-auxadc";
		pmic_clock_buffer_ctrl = "/pmic_clock_buffer_ctrl";
		pwm = "/pwm@11006000";
		radio_md_cfg = "/radio_md_cfg";
		reserved_memory = "/reserved-memory";
		rt9465_slave_chr = "/rt9465_slave_chr";
		scpsys = "/scpsys@10001000";
		sia81xx_L = "/sia81xx@L";
		sia81xx_gpio_L = "/pinctrl@1000b000/sia81xx_gpio_L";
		sia81xx_i2c_L = "/i2c5@11016000/sia81xx_i2c@L";
		sleep = "/sleep@10006000";
		smart_pa = "/smart_pa";
		smi_larb0 = "/smi_larb0@14003000";
		smi_larb1 = "/smi_larb1@17010000";
		smi_larb2 = "/smi_larb2@15021000";
		smi_larb3 = "/smi_larb3@1a002000";
		spi0 = "/spi@1100a000";
		spi1 = "/spi@11010000";
		spi2 = "/spi@11012000";
		spi3 = "/spi@11013000";
		spi4 = "/spi@11014000";
		spi5 = "/spi@11015000";
		subpmic_pmu_eint = "/mt6370_pmu_eint";
		syscfg_pctl_0 = "/syscfg_pctl_0@10005000";
		syscfg_pctl_1 = "/syscfg_pctl_1@0x10002000";
		syscfg_pctl_2 = "/syscfg_pctl_2@0x10002200";
		syscfg_pctl_3 = "/syscfg_pctl_3@0x10002400";
		syscfg_pctl_4 = "/syscfg_pctl_4@0x10002600";
		syscfg_pctl_5 = "/syscfg_pctl_5@0x10002800";
		syscfg_pctl_6 = "/syscfg_pctl_6@0x10002a00";
		syscfg_pctl_7 = "/syscfg_pctl_7@0x10002c00";
		sysirq = "/intpol-controller@10200a80";
		tcpc_pd = "/mt6370_pd_eint";
		topckgen = "/topckgen@10000000";
		touch = "/touch";
		uart0 = "/serial@11020000";
		uart1 = "/serial@11030000";
		venc_gcon = "/venc_gcon@17000000";
	};

	accdet {
		compatible = "mediatek,pmic-accdet";
		linux,phandle = <0x82>;
		phandle = <0x82>;
	};

	aes_top0@10016000 {
		compatible = "mediatek,aes_top0";
		reg = <0x00 0x10016000 0x00 0x1000>;
	};

	amms_control {
		compatible = "mediatek,amms";
		interrupts = <0x00 0x86 0x01>;
	};

	ap_ccif0@10209000 {
		compatible = "mediatek,ap_ccif0";
		interrupts = <0x00 0x94 0x08>;
		reg = <0x00 0x10209000 0x00 0x1000>;
	};

	ap_ccif1@1020b000 {
		compatible = "mediatek,ap_ccif1";
		interrupts = <0x00 0x96 0x08>;
		reg = <0x00 0x1020b000 0x00 0x1000>;
	};

	ap_ccif2@1023c000 {
		compatible = "mediatek,ap_ccif2";
		interrupts = <0x00 0x8f 0x08>;
		reg = <0x00 0x1023c000 0x00 0x1000>;
	};

	ap_ccif3@1023e000 {
		compatible = "mediatek,ap_ccif3";
		interrupts = <0x00 0x92 0x08>;
		reg = <0x00 0x1023e000 0x00 0x1000>;
	};

	ap_dma@11000000 {
		compatible = "mediatek,ap_dma";
		interrupts = <0x00 0x61 0x08>;
		reg = <0x00 0x11000000 0x00 0x1000>;
	};

	apcldmain@1021b000 {
		compatible = "mediatek,apcldmain";
		reg = <0x00 0x1021b000 0x00 0x00>;
	};

	apcldmain_ao@10014000 {
		compatible = "mediatek,apcldmain_ao";
		reg = <0x00 0x10014000 0x00 0x400>;
	};

	apcldmamisc@1021b800 {
		compatible = "mediatek,apcldmamisc";
		interrupts = <0x00 0xa5 0x04>;
		reg = <0x00 0x1021b800 0x00 0x00>;
	};

	apcldmamisc_ao@10014800 {
		compatible = "mediatek,apcldmamisc_ao";
		reg = <0x00 0x10014800 0x00 0x400>;
	};

	apcldmaout@1021b400 {
		compatible = "mediatek,apcldmaout";
		reg = <0x00 0x1021b400 0x00 0x00>;
	};

	apcldmaout_ao@10014400 {
		compatible = "mediatek,apcldmaout_ao";
		reg = <0x00 0x10014400 0x00 0x400>;
	};

	apmixed@1000c000 {
		#clock-cells = <0x01>;
		compatible = "mediatek,apmixed\0syscon";
		linux,phandle = <0x43>;
		phandle = <0x43>;
		reg = <0x00 0x1000c000 0x00 0x1000>;
	};

	apxgpt@10008000 {
		clocks = <0x1d>;
		compatible = "mediatek,apxgpt";
		interrupts = <0x00 0xaa 0x08>;
		reg = <0x00 0x10008000 0x00 0x1000>;
	};

	atf_logger {
		compatible = "mediatek,atf_logger";
		interrupts = <0x00 0xf7 0x01>;
	};

	audio@11220000 {
		#clock-cells = <0x01>;
		compatible = "mediatek,audio\0syscon";
		linux,phandle = <0x42>;
		mediatek,btcvsd_snd = <0x41>;
		phandle = <0x42>;
		reg = <0x00 0x11220000 0x00 0x1000>;
		si,sia81xx-aux-devs = <0x34>;
		si,sia81xx-aux-devs-prefix = "SpkrLeft";
		si,sia81xx-max-num = <0x01>;
	};

	audio_snd_card {
		compatible = "mediatek,audio_snd_card";
	};

	audio_sram@11221000 {
		compatible = "mediatek,audio_sram";
		reg = <0x00 0x11221000 0x00 0x9000>;
	};

	auxadc@11001000 {
		clock-names = "auxadc-main";
		clocks = <0x26 0x21>;
		compatible = "mediatek,auxadc";
		interrupts = <0x00 0x4c 0x02>;
		linux,phandle = <0x8a>;
		phandle = <0x8a>;
		reg = <0x00 0x11001000 0x00 0x10000>;
	};

	battery {
		CAR_TUNE_VALUE = <0x64>;
		DIFFERENCE_FULLOCV_ITH = <0xc8>;
		EMBEDDED_SEL = <0x01>;
		FG_METER_RESISTANCE = <0x4b>;
		KEEP_100_PERCENT = <0x01>;
		PMIC_MIN_VOL = <0x82dc>;
		PMIC_SHUTDOWN_CURRENT = <0x14>;
		POWERON_SYSTEM_IBOOT = <0x1f4>;
		Q_MAX_SYS_VOLTAGE_BAT0 = <0xd16>;
		Q_MAX_SYS_VOLTAGE_BAT1 = <0xd16>;
		Q_MAX_SYS_VOLTAGE_BAT2 = <0xd16>;
		Q_MAX_SYS_VOLTAGE_BAT3 = <0xd16>;
		R_FG_VALUE = <0x0a>;
		SHUTDOWN_1_TIME = <0x1e>;
		SHUTDOWN_GAUGE0_VOLTAGE = <0x84d0>;
		TEMPERATURE_T0 = <0x32>;
		TEMPERATURE_T1 = <0x19>;
		TEMPERATURE_T2 = <0x0a>;
		TEMPERATURE_T3 = <0x00>;
		TEMPERATURE_T4 = <0xfffffff6>;
		battery0_profile_t0 = <0x00 0xaba4 0x384 0x203 0xab23 0x384 0x407 0xaaa9 0x384 0x60a 0xaa37 0x392 0x80e 0xa9c7 0x3a8 0xa11 0xa955 0x3af 0xc15 0xa8de 0x3a1 0xe18 0xa86e 0x3b6 0x101c 0xa7f6 0x3b6 0x121f 0xa77e 0x3a4 0x1423 0xa705 0x39d 0x1626 0xa68d 0x3a8 0x1829 0xa615 0x3b6 0x1a2d 0xa59c 0x3c9 0x1c30 0xa521 0x429 0x1e34 0xa4a8 0x3d3 0x2037 0xa430 0x3c6 0x223b 0xa3b8 0x3cf 0x243e 0xa33f 0x3c6 0x2642 0xa2c7 0x3b6 0x2845 0xa250 0x3b8 0x2a49 0xa1e0 0x3cd 0x2c4c 0xa168 0x3bb 0x2e4f 0xa0f6 0x3c6 0x3053 0xa087 0x3cf 0x3256 0xa017 0x3cf 0x345a 0x9faa 0x3d4 0x365d 0x9f43 0x3e8 0x3861 0x9edb 0x3e8 0x3a64 0x9e74 0x3e8 0x3c68 0x9e0d 0x3e8 0x3e6b 0x9dab 0x3f5 0x406f 0x9d49 0x401 0x4272 0x9ce7 0x407 0x4475 0x9c90 0x41a 0x4679 0x9c30 0x41a 0x487c 0x9bd9 0x42f 0x4a80 0x9b83 0x455 0x4c83 0x9b28 0x465 0x4e87 0x9aca 0x46f 0x508a 0x9a66 0x477 0x528e 0x99f1 0x459 0x5491 0x995f 0x403 0x5695 0x98d5 0x3c2 0x5898 0x986f 0x3b6 0x5a9b 0x981c 0x3b6 0x5c9f 0x97ce 0x3ac 0x5ea2 0x9787 0x3a4 0x60a6 0x974a 0x3b6 0x62a9 0x970e 0x3b6 0x64ad 0x96d2 0x3b6 0x66b0 0x9696 0x3a4 0x68b4 0x9660 0x39d 0x6ab7 0x962c 0x3a8 0x6cbb 0x95fb 0x3b6 0x6ebe 0x95cf 0x3b6 0x70c1 0x959c 0x3b6 0x72c5 0x9571 0x3b6 0x74c8 0x954d 0x3c8 0x76cc 0x9525 0x3cf 0x78cf 0x94fe 0x3da 0x7ad3 0x94dc 0x3e8 0x7cd6 0x94b8 0x3e4 0x7eda 0x948d 0x3d0 0x80dd 0x9474 0x3fb 0x82e1 0x9452 0x401 0x84e4 0x9430 0x401 0x86e7 0x940e 0x40c 0x88eb 0x93e5 0x412 0x8aee 0x93aa 0x3f3 0x8cf2 0x9354 0x3b6 0x8ef5 0x930f 0x3b6 0x90f9 0x92da 0x3b6 0x92fc 0x92ac 0x3c6 0x9500 0x927d 0x3c3 0x9703 0x924d 0x3bf 0x9907 0x9222 0x3cf 0x9b0a 0x91f7 0x3cf 0x9d0d 0x91d5 0x3cf 0x9f11 0x91ab 0x3e3 0xa114 0x9179 0x3e8 0xa318 0x913c 0x3db 0xa51b 0x90fb 0x3cf 0xa71f 0x90bf 0x3d5 0xa922 0x9080 0x3e4 0xab26 0x902a 0x3b9 0xad29 0x8fec 0x3a2 0xaf2d 0x8fd7 0x3ad 0xb130 0x8fcf 0x3d0 0xb333 0x8fc2 0x3f1 0xb537 0x8faf 0x413 0xb73a 0x8f91 0x451 0xb93e 0x8f55 0x47c 0xbb41 0x8e3e 0x418 0xbd45 0x8c86 0x423 0xbf48 0x8a30 0x44e 0xc14c 0x86fa 0x4a9 0xc34f 0x81b1 0x909 0xc553 0x785a 0x1991 0xc756 0x74ae 0x12d9>;
		battery0_profile_t0_col = <0x03>;
		battery0_profile_t0_num = <0x64>;
		battery0_profile_t1 = <0x00 0xabea 0x4ce 0x203 0xab72 0x4ca 0x407 0xab08 0x4db 0x60a 0xaa9b 0x4e2 0x80e 0xaa2b 0x4d7 0xa11 0xa9bc 0x4c9 0xc15 0xa94c 0x4cd 0xe18 0xa8dc 0x4e2 0x101c 0xa86d 0x4f8 0x121f 0xa7f6 0x4e9 0x1423 0xa77d 0x4e2 0x1626 0xa701 0x4d7 0x1829 0xa683 0x4c9 0x1a2d 0xa60a 0x4e0 0x1c30 0xa58f 0x553 0x1e34 0xa516 0x4ff 0x2037 0xa49e 0x4e2 0x223b 0xa426 0x4e2 0x243e 0xa3ad 0x4e2 0x2642 0xa335 0x4e2 0x2845 0xa2be 0x4e4 0x2a49 0xa24e 0x4f9 0x2c4c 0xa1d6 0x4fb 0x2e4f 0xa164 0x4fb 0x3053 0xa0f5 0x508 0x3256 0xa085 0x514 0x345a 0xa015 0x514 0x365d 0x9fa7 0x516 0x3861 0x9f3f 0x52b 0x3a64 0x9ed8 0x52d 0x3c68 0x9e71 0x53d 0x3e6b 0x9e0a 0x553 0x406f 0x9da7 0x568 0x4272 0x9d48 0x57e 0x4475 0x9cea 0x593 0x4679 0x9c8a 0x5a9 0x487c 0x9c2b 0x5bf 0x4a80 0x9bcd 0x5d4 0x4c83 0x9b6e 0x5ea 0x4e87 0x9b0b 0x5eb 0x508a 0x9aa2 0x5d5 0x528e 0x9a31 0x5ba 0x5491 0x99b9 0x579 0x5695 0x992f 0x524 0x5898 0x98bb 0x4f1 0x5a9b 0x9857 0x4d4 0x5c9f 0x9800 0x4bf 0x5ea2 0x97b3 0x4a9 0x60a6 0x9768 0x497 0x62a9 0x972c 0x497 0x64ad 0x96f0 0x497 0x66b0 0x96b4 0x497 0x68b4 0x967e 0x497 0x6ab7 0x964a 0x497 0x6cbb 0x9619 0x49e 0x6ebe 0x95ed 0x4ac 0x70c1 0x95ba 0x497 0x72c5 0x9597 0x4c2 0x74c8 0x956e 0x4c9 0x76cc 0x9543 0x4c9 0x78cf 0x951c 0x4c9 0x7ad3 0x94fa 0x4d1 0x7cd6 0x94d7 0x4e2 0x7eda 0x94b5 0x4e2 0x80dd 0x9493 0x4e2 0x82e1 0x9470 0x4e2 0x84e4 0x9454 0x4f1 0x86e7 0x9436 0x4fb 0x88eb 0x9413 0x4f3 0x8aee 0x93f3 0x4e7 0x8cf2 0x93d7 0x4fa 0x8ef5 0x93ac 0x4e4 0x90f9 0x9381 0x4cf 0x92fc 0x9356 0x4b9 0x9500 0x932c 0x4b0 0x9703 0x92fd 0x4a7 0x9907 0x92ce 0x49c 0x9b0a 0x92ab 0x4ae 0x9d0d 0x9280 0x499 0x9f11 0x9264 0x4be 0xa114 0x9237 0x4a9 0xa318 0x9204 0x4a4 0xa51b 0x91c9 0x4b0 0xa71f 0x9187 0x4b0 0xa922 0x914a 0x4b0 0xab26 0x910e 0x4b0 0xad29 0x90ba 0x4b0 0xaf2d 0x907f 0x4b0 0xb130 0x9060 0x4b0 0xb333 0x904e 0x4b9 0xb537 0x9040 0x4d5 0xb73a 0x9035 0x500 0xb93e 0x901b 0x52b 0xbb41 0x8fd9 0x56a 0xbd45 0x8ee6 0x556 0xbf48 0x8d38 0x561 0xc14c 0x8ad7 0x59f 0xc34f 0x8787 0x627 0xc553 0x8237 0xa55 0xc756 0x779c 0x19af>;
		battery0_profile_t1_col = <0x03>;
		battery0_profile_t1_num = <0x64>;
		battery0_profile_t2 = <0x00 0xac12 0x820 0x83e 0x203 0xab91 0x81c 0x839 0x407 0xab1f 0x81b 0x839 0x60a 0xaab5 0x838 0x849 0x80e 0xaa49 0x84d 0x844 0xa11 0xa9dd 0x84d 0x751 0xc15 0xa974 0x84d 0x741 0xe18 0xa904 0x84d 0x714 0x101c 0xa88c 0x837 0x760 0x121f 0xa814 0x834 0x742 0x1423 0xa79b 0x834 0x704 0x1626 0xa723 0x834 0x69f 0x1829 0xa6ab 0x82c 0x66d 0x1a2d 0xa632 0x844 0x676 0x1c30 0xa5b7 0x918 0x643 0x1e34 0xa53e 0x86e 0x646 0x2037 0xa4c6 0x834 0x6ac 0x223b 0xa449 0x834 0x62a 0x243e 0xa3cf 0x834 0x637 0x2642 0xa35d 0x834 0x62b 0x2845 0xa2e5 0x834 0x62c 0x2a49 0xa26d 0x834 0x612 0x2c4c 0xa1f4 0x834 0x630 0x2e4f 0xa182 0x844 0x68e 0x3053 0xa113 0x85a 0x62d 0x3256 0xa0a3 0x866 0x67f 0x345a 0xa033 0x86b 0x67c 0x365d 0x9fc4 0x87f 0x645 0x3861 0x9f54 0x87f 0x694 0x3a64 0x9ef4 0x893 0x665 0x3c68 0x9e8f 0x8b9 0x6bb 0x3e6b 0x9e28 0x8ca 0x6ca 0x406f 0x9dbd 0x8dd 0x6d1 0x4272 0x9d4e 0x902 0x6ba 0x4475 0x9ce7 0x915 0x670 0x4679 0x9c80 0x915 0x705 0x487c 0x9c21 0x915 0x6c0 0x4a80 0x9bc9 0x915 0x6ec 0x4c83 0x9b69 0x915 0x6ef 0x4e87 0x9afd 0x901 0x714 0x508a 0x9a8b 0x8d6 0x6df 0x528e 0x9a12 0x8a5 0x7c0 0x5491 0x9991 0x84f 0x751 0x5695 0x9918 0x80e 0x7c0 0x5898 0x98a7 0x7ce 0x806 0x5a9b 0x9843 0x7a9 0x7e5 0x5c9f 0x97ec 0x789 0x8ad 0x5ea2 0x979f 0x76c 0x8ad 0x60a6 0x9754 0x76f 0x86b 0x62a9 0x9718 0x785 0x8df 0x64ad 0x96d4 0x770 0x92f 0x66b0 0x969d 0x77e 0x84d 0x68b4 0x9664 0x777 0x8a5 0x6ab7 0x962c 0x777 0x8ad 0x6cbb 0x95f9 0x785 0x8ed 0x6ebe 0x95c7 0x789 0x8b6 0x70c1 0x959c 0x79e 0x930 0x72c5 0x9571 0x79e 0x8f2 0x74c8 0x9546 0x7b0 0x856 0x76cc 0x951b 0x7b7 0x860 0x78cf 0x94f0 0x7b7 0x8df 0x7ad3 0x94c8 0x7bf 0x857 0x7cd6 0x94a5 0x7d4 0x97e 0x7eda 0x9483 0x7ea 0x97f 0x80dd 0x946a 0x7ff 0x9a7 0x82e1 0x9448 0x7ef 0x95e 0x84e4 0x9426 0x7f8 0x946 0x86e7 0x9408 0x80e 0x997 0x88eb 0x93ee 0x81b 0x957 0x8aee 0x93d4 0x81b 0x9cf 0x8cf2 0x93ba 0x81c 0x940 0x8ef5 0x93a1 0x832 0x9c0 0x90f9 0x9387 0x821 0x951 0x92fc 0x936d 0x81b 0x9d6 0x9500 0x934e 0x81b 0x942 0x9703 0x932c 0x824 0x942 0x9907 0x9308 0x839 0x9e2 0x9b0a 0x92dd 0x84d 0x9d1 0x9d0d 0x92b2 0x84d 0x970 0x9f11 0x928f 0x888 0x8f5 0xa114 0x9266 0x8b8 0x90c 0xa318 0x9231 0x8e3 0x906 0xa51b 0x91f1 0x917 0x8d6 0xa71f 0x91ac 0x952 0x8cf 0xa922 0x9168 0x981 0x8a4 0xab26 0x912c 0x9d7 0x881 0xad29 0x90d0 0xa19 0x87c 0xaf2d 0x9085 0xa8b 0x81a 0xb130 0x9055 0xb0c 0x838 0xb333 0x9037 0xb9f 0x859 0xb537 0x901b 0xc51 0x872 0xb73a 0x8ff8 0xd27 0x8bd 0xb93e 0x8fd6 0xeaa 0x866 0xbb41 0x8f93 0x107e 0x758 0xbd45 0x8edc 0x12cc 0x7a7 0xbf48 0x8d56 0x15a5 0x70f 0xc14c 0x8b03 0x1a62 0x5af 0xc34f 0x87c7 0x24ce 0x48e 0xc553 0x8326 0x3490 0x436 0xc756 0x7c92 0x262f 0x436>;
		battery0_profile_t2_col = <0x04>;
		battery0_profile_t2_num = <0x64>;
		battery0_profile_t3 = <0x00 0xac26 0xea6 0x4d8 0x203 0xab94 0xea6 0x4d3 0x407 0xab10 0xeee 0x92e 0x60a 0xaa9b 0xf18 0xaae 0x80e 0xaa2b 0xf23 0xa70 0xa11 0xa9b9 0xf1c 0xa43 0xc15 0xa942 0xf0e 0xa00 0xe18 0xa8d2 0xf22 0x9ce 0x101c 0xa85a 0xef7 0x9a3 0x121f 0xa7e2 0xedf 0x9c6 0x1423 0xa769 0xeba 0x98d 0x1626 0xa6f1 0xea6 0x941 0x1829 0xa679 0xea6 0x93a 0x1a2d 0xa600 0xee6 0x914 0x1c30 0xa585 0x102d 0x90c 0x1e34 0xa50c 0xf08 0x8d3 0x2037 0xa48e 0xe77 0x8bb 0x223b 0xa417 0xe67 0x8c5 0x243e 0xa3a3 0xe74 0x8b2 0x2642 0xa32b 0xe6a 0x8a2 0x2845 0xa2b4 0xe45 0x8af 0x2a49 0xa244 0xe70 0x8a9 0x2c4c 0xa1cc 0xe60 0x89c 0x2e4f 0xa15a 0xe5b 0x89b 0x3053 0xa0eb 0xe68 0x8a0 0x3256 0xa07b 0xe6b 0x898 0x345a 0xa00b 0xe60 0x89a 0x365d 0x9f9d 0xe78 0x8b7 0x3861 0x9f3f 0xea3 0x8ca 0x3a64 0x9ed0 0xeba 0x8c8 0x3c68 0x9e61 0xeaf 0x8ce 0x3e6b 0x9df1 0xeb3 0x8f7 0x406f 0x9d7e 0xebf 0x90a 0x4272 0x9d08 0xebf 0x939 0x4475 0x9c98 0xeb6 0x962 0x4679 0x9c26 0xe5e 0x985 0x487c 0x9bbf 0xe5b 0x9ab 0x4a80 0x9b5f 0xe39 0x9c6 0x4c83 0x9af5 0xe37 0x9ef 0x4e87 0x9a85 0xe0f 0xa08 0x508a 0x9a13 0xdc5 0xa30 0x528e 0x999b 0xdb6 0xa85 0x5491 0x9923 0xd4a 0xab9 0x5695 0x98bb 0xd33 0xb1d 0x5898 0x985b 0xd1e 0xb61 0x5a9b 0x9802 0xcfa 0xb97 0x5c9f 0x97b0 0xcee 0xbac 0x5ea2 0x9763 0xcfd 0xc03 0x60a6 0x9717 0xd00 0xbf9 0x62a9 0x96d2 0xd16 0xc1a 0x64ad 0x9696 0xd01 0xc39 0x66b0 0x965a 0xd21 0xc58 0x68b4 0x9624 0xd2f 0xc59 0x6ab7 0x95f0 0xd45 0xc84 0x6cbb 0x95ba 0xd5a 0xc8a 0x6ebe 0x9581 0xd50 0xc7e 0x70c1 0x9556 0xd7a 0xca9 0x72c5 0x952b 0xda5 0xcc9 0x74c8 0x9500 0xdac 0xcd0 0x76cc 0x94d5 0xdac 0xce4 0x78cf 0x94ae 0xdb7 0xcfb 0x7ad3 0x948c 0xde3 0xd0e 0x7cd6 0x9469 0xe29 0xd48 0x7eda 0x9447 0xe2a 0xd2a 0x80dd 0x9425 0xe55 0xd6e 0x82e1 0x940a 0xe6e 0xd61 0x84e4 0x93f6 0xe74 0xd67 0x86e7 0x93e5 0xe96 0xd91 0x88eb 0x93d4 0xed7 0xd82 0x8aee 0x93c2 0xf13 0xd98 0x8cf2 0x93b1 0xf41 0xd76 0x8ef5 0x93a0 0xf97 0xd8a 0x90f9 0x9387 0x1000 0xd67 0x92fc 0x936d 0x104c 0xd5d 0x9500 0x9353 0x10ca 0xd67 0x9703 0x9333 0x115c 0xd38 0x9907 0x930a 0x11d1 0xd4b 0x9b0a 0x92e6 0x1266 0xcd6 0x9d0d 0x92b2 0x12e7 0xcc5 0x9f11 0x9287 0x13dd 0xc80 0xa114 0x924f 0x14cf 0xc4a 0xa318 0x920e 0x15a2 0xc35 0xa51b 0x91c9 0x1691 0xc3b 0xa71f 0x9184 0x17c8 0xc05 0xa922 0x913f 0x1918 0xbe0 0xab26 0x90f1 0x1a1a 0xb95 0xad29 0x909c 0x1bbb 0xb5c 0xaf2d 0x904d 0x1d37 0xb4e 0xb130 0x900f 0x1f4d 0xb5c 0xb333 0x8fe3 0x21d1 0xb88 0xb537 0x8fc1 0x24bf 0xbda 0xb73a 0x8f9d 0x28ee 0xbf2 0xb93e 0x8f72 0x2e62 0xb60 0xbb41 0x8f1f 0x352f 0xac5 0xbd45 0x8e72 0x3ca7 0xa09 0xbf48 0x8d10 0x4758 0x8e2 0xc14c 0x8b02 0x4a52 0x7f3 0xc34f 0x884a 0x4443 0x768 0xc553 0x884a 0x4443 0x768 0xc756 0x884a 0x4443 0x768>;
		battery0_profile_t3_col = <0x04>;
		battery0_profile_t3_num = <0x64>;
		battery0_profile_t4 = <0x00 0xac44 0x1e64 0x203 0xab90 0x1e60 0x407 0xaaf1 0x1ecb 0x60a 0xaa62 0x1f20 0x80e 0xa9d8 0x1f35 0xa11 0xa952 0x1f2e 0xc15 0xa8cf 0x1f2d 0xe18 0xa846 0x1ec3 0x101c 0xa7c5 0x1ead 0x121f 0xa744 0x1e61 0x1423 0xa6c3 0x1e46 0x1626 0xa643 0x1e24 0x1829 0xa5c5 0x1df3 0x1a2d 0xa54a 0x1e5a 0x1c30 0xa4c8 0x20c2 0x1e34 0xa447 0x1e74 0x2037 0xa3d2 0x1d91 0x223b 0xa35e 0x1d7e 0x243e 0xa2e5 0x1d75 0x2642 0xa26d 0x1d5b 0x2845 0xa1f6 0x1d33 0x2a49 0xa186 0x1d33 0x2c4c 0xa10e 0x1d47 0x2e4f 0xa09c 0x1d2c 0x3053 0xa032 0x1cf4 0x3256 0x9fcb 0x1cf3 0x345a 0x9f5f 0x1d33 0x365d 0x9ee7 0x1d31 0x3861 0x9e6f 0x1d1c 0x3a64 0x9dee 0x1d06 0x3c68 0x9d74 0x1ce0 0x3e6b 0x9cf7 0x1c41 0x406f 0x9c7a 0x1bd8 0x4272 0x9c01 0x1c0d 0x4475 0x9b8c 0x1c1b 0x4679 0x9b2c 0x1bf0 0x487c 0x9acd 0x1c17 0x4a80 0x9a61 0x1bfe 0x4c83 0x99f7 0x1bd3 0x4e87 0x998f 0x1bbc 0x508a 0x9928 0x1b9b 0x528e 0x98c3 0x1b45 0x5491 0x9864 0x1b70 0x5695 0x980e 0x1b1d 0x5898 0x97b8 0x1b30 0x5a9b 0x9768 0x1b23 0x5c9f 0x971f 0x1b37 0x5ea2 0x96da 0x1b78 0x60a6 0x9695 0x1b8a 0x62a9 0x9650 0x1b8a 0x64ad 0x9614 0x1bdf 0x66b0 0x95df 0x1bee 0x68b4 0x95ac 0x1c36 0x6ab7 0x9578 0x1c6b 0x6cbb 0x9545 0x1c8f 0x6ebe 0x9513 0x1cec 0x70c1 0x94e8 0x1d02 0x72c5 0x94c5 0x1d58 0x74c8 0x94a3 0x1d89 0x76cc 0x9486 0x1dd2 0x78cf 0x946d 0x1e28 0x7ad3 0x9456 0x1e8d 0x7cd6 0x9443 0x1f01 0x7eda 0x942a 0x1f45 0x80dd 0x9418 0x1ff0 0x82e1 0x9407 0x208a 0x84e4 0x93f6 0x212f 0x86e7 0x93e0 0x21c4 0x88eb 0x93ca 0x226d 0x8aee 0x93b7 0x2363 0x8cf2 0x939c 0x247e 0x8ef5 0x9383 0x2595 0x90f9 0x9361 0x264c 0x92fc 0x933f 0x2776 0x9500 0x931c 0x290b 0x9703 0x92fa 0x2abd 0x9907 0x92d6 0x2c4a 0x9b0a 0x92ab 0x2dc3 0x9d0d 0x9280 0x2fc6 0x9f11 0x924d 0x317b 0xa114 0x9219 0x3329 0xa318 0x91e1 0x3498 0xa51b 0x91a1 0x35e3 0xa71f 0x915f 0x3746 0xa922 0x9122 0x38b4 0xab26 0x90dd 0x3960 0xad29 0x9090 0x3aab 0xaf2d 0x9049 0x3b80 0xb130 0x900f 0x3ce0 0xb333 0x8fe3 0x3e93 0xb537 0x8fc3 0x4068 0xb73a 0x8fa8 0x437e 0xb93e 0x8f86 0x49df 0xbb41 0x8f55 0x5449 0xbd45 0x8ed9 0x53c8 0xbf48 0x8d90 0x50e2 0xc14c 0x8d90 0x510e 0xc34f 0x8d90 0x510e 0xc553 0x8d90 0x510e 0xc756 0x8d90 0x510e>;
		battery0_profile_t4_col = <0x03>;
		battery0_profile_t4_num = <0x64>;
		battery1_profile_t0 = <0x00 0xab36 0x3a2 0x1fb 0xaaa6 0x39e 0x3f5 0xaa25 0x39d 0x5f0 0xa9ab 0x3aa 0x7ea 0xa935 0x3b6 0x9e5 0xa8bf 0x3b6 0xbdf 0xa848 0x3b6 0xdda 0xa7ca 0x3b6 0xfd5 0xa752 0x3b6 0x11cf 0xa6d6 0x3a7 0x13ca 0xa65c 0x3a8 0x15c4 0xa5e3 0x3af 0x17bf 0xa566 0x3a0 0x19b9 0xa4ef 0x3b5 0x1bb4 0xa478 0x3fe 0x1dae 0xa402 0x3e5 0x1fa9 0xa38b 0x3b6 0x21a4 0xa313 0x3b1 0x239e 0xa296 0x39f 0x2599 0xa228 0x3b4 0x2793 0xa1b3 0x3b6 0x298e 0xa13c 0x3a7 0x2b88 0xa0cb 0x3a8 0x2d83 0xa05d 0x3b6 0x2f7e 0x9fef 0x3b6 0x3178 0x9f81 0x3b6 0x3373 0x9f14 0x3b6 0x356d 0x9ead 0x3c7 0x3768 0x9e48 0x3cf 0x3962 0x9de4 0x3cf 0x3b5d 0x9d7f 0x3cf 0x3d58 0x9d1a 0x3d0 0x3f52 0x9cc5 0x3e5 0x414d 0x9c63 0x3e8 0x4347 0x9c08 0x3f6 0x4542 0x9bb0 0x401 0x473c 0x9b58 0x40d 0x4937 0x9b0b 0x435 0x4b31 0x9ab7 0x44a 0x4d2c 0x9a5b 0x45f 0x4f27 0x99f7 0x465 0x5121 0x9980 0x442 0x531c 0x98f5 0x403 0x5516 0x986c 0x3c7 0x5711 0x97fe 0x39d 0x590b 0x97aa 0x39d 0x5b06 0x9763 0x39d 0x5d01 0x9720 0x39d 0x5efb 0x96e0 0x39d 0x60f6 0x96a5 0x398 0x62f0 0x966a 0x384 0x64eb 0x962e 0x384 0x66e5 0x95fb 0x384 0x68e0 0x95c8 0x384 0x6adb 0x9596 0x384 0x6cd5 0x9566 0x38b 0x6ed0 0x953c 0x39a 0x70ca 0x9512 0x385 0x72c5 0x94f0 0x398 0x74bf 0x94c8 0x39d 0x76ba 0x94a2 0x3a9 0x78b5 0x9481 0x3b6 0x7aaf 0x945f 0x3b6 0x7caa 0x943d 0x3b6 0x7ea4 0x941b 0x3b6 0x809f 0x9401 0x3c8 0x8299 0x93e2 0x3dd 0x8494 0x93c0 0x3e8 0x868e 0x9399 0x3e2 0x8889 0x9363 0x3cb 0x8a84 0x930f 0x3a0 0x8c7e 0x92ca 0x39d 0x8e79 0x9299 0x3ad 0x9073 0x926f 0x3b6 0x926e 0x9241 0x3b6 0x9468 0x9210 0x3b6 0x9663 0x91e6 0x3b6 0x985e 0x91bc 0x3a1 0x9a58 0x9199 0x3ae 0x9c53 0x9171 0x3b6 0x9e4d 0x9140 0x3b6 0xa048 0x9105 0x3b6 0xa242 0x90ca 0x3b6 0xa43d 0x908f 0x3b6 0xa638 0x904d 0x3b6 0xa832 0x8ffe 0x399 0xaa2d 0x8fc3 0x38f 0xac27 0x8fa9 0x3a4 0xae22 0x8fa1 0x3bc 0xb01c 0x8f98 0x3e6 0xb217 0x8f80 0x410 0xb411 0x8f60 0x45b 0xb60c 0x8ee1 0x44d 0xb807 0x8dbe 0x412 0xba01 0x8be3 0x413 0xbbfc 0x897b 0x468 0xbdf6 0x85e3 0x4e7 0xbff1 0x7f35 0x863 0xc1eb 0x74a4 0x1469 0xc3e6 0x74a4 0x1469>;
		battery1_profile_t0_col = <0x03>;
		battery1_profile_t0_num = <0x64>;
		battery1_profile_t1 = <0x00 0xab7c 0x65e 0x1fb 0xaaf5 0x65a 0x3f5 0xaa7c 0x659 0x5f0 0xaa05 0x659 0x7ea 0xa98f 0x659 0x9e5 0xa919 0x653 0xbdf 0xa8a3 0x640 0xdda 0xa82d 0x640 0xfd5 0xa7b6 0x640 0x11cf 0xa73a 0x622 0x13ca 0xa6c0 0x60e 0x15c4 0xa647 0x607 0x17bf 0xa5ca 0x5f5 0x19b9 0xa553 0x5f5 0x1bb4 0xa4dc 0x674 0x1dae 0xa460 0x63a 0x1fa9 0xa3e9 0x5dc 0x21a4 0xa379 0x5dc 0x239e 0xa303 0x5dc 0x2599 0xa28d 0x5dc 0x2793 0xa217 0x5dc 0x298e 0xa1a6 0x5dc 0x2b88 0xa134 0x5dc 0x2d83 0xa0c1 0x5dc 0x2f7e 0xa053 0x5dc 0x3178 0x9fe5 0x5dc 0x3373 0x9f78 0x5dc 0x356d 0x9f11 0x5ed 0x3768 0x9eac 0x5f5 0x3962 0x9e48 0x5fd 0x3b5d 0x9de3 0x612 0x3d58 0x9d7d 0x627 0x3f52 0x9d18 0x627 0x414d 0x9cb3 0x627 0x4347 0x9c53 0x635 0x4542 0x9bfa 0x64a 0x473c 0x9ba6 0x65f 0x4937 0x9b50 0x672 0x4b31 0x9af3 0x672 0x4d2c 0x9a97 0x685 0x4f27 0x9a2d 0x67b 0x5121 0x99b6 0x64f 0x531c 0x9934 0x600 0x5516 0x98b0 0x59e 0x5711 0x983a 0x55f 0x590b 0x97dd 0x535 0x5b06 0x978e 0x52d 0x5d01 0x9748 0x52d 0x5efb 0x9704 0x524 0x60f6 0x96c3 0x514 0x62f0 0x9688 0x514 0x64eb 0x9656 0x514 0x66e5 0x9623 0x527 0x68e0 0x95f0 0x51e 0x6adb 0x95be 0x514 0x6cd5 0x958e 0x51b 0x6ed0 0x9564 0x52d 0x70ca 0x953a 0x52d 0x72c5 0x9510 0x52d 0x74bf 0x94ec 0x53d 0x76ba 0x94ca 0x546 0x78b5 0x94a9 0x54e 0x7aaf 0x9487 0x55f 0x7caa 0x9465 0x55f 0x7ea4 0x9443 0x55f 0x809f 0x9429 0x571 0x8299 0x940a 0x578 0x8494 0x93ec 0x578 0x868e 0x93d0 0x578 0x8889 0x93ae 0x576 0x8a84 0x9383 0x561 0x8c7e 0x9361 0x55f 0x8e79 0x9339 0x54f 0x9073 0x930f 0x53a 0x926e 0x92e5 0x52d 0x9468 0x92ba 0x52d 0x9663 0x9290 0x52d 0x985e 0x9266 0x52d 0x9a58 0x9243 0x52d 0x9c53 0x9221 0x53a 0x9e4d 0x91f7 0x54f 0xa048 0x91c3 0x55f 0xa242 0x9188 0x561 0xa43d 0x914d 0x575 0xa638 0x9112 0x58a 0xa832 0x90cc 0x591 0xaa2d 0x9080 0x59c 0xac27 0x9044 0x5b1 0xae22 0x902c 0x5c9 0xb01c 0x901b 0x5f3 0xb217 0x900a 0x631 0xb411 0x8ff3 0x681 0xb60c 0x8fc1 0x6ee 0xb807 0x8f30 0x742 0xba01 0x8df5 0x765 0xbbfc 0x8bed 0x7be 0xbdf6 0x891f 0x8bb 0xbff1 0x84ca 0xa7c 0xc1eb 0x7cab 0x1cb3 0xc3e6 0x7814 0x1c07>;
		battery1_profile_t1_col = <0x03>;
		battery1_profile_t1_num = <0x64>;
		battery1_profile_t2 = <0x00 0xabcc 0xec4 0x728 0x1fb 0xab2c 0xec0 0x728 0x3f5 0xaaa0 0xebf 0x71e 0x5f0 0xaa1e 0xeb2 0x738 0x7ea 0xa99f 0xe8a 0x710 0x9e5 0xa923 0xe50 0x704 0xbdf 0xa8ac 0xe24 0x743 0xdda 0xa82e 0xde5 0x743 0xfd5 0xa7b6 0xdcb 0x69c 0x11cf 0xa73a 0xd98 0x6fd 0x13ca 0xa6c0 0xd64 0x6eb 0x15c4 0xa647 0xd3a 0x66d 0x17bf 0xa5ca 0xd0f 0x68a 0x19b9 0xa553 0xce5 0x68a 0x1bb4 0xa4dc 0xdf3 0x69d 0x1dae 0xa466 0xd6c 0x636 0x1fa9 0xa3ef 0xc86 0x614 0x21a4 0xa37b 0xc62 0x680 0x239e 0xa30d 0xc4c 0x676 0x2599 0xa297 0xc37 0x684 0x2793 0xa221 0xc0f 0x6e5 0x298e 0xa1b0 0xc03 0x663 0x2b88 0xa13e 0xbed 0x65a 0x2d83 0xa0cb 0xbca 0x656 0x2f7e 0xa05e 0xbbb 0x63b 0x3178 0x9ff9 0xbd0 0x631 0x3373 0x9f8c 0xbbd 0x629 0x356d 0x9f25 0xbc9 0x62f 0x3768 0x9ec0 0xbdd 0x625 0x3962 0x9e59 0xbea 0x62e 0x3b5d 0x9deb 0xbe6 0x610 0x3d58 0x9d7d 0xbd1 0x62f 0x3f52 0x9d18 0xbd1 0x61d 0x414d 0x9cac 0xbad 0x636 0x4347 0x9c49 0xb9f 0x653 0x4542 0x9be8 0xb95 0x643 0x473c 0x9b85 0xb80 0x645 0x4937 0x9b28 0xb6b 0x635 0x4b31 0x9acb 0xb56 0x64b 0x4d2c 0x9a67 0xb41 0x634 0x4f27 0x99fb 0xb1c 0x65f 0x5121 0x9989 0xada 0x676 0x531c 0x9916 0xa8e 0x68e 0x5516 0x98a8 0xa4e 0x69e 0x5711 0x983a 0xa0f 0x6be 0x590b 0x97e6 0x9fa 0x6d7 0x5b06 0x9791 0x9e5 0x6cf 0x5d01 0x9742 0x9d0 0x6f6 0x5efb 0x96fa 0x9bb 0x710 0x60f6 0x96b9 0x9ab 0x6ec 0x62f0 0x967e 0x9ab 0x6fc 0x64eb 0x9642 0x9ab 0x71b 0x66e5 0x960f 0x9be 0x723 0x68e0 0x95dc 0x9d3 0x71e 0x6adb 0x95aa 0x9dd 0x71e 0x6cd5 0x957a 0x9e4 0x723 0x6ed0 0x9550 0x9f6 0x71e 0x70ca 0x9526 0x9f6 0x72c 0x72c5 0x94fc 0xa0a 0x72f 0x74bf 0x94d2 0xa0f 0x72d 0x76ba 0x94ac 0xa1b 0x739 0x78b5 0x948b 0xa30 0x726 0x7aaf 0x9469 0xa41 0x73a 0x7caa 0x9447 0xa42 0x73e 0x7ea4 0x9425 0xa57 0x73b 0x809f 0x940b 0xa6c 0x725 0x8299 0x93f1 0xa81 0x73e 0x8494 0x93d8 0xa8c 0x744 0x868e 0x93bf 0xa92 0x748 0x8889 0x93a6 0xaa7 0x745 0x8a84 0x9395 0xabc 0x73b 0x8c7e 0x937d 0xad1 0x733 0x8e79 0x9363 0xae7 0x749 0x9073 0x934a 0xb13 0x756 0x926e 0x932e 0xb43 0x73e 0x9468 0x930c 0xb5c 0x744 0x9663 0x92ea 0xb86 0x72f 0x985e 0x92c0 0xb86 0x73c 0x9a58 0x929d 0xbba 0x732 0x9c53 0x9275 0xc21 0x70c 0x9e4d 0x9247 0xc83 0x718 0xa048 0x9213 0xcc8 0x707 0xa242 0x91d8 0xd1e 0x6e4 0xa43d 0x919d 0xd86 0x6e8 0xa638 0x915b 0xe01 0x6dc 0xa832 0x9112 0xe80 0x6d3 0xaa2d 0x90c6 0xeff 0x6bc 0xac27 0x907f 0xf91 0x698 0xae22 0x9046 0x1055 0x6a6 0xb01c 0x901c 0x113d 0x69a 0xb217 0x8ffa 0x128a 0x69d 0xb411 0x8fd2 0x141c 0x682 0xb60c 0x8f94 0x160c 0x64f 0xb807 0x8f23 0x1849 0x604 0xba01 0x8e5a 0x1ac4 0x5d4 0xbbfc 0x8d13 0x1d9b 0x637 0xbdf6 0x8aee 0x21d0 0x670 0xbff1 0x87c9 0x28cc 0x6bb 0xc1eb 0x832a 0x3219 0x6d1 0xc3e6 0x79c2 0x1fbd 0x65a>;
		battery1_profile_t2_col = <0x04>;
		battery1_profile_t2_num = <0x64>;
		battery1_profile_t3 = <0x00 0xabcc 0x1b76 0x728 0x1fb 0xab0a 0x1b72 0x16d6 0x3f5 0xaa6a 0x1b71 0x16d6 0x5f0 0xa9d2 0x1b56 0x16e9 0x7ea 0xa942 0x1b2c 0x16fd 0x9e5 0xa8b8 0x1afc 0x1723 0xbdf 0xa82a 0x1abf 0x1723 0xdda 0xa7ac 0x1a95 0x174a 0xfd5 0xa725 0x1a57 0x1770 0x11cf 0xa6a4 0x1a18 0x15cf 0x13ca 0xa621 0x19ce 0x145f 0x15c4 0xa59d 0x1980 0x132b 0x17bf 0xa51e 0x1941 0x1226 0x19b9 0xa4a0 0x1902 0x1154 0x1bb4 0xa421 0x1ab2 0x1074 0x1dae 0xa3a8 0x19ca 0xfaa 0x1fa9 0xa331 0x1857 0xf4e 0x21a4 0xa2bb 0x182d 0xeea 0x239e 0xa245 0x1801 0xec4 0x2599 0xa1cf 0x17c2 0xe7d 0x2793 0xa160 0x1795 0xe68 0x298e 0xa0ec 0x176b 0xe4b 0x2b88 0xa07f 0x174c 0xe2a 0x2d83 0xa017 0x1737 0xdfa 0x2f7e 0x9faa 0x1722 0xdd8 0x3178 0x9f45 0x170d 0xde4 0x3373 0x9ed8 0x16f8 0xdb6 0x356d 0x9e6a 0x16d2 0xdaa 0x3768 0x9df8 0x168f 0xda6 0x3962 0x9d83 0x1655 0xd97 0x3b5d 0x9d0f 0x1637 0xd94 0x3d58 0x9ca1 0x15f9 0xd8c 0x3f52 0x9c3c 0x15f9 0xd87 0x414d 0x9bd7 0x15d5 0xd75 0x4347 0x9b71 0x1582 0xd49 0x4542 0x9b10 0x1554 0xd4f 0x473c 0x9ab1 0x1551 0xd48 0x4937 0x9a4c 0x151a 0xd55 0x4b31 0x99ef 0x152f 0xd4f 0x4d2c 0x9983 0x14bc 0xd62 0x4f27 0x991b 0x147c 0xd7d 0x5121 0x98b6 0x1446 0xd94 0x531c 0x9854 0x1416 0xdcc 0x5516 0x97f9 0x13fd 0xdf8 0x5711 0x97a4 0x13d3 0xe10 0x590b 0x9750 0x13be 0xe12 0x5b06 0x9702 0x13a9 0xe47 0x5d01 0x96bc 0x13a1 0xe5b 0x5efb 0x967c 0x13aa 0xe66 0x60f6 0x9641 0x13ba 0xe5a 0x62f0 0x9606 0x13ba 0xe71 0x64eb 0x95ca 0x13ba 0xe69 0x66e5 0x9597 0x13cd 0xe6f 0x68e0 0x956a 0x13e2 0xe74 0x6adb 0x953c 0x13f7 0xe47 0x6cd5 0x950c 0x1405 0xe56 0x6ed0 0x94e3 0x140d 0xe36 0x70ca 0x94c2 0x144d 0xe2f 0x72c5 0x9498 0x1450 0xe2a 0x74bf 0x9474 0x1460 0xe1f 0x76ba 0x9457 0x148e 0xe30 0x78b5 0x943e 0x14bc 0xe27 0x7aaf 0x9425 0x14d6 0xe1c 0x7caa 0x940c 0x1501 0xe26 0x7ea4 0x93fb 0x1556 0xe07 0x809f 0x93ea 0x1598 0xe04 0x8299 0x93d9 0x15e6 0xdf6 0x8494 0x93c4 0x163a 0xdf3 0x868e 0x93ad 0x1695 0xded 0x8889 0x939c 0x16fe 0xde7 0x8a84 0x938b 0x1768 0xde1 0x8c7e 0x9373 0x17e5 0xdf3 0x8e79 0x9359 0x1854 0xde5 0x9073 0x9340 0x18d4 0xdef 0x926e 0x9324 0x1960 0xdf6 0x9468 0x9300 0x19e3 0xe01 0x9663 0x92d6 0x1a77 0xe00 0x985e 0x92b4 0x1b35 0xe13 0x9a58 0x9285 0x1bbf 0xe0a 0x9c53 0x9252 0x1c80 0xe03 0x9e4d 0x921c 0x1d5f 0xde0 0xa048 0x91e1 0x1e3d 0xdcf 0xa242 0x91a5 0x1f3b 0xdac 0xa43d 0x9163 0x2049 0xd79 0xa638 0x9118 0x216e 0xd1d 0xa832 0x90d7 0x22ec 0xc10 0xaa2d 0x9098 0x2492 0xb03 0xac27 0x905a 0x265a 0xb37 0xae22 0x9027 0x2875 0xa05 0xb01c 0x8ff5 0x2ad9 0x8f5 0xb217 0x8fc2 0x2d65 0x862 0xb411 0x8f89 0x3004 0x78c 0xb60c 0x8f3a 0x3282 0x750 0xb807 0x8eb8 0x34c5 0x725 0xba01 0x8ddf 0x36eb 0x67d 0xbbfc 0x8c86 0x3977 0x5ec 0xbdf6 0x8a37 0x3ea9 0x5cd 0xbff1 0x86d3 0x3fb8 0x622 0xc1eb 0x81a6 0x32e6 0x6f2 0xc3e6 0x81a6 0x32e1 0x8ac>;
		battery1_profile_t3_col = <0x04>;
		battery1_profile_t3_num = <0x64>;
		battery1_profile_t4 = <0x00 0xabf4 0x30a2 0x1fb 0xab21 0x30a2 0x3f5 0xaa63 0x30e7 0x5f0 0xa9ae 0x30d1 0x7ea 0xa901 0x3057 0x9e5 0xa85a 0x2fae 0xbdf 0xa7bb 0x2f08 0xdda 0xa72b 0x2e8a 0xfd5 0xa694 0x2dd2 0x11cf 0xa608 0x2d32 0x13ca 0xa581 0x2c9f 0x15c4 0xa4fa 0x2c04 0x17bf 0xa476 0x2b65 0x19b9 0xa3ff 0x2afb 0x1bb4 0xa381 0x2cce 0x1dae 0xa308 0x2b7c 0x1fa9 0xa291 0x297b 0x21a4 0xa21d 0x2907 0x239e 0xa1af 0x28ae 0x2599 0xa139 0x281a 0x2793 0xa0d2 0x27d2 0x298e 0xa066 0x2774 0x2b88 0x9ffd 0x2721 0x2d83 0x9f95 0x26da 0x2f7e 0x9f26 0x2689 0x3178 0x9eb0 0x264a 0x3373 0x9e31 0x25cd 0x356d 0x9db3 0x255f 0x3768 0x9d35 0x24de 0x3962 0x9cbb 0x246d 0x3b5d 0x9c47 0x2425 0x3d58 0x9bd9 0x23be 0x3f52 0x9b74 0x23be 0x414d 0x9b0f 0x230c 0x4347 0x9aaf 0x22e0 0x4542 0x9a56 0x2300 0x473c 0x99ff 0x22fd 0x4937 0x99a2 0x22bd 0x4b31 0x9945 0x227e 0x4d2c 0x98e9 0x228c 0x4f27 0x9892 0x2244 0x5121 0x983d 0x21e6 0x531c 0x97ec 0x21a2 0x5516 0x97a0 0x218b 0x5711 0x9754 0x21ca 0x590b 0x9708 0x21b5 0x5b06 0x96c3 0x21a0 0x5d01 0x9680 0x218b 0x5efb 0x9643 0x2192 0x60f6 0x960f 0x21b1 0x62f0 0x95d4 0x21b3 0x64eb 0x95a2 0x21c8 0x66e5 0x956f 0x21ca 0x68e0 0x9542 0x21e8 0x6adb 0x9518 0x2207 0x6cd5 0x94ee 0x221c 0x6ed0 0x94c5 0x2231 0x70ca 0x94a4 0x2246 0x72c5 0x948a 0x2283 0x74bf 0x9471 0x22c2 0x76ba 0x9457 0x2302 0x78b5 0x9441 0x2349 0x7aaf 0x942f 0x239e 0x7caa 0x9415 0x23f3 0x7ea4 0x93fc 0x245c 0x809f 0x93ea 0x24c6 0x8299 0x93d9 0x253d 0x8494 0x93c4 0x25c6 0x868e 0x93ad 0x264e 0x8889 0x939b 0x26c2 0x8a84 0x9382 0x2795 0x8c7e 0x9369 0x281b 0x8e79 0x934f 0x28c8 0x9073 0x9331 0x294c 0x926e 0x9310 0x29ce 0x9468 0x92ef 0x2a9e 0x9663 0x92d6 0x2b5c 0x985e 0x92ac 0x2c1a 0x9a58 0x9282 0x2cd8 0x9c53 0x9257 0x2da3 0x9e4d 0x9229 0x2e6c 0xa048 0x91f5 0x2f30 0xa242 0x91ba 0x3004 0xa43d 0x917f 0x30e9 0xa638 0x9144 0x31e3 0xa832 0x90fe 0x32c3 0xaa2d 0x90ba 0x33b6 0xac27 0x907f 0x34c8 0xae22 0x9046 0x35e6 0xb01c 0x901c 0x374d 0xb217 0x8ffa 0x38f0 0xb411 0x8fd2 0x3ae7 0xb60c 0x8f9e 0x3d71 0xb807 0x8f45 0x40d9 0xba01 0x8e93 0x4574 0xbbfc 0x8d3c 0x4b72 0xbdf6 0x8b12 0x4a6d 0xbff1 0x87d9 0x4246 0xc1eb 0x87d2 0x421d 0xc3e6 0x87d2 0x421d>;
		battery1_profile_t4_col = <0x03>;
		battery1_profile_t4_num = <0x64>;
		battery2_profile_t0 = <0x00 0xac58 0x33e 0x26a 0xab73 0x33a 0x4d4 0xaae9 0x34c 0x73e 0xaa6d 0x352 0x9a8 0xa9fc 0x35f 0xc11 0xa98a 0x375 0xe7b 0xa90f 0x37d 0x10e5 0xa895 0x36b 0x134f 0xa821 0x36d 0x15b9 0xa7a6 0x383 0x1823 0xa722 0x36f 0x1a8d 0xa6a5 0x36b 0x1cf7 0xa629 0x37a 0x1f60 0xa5a9 0x378 0x21ca 0xa528 0x36b 0x2434 0xa4ad 0x371 0x269e 0xa433 0x384 0x2908 0xa3b7 0x384 0x2b72 0xa33c 0x384 0x2ddc 0xa2c0 0x384 0x3046 0xa244 0x384 0x32af 0xa1ce 0x384 0x3519 0xa15b 0x38e 0x3783 0xa0e6 0x396 0x39ed 0xa06c 0x384 0x3c57 0x9ffa 0x385 0x3ec1 0x9f90 0x39b 0x412b 0x9f1e 0x39d 0x4395 0x9eb2 0x39d 0x45fe 0x9e48 0x3ac 0x4868 0x9dde 0x3b6 0x4ad2 0x9d78 0x3b6 0x4d3c 0x9d17 0x3b6 0x4fa6 0x9cb5 0x3b9 0x5210 0x9c54 0x3cf 0x547a 0x9bfc 0x3e5 0x56e4 0x9b9c 0x3e8 0x594e 0x9b41 0x3f8 0x5bb7 0x9ae9 0x401 0x5e21 0x9a91 0x416 0x608b 0x9a36 0x433 0x62f5 0x99cc 0x426 0x655f 0x993f 0x3e5 0x67c9 0x98b1 0x3b9 0x6a33 0x983d 0x3a1 0x6c9d 0x97e0 0x38c 0x6f06 0x978e 0x384 0x7170 0x9748 0x384 0x73da 0x970a 0x384 0x7644 0x96cc 0x384 0x78ae 0x9690 0x384 0x7b18 0x965b 0x384 0x7d82 0x961d 0x36e 0x7fec 0x95ee 0x37e 0x8255 0x95bc 0x384 0x84bf 0x958c 0x384 0x8729 0x9560 0x384 0x8993 0x9534 0x384 0x8bfd 0x9509 0x388 0x8e67 0x94e6 0x39e 0x90d1 0x94c3 0x3b4 0x933b 0x949f 0x3b6 0x95a4 0x947c 0x3b6 0x980e 0x9459 0x3b6 0x9a78 0x9435 0x3b6 0x9ce2 0x9416 0x3bf 0x9f4c 0x93f9 0x3cf 0xa1b6 0x93d7 0x3d2 0xa420 0x93bc 0x3e8 0xa68a 0x9376 0x3a6 0xa8f4 0x9328 0x38a 0xab5d 0x92e5 0x384 0xadc7 0x92b2 0x391 0xb031 0x9286 0x39d 0xb29b 0x9259 0x39d 0xb505 0x922d 0x39d 0xb76f 0x9202 0x39d 0xb9d9 0x91df 0x39d 0xbc43 0x91bc 0x3b1 0xbeac 0x9192 0x3b6 0xc116 0x9160 0x3b6 0xc380 0x9126 0x3ab 0xc5ea 0x90e8 0x39d 0xc854 0x90ab 0x3a2 0xcabe 0x906b 0x3b3 0xcd28 0x901b 0x39d 0xcf92 0x8fdd 0x387 0xd1fb 0x8fc5 0x384 0xd465 0x8fba 0x3a4 0xd6cf 0x8fac 0x3c3 0xd939 0x8f96 0x3ed 0xdba3 0x8f6d 0x428 0xde0d 0x8eff 0x437 0xe077 0x8dda 0x3d0 0xe2e1 0x8bf5 0x3e6 0xe54a 0x896d 0x425 0xe7b4 0x85dd 0x48a 0xea1e 0x7fab 0x6c6 0xec88 0x749a 0x1243 0xeef2 0x73a0 0xfb9>;
		battery2_profile_t0_col = <0x03>;
		battery2_profile_t0_num = <0x64>;
		battery2_profile_t1 = <0x00 0xac30 0x406 0x26a 0xabb4 0x402 0x4d4 0xab39 0x3ee 0x73e 0xaaca 0x3f8 0x9a8 0xaa5b 0x401 0xc11 0xa9e8 0x3f7 0xe7b 0xa976 0x3ef 0x10e5 0xa901 0x3fd 0x134f 0xa885 0x3e8 0x15b9 0xa80a 0x3e8 0x1823 0xa78e 0x3e8 0x1a8d 0xa713 0x3fa 0x1cf7 0xa697 0x401 0x1f60 0xa617 0x3f5 0x21ca 0xa596 0x3f1 0x2434 0xa51b 0x401 0x269e 0xa4a0 0x3fe 0x2908 0xa41b 0x3e8 0x2b72 0xa3a8 0x3fe 0x2ddc 0xa326 0x401 0x3046 0xa2af 0x411 0x32af 0xa237 0x41a 0x3519 0xa1bf 0x41a 0x3783 0xa14a 0x41a 0x39ed 0xa0d0 0x41a 0x3c57 0xa05d 0x41a 0x3ec1 0x9fea 0x41a 0x412b 0x9f80 0x42e 0x4395 0x9f0f 0x433 0x45fe 0x9ea2 0x442 0x4868 0x9e38 0x44c 0x4ad2 0x9dd2 0x455 0x4d3c 0x9d71 0x46b 0x4fa6 0x9d0f 0x481 0x5210 0x9cae 0x497 0x547a 0x9c4d 0x497 0x56e4 0x9bec 0x4aa 0x594e 0x9b91 0x4c0 0x5bb7 0x9b34 0x4d6 0x5e21 0x9ad3 0x4e2 0x608b 0x9a75 0x4e9 0x62f5 0x9a17 0x4f7 0x655f 0x99a3 0x4de 0x67c9 0x991f 0x49b 0x6a33 0x9892 0x445 0x6c9d 0x9822 0x410 0x6f06 0x97c5 0x401 0x7170 0x9775 0x401 0x73da 0x972f 0x3f8 0x7644 0x96ea 0x3e8 0x78ae 0x96ae 0x3e8 0x7b18 0x9679 0x3e8 0x7d82 0x9644 0x3e8 0x7fec 0x960f 0x3e8 0x8255 0x95e0 0x3f8 0x84bf 0x95b4 0x401 0x8729 0x9588 0x401 0x8993 0x955c 0x401 0x8bfd 0x9531 0x401 0x8e67 0x950e 0x403 0x90d1 0x94eb 0x430 0x933b 0x94c7 0x433 0x95a4 0x94a4 0x433 0x980e 0x9481 0x433 0x9a78 0x9462 0x433 0x9ce2 0x9448 0x43c 0x9f4c 0x942d 0x452 0xa1b6 0x9413 0x465 0xa420 0x93f8 0x465 0xa68a 0x93d5 0x44f 0xa8f4 0x93b9 0x44c 0xab5d 0x9392 0x43c 0xadc7 0x9366 0x426 0xb031 0x933a 0x41a 0xb29b 0x930d 0x413 0xb505 0x92e3 0x405 0xb76f 0x92c0 0x419 0xb9d9 0x9294 0x403 0xbc43 0x9278 0x415 0xbeac 0x9256 0x42b 0xc116 0x922d 0x425 0xc380 0x91fd 0x425 0xc5ea 0x91c1 0x422 0xc854 0x917d 0x401 0xcabe 0x9140 0x406 0xcd28 0x910b 0x432 0xcf92 0x90ab 0x408 0xd1fb 0x906f 0x3ee 0xd465 0x9053 0x3f8 0xd6cf 0x9042 0x40e 0xd939 0x9030 0x424 0xdba3 0x901e 0x448 0xde0d 0x9005 0x486 0xe077 0x8fbc 0x4ac 0xe2e1 0x8ebc 0x46a 0xe54a 0x8ce1 0x465 0xe7b4 0x8a61 0x4aa 0xea1e 0x86c7 0x520 0xec88 0x8036 0x976 0xeef2 0x74e0 0x130b>;
		battery2_profile_t1_col = <0x03>;
		battery2_profile_t1_num = <0x64>;
		battery2_profile_t2 = <0x00 0xac58 0x514 0x4d8 0x26a 0xabe5 0x514 0xca0 0x4d4 0xab73 0x561 0xca0 0x73e 0xab00 0x568 0xca0 0x9a8 0xaa92 0x55f 0xca0 0xc11 0xaa28 0x569 0xca0 0xe7b 0xa9bc 0x578 0xc61 0x10e5 0xa947 0x578 0xb8e 0x134f 0xa8cc 0x578 0xade 0x15b9 0xa859 0x578 0xa35 0x1823 0xa7d6 0x578 0x9c9 0x1a8d 0xa759 0x578 0x960 0x1cf7 0xa6dd 0x578 0x928 0x1f60 0xa65d 0x56c 0x906 0x21ca 0xa5dc 0x568 0x8e8 0x2434 0xa561 0x578 0x8d6 0x269e 0xa4e6 0x578 0x8ea 0x2908 0xa461 0x578 0x908 0x2b72 0xa3e6 0x578 0x7c2 0x2ddc 0xa36a 0x578 0x796 0x3046 0xa2ee 0x578 0x768 0x32af 0xa273 0x578 0x742 0x3519 0xa1fb 0x582 0x722 0x3783 0xa186 0x591 0x70d 0x39ed 0xa10c 0x595 0x6f3 0x3c57 0xa099 0x5aa 0x6de 0x3ec1 0xa026 0x5aa 0x6d0 0x412b 0x9fb4 0x5be 0x6bb 0x4395 0x9f48 0x5d5 0x6b7 0x45fe 0x9ede 0x5dc 0x6af 0x4868 0x9e74 0x5f3 0x6a8 0x4ad2 0x9e0a 0x60e 0x69c 0x4d3c 0x9da0 0x61a 0x69e 0x4fa6 0x9d36 0x640 0x69d 0x5210 0x9ccc 0x640 0x69d 0x547a 0x9c6b 0x656 0x69c 0x56e4 0x9c12 0x659 0x696 0x594e 0x9bb3 0x669 0x6a0 0x5bb7 0x9b57 0x68c 0x6be 0x5e21 0x9afb 0x6a4 0x6a0 0x608b 0x9a97 0x6a4 0x6a8 0x62f5 0x9a29 0x697 0x6a9 0x655f 0x99ad 0x653 0x6b5 0x67c9 0x991f 0x5fb 0x6c7 0x6a33 0x989a 0x5a3 0x6db 0x6c9d 0x982c 0x56e 0x6ff 0x6f06 0x97cf 0x55f 0x71a 0x7170 0x977f 0x55f 0x72e 0x73da 0x9739 0x556 0x736 0x7644 0x96f4 0x546 0x73c 0x78ae 0x96b7 0x546 0x735 0x7b18 0x9679 0x546 0x744 0x7d82 0x9644 0x546 0x740 0x7fec 0x960f 0x559 0x74a 0x8255 0x95da 0x54f 0x743 0x84bf 0x95aa 0x553 0x743 0x8729 0x957e 0x55f 0x740 0x8993 0x9552 0x55f 0x740 0x8bfd 0x9526 0x55f 0x73b 0x8e67 0x94fa 0x55f 0x73b 0x90d1 0x94d7 0x55f 0x738 0x933b 0x94b3 0x573 0x735 0x95a4 0x9490 0x578 0x736 0x980e 0x946d 0x578 0x734 0x9a78 0x944e 0x584 0x734 0x9ce2 0x9434 0x59a 0x733 0x9f4c 0x9419 0x5aa 0x766 0xa1b6 0x93ff 0x5aa 0x740 0xa420 0x93e4 0x5aa 0x787 0xa68a 0x93ca 0x5aa 0x75b 0xa8f4 0x93b7 0x5bd 0x7fc 0xab5d 0x939f 0x5b3 0x812 0xadc7 0x9384 0x5aa 0x80e 0xb031 0x936a 0x5aa 0x814 0xb29b 0x934c 0x5a3 0x815 0xb505 0x9326 0x588 0x818 0xb76f 0x92f2 0x560 0x81c 0xb9d9 0x92cf 0x576 0x81b 0xbc43 0x92ac 0x578 0x829 0xbeac 0x9288 0x578 0x828 0xc116 0x925f 0x586 0x828 0xc380 0x922f 0x591 0x81c 0xc5ea 0x91f3 0x591 0x809 0xc854 0x91af 0x596 0x7f3 0xcabe 0x9172 0x5ad 0x7e1 0xcd28 0x913d 0x5c3 0x7ca 0xcf92 0x90dd 0x5ad 0x7c6 0xd1fb 0x9092 0x5bd 0x7b7 0xd465 0x9065 0x5c3 0x7a6 0xd6cf 0x904c 0x5ea 0x79b 0xd939 0x9036 0x622 0x79b 0xdba3 0x9019 0x65c 0x78d 0xde0d 0x8ff1 0x6c1 0x76f 0xe077 0x8fab 0x75f 0x75a 0xe2e1 0x8ee0 0x83b 0x74d 0xe54a 0x8d01 0xa9a 0x74a 0xe7b4 0x8a10 0x19db 0x74f 0xea1e 0x7ed9 0x1adb 0x732 0xec88 0x74d6 0x12a7 0x6c3 0xeef2 0x74d6 0x12a7 0x69b>;
		battery2_profile_t2_col = <0x04>;
		battery2_profile_t2_num = <0x64>;
		battery2_profile_t3 = <0x00 0xac6c 0x7d0 0x4d8 0x26a 0xabf0 0x7d0 0xb32 0x4d4 0xab7d 0x7f6 0xb32 0x73e 0xab0a 0x7f2 0xb32 0x9a8 0xaa9c 0x7f6 0xb32 0xc11 0xaa2e 0x7ed 0xb32 0xe7b 0xa9be 0x7d7 0xb32 0x10e5 0xa951 0x7e5 0xb32 0x134f 0xa8d6 0x7d2 0xc14 0x15b9 0xa863 0x7e8 0xbbb 0x1823 0xa7e0 0x7c0 0xb1a 0x1a8d 0xa763 0x7c9 0xacc 0x1cf7 0xa6e7 0x7c1 0xa8e 0x1f60 0xa667 0x7b7 0xa58 0x21ca 0xa5e6 0x7b7 0xa24 0x2434 0xa56b 0x7bd 0xa1a 0x269e 0xa4f0 0x7cd 0x9e7 0x2908 0xa46b 0x7b7 0x9ef 0x2b72 0xa3f0 0x7b7 0x9e0 0x2ddc 0xa374 0x7ca 0x9d7 0x3046 0xa2f8 0x7d0 0x9b4 0x32af 0xa27d 0x7d0 0x9ad 0x3519 0xa201 0x7d0 0x9a4 0x3783 0xa189 0x7d7 0x99c 0x39ed 0xa116 0x7ed 0x9ae 0x3c57 0xa0a3 0x802 0x99d 0x3ec1 0xa027 0x802 0x9a2 0x412b 0x9fbc 0x816 0x9a3 0x4395 0x9f52 0x82d 0x9b9 0x45fe 0x9ee2 0x834 0x9b7 0x4868 0x9e74 0x84b 0x9b8 0x4ad2 0x9e07 0x86f 0x9c4 0x4d3c 0x9d96 0x87f 0x9dd 0x4fa6 0x9d2c 0x882 0x9f3 0x5210 0x9cc2 0x898 0xa0b 0x547a 0x9c58 0x882 0xa3d 0x56e4 0x9bf6 0x87f 0xa4f 0x594e 0x9b9b 0x88f 0xa85 0x5bb7 0x9b39 0x87e 0xa90 0x5e21 0x9acf 0x866 0xa9d 0x608b 0x9a62 0x85f 0xab5 0x62f5 0x99ec 0x83b 0xac9 0x655f 0x9968 0x7e5 0xaf6 0x67c9 0x98ec 0x7a2 0xb30 0x6a33 0x9879 0x775 0xb7b 0x6c9d 0x9815 0x75b 0xbc7 0x6f06 0x97bb 0x736 0xc11 0x7170 0x9767 0x716 0xc6b 0x73da 0x971b 0x708 0xc8a 0x7644 0x96d9 0x70e 0xcb2 0x78ae 0x96a3 0x721 0xccc 0x7b18 0x9665 0x721 0xcec 0x7d82 0x9627 0x721 0xce1 0x7fec 0x95f1 0x721 0xcef 0x8255 0x95c2 0x731 0xcff 0x84bf 0x9591 0x73a 0xd1a 0x8729 0x9560 0x73a 0xd23 0x8993 0x9534 0x741 0xd23 0x8bfd 0x9509 0x757 0xd41 0x8e67 0x94e6 0x76b 0xd50 0x90d1 0x94b9 0x755 0xd5a 0x933b 0x9495 0x767 0xd5e 0x95a4 0x9479 0x77d 0xd53 0x980e 0x9459 0x794 0xd75 0x9a78 0x943a 0x79e 0xd6a 0x9ce2 0x941c 0x79e 0xd8a 0x9f4c 0x93fd 0x7a4 0xd82 0xa1b6 0x93eb 0x7b7 0xdbc 0xa420 0x93d0 0x7b7 0xdac 0xa68a 0x93be 0x7cd 0xdaf 0xa8f4 0x93ad 0x7d0 0xdb1 0xab5d 0x939b 0x7d0 0xda8 0xadc7 0x938a 0x7dd 0xdcb 0xb031 0x9374 0x7e9 0xdba 0xb29b 0x9359 0x7f0 0xddf 0xb505 0x933b 0x7fe 0xdab 0xb76f 0x9310 0x7e9 0xdc5 0xb9d9 0x92e4 0x7e9 0xdac 0xbc43 0x92c0 0x811 0xdac 0xbeac 0x9296 0x82c 0xdb1 0xc116 0x9269 0x851 0xd98 0xc380 0x9230 0x871 0xd6e 0xc5ea 0x91e9 0x890 0xd59 0xc854 0x91a5 0x8bc 0xd1f 0xcabe 0x9166 0x8eb 0xcf5 0xcd28 0x911f 0x92d 0xca1 0xcf92 0x90bf 0x96f 0xc97 0xd1fb 0x906c 0x9c4 0xc68 0xd465 0x903d 0xa5c 0xc6a 0xd6cf 0x9014 0xb26 0xc1c 0xd939 0x8fe8 0xc52 0xbf3 0xdba3 0x8fb6 0xe65 0xc1a 0xde0d 0x8f6d 0x1246 0xc49 0xe077 0x8ee8 0x1a0e 0xc3f 0xe2e1 0x8db3 0x31ad 0xc48 0xe54a 0x8897 0x361a 0xc4c 0xe7b4 0x799c 0x1ec1 0xc45 0xea1e 0x77e2 0x1a45 0xb9b 0xec88 0x77e2 0x1a45 0x980 0xeef2 0x77e2 0x1a45 0x38c>;
		battery2_profile_t3_col = <0x04>;
		battery2_profile_t3_num = <0x64>;
		battery2_profile_t4 = <0x00 0xac62 0xdac 0x26a 0xabcc 0xdac 0x4d4 0xab4d 0xdac 0x73e 0xaad8 0xdac 0x9a8 0xaa65 0xd9f 0xc11 0xa9f2 0xd89 0xe7b 0xa980 0xd7a 0x10e5 0xa90b 0xd76 0x134f 0xa890 0xd61 0x15b9 0xa81d 0xd61 0x1823 0xa7a2 0xd61 0x1a8d 0xa727 0xd4f 0x1cf7 0xa6a5 0xd39 0x1f60 0xa626 0xd23 0x21ca 0xa5a6 0xd16 0x2434 0xa525 0xd10 0x269e 0xa4ab 0xcfd 0x2908 0xa42f 0xcfd 0x2b72 0xa3b4 0xd13 0x2ddc 0xa338 0xd16 0x3046 0xa2bc 0xd16 0x32af 0xa241 0xd16 0x3519 0xa1c9 0xd2a 0x3783 0xa154 0xd41 0x39ed 0xa0da 0xd38 0x3c57 0xa067 0xd61 0x3ec1 0x9ff4 0xd61 0x412b 0x9f82 0xd61 0x4395 0x9f16 0xd73 0x45fe 0x9ea6 0xd97 0x4868 0x9e2f 0xdac 0x4ad2 0x9db3 0xdac 0x4d3c 0x9d3a 0xdac 0x4fa6 0x9cc7 0xda9 0x5210 0x9c54 0xd93 0x547a 0x9be2 0xd7d 0x56e4 0x9b6f 0xd54 0x594e 0x9b03 0xd38 0x5bb7 0x9a99 0xd15 0x5e21 0x9a2b 0xce8 0x608b 0x99b8 0xcc4 0x62f5 0x9945 0xca9 0x655f 0x98d4 0xc7f 0x67c9 0x9872 0xc68 0x6a33 0x9811 0xc52 0x6c9d 0x97b8 0xc3d 0x6f06 0x9766 0xc35 0x7170 0x971b 0xc35 0x73da 0x96d5 0xc35 0x7644 0x9690 0xc3b 0x78ae 0x9654 0xc51 0x7b18 0x961f 0xc67 0x7d82 0x95ea 0xc7d 0x7fec 0x95b5 0xc80 0x8255 0x9580 0xc90 0x84bf 0x9550 0xca6 0x8729 0x9524 0xcbc 0x8993 0x94f8 0xccb 0x8bfd 0x94cd 0xcd3 0x8e67 0x94aa 0xcfe 0x90d1 0x9487 0xd14 0x933b 0x9463 0xd2a 0x95a4 0x9440 0xd2f 0x980e 0x9423 0xd3e 0x9a78 0x940d 0xd5f 0x9ce2 0x93f8 0xd83 0x9f4c 0x93e2 0xd9e 0xa1b6 0x93d8 0xdcb 0xa420 0x93c6 0xdf7 0xa68a 0x93b4 0xe23 0xa8f4 0x93a3 0xe4f 0xab5d 0x9391 0xe8b 0xadc7 0x9380 0xecd 0xb031 0x936a 0xf1a 0xb29b 0x934c 0xf6b 0xb505 0x9329 0xfad 0xb76f 0x9306 0xff0 0xb9d9 0x92da 0x105e 0xbc43 0x92ae 0x10cd 0xbeac 0x927b 0x114c 0xc116 0x9240 0x11df 0xc380 0x91fe 0x127a 0xc5ea 0x91b7 0x1325 0xc854 0x9170 0x13f6 0xcabe 0x9128 0x14f1 0xcd28 0x90cf 0x1626 0xcf92 0x906f 0x1786 0xd1fb 0x9024 0x197d 0xd465 0x8fea 0x1c3d 0xd6cf 0x8fb5 0x205d 0xd939 0x8f7c 0x279d 0xdba3 0x8f36 0x333d 0xde0d 0x8ea6 0x4218 0xe077 0x8cc0 0x4e70 0xe2e1 0x7cbe 0x2678 0xe54a 0x7bde 0x2454 0xe7b4 0x7bde 0x2454 0xea1e 0x7bde 0x2454 0xec88 0x7bde 0x2454 0xeef2 0x7bde 0x2454>;
		battery2_profile_t4_col = <0x03>;
		battery2_profile_t4_num = <0x64>;
		battery3_profile_t0 = <0x00 0xab36 0x3a2 0x1fb 0xaaa6 0x39e 0x3f5 0xaa25 0x39d 0x5f0 0xa9ab 0x3aa 0x7ea 0xa935 0x3b6 0x9e5 0xa8bf 0x3b6 0xbdf 0xa848 0x3b6 0xdda 0xa7ca 0x3b6 0xfd5 0xa752 0x3b6 0x11cf 0xa6d6 0x3a7 0x13ca 0xa65c 0x3a8 0x15c4 0xa5e3 0x3af 0x17bf 0xa566 0x3a0 0x19b9 0xa4ef 0x3b5 0x1bb4 0xa478 0x3fe 0x1dae 0xa402 0x3e5 0x1fa9 0xa38b 0x3b6 0x21a4 0xa313 0x3b1 0x239e 0xa296 0x39f 0x2599 0xa228 0x3b4 0x2793 0xa1b3 0x3b6 0x298e 0xa13c 0x3a7 0x2b88 0xa0cb 0x3a8 0x2d83 0xa05d 0x3b6 0x2f7e 0x9fef 0x3b6 0x3178 0x9f81 0x3b6 0x3373 0x9f14 0x3b6 0x356d 0x9ead 0x3c7 0x3768 0x9e48 0x3cf 0x3962 0x9de4 0x3cf 0x3b5d 0x9d7f 0x3cf 0x3d58 0x9d1a 0x3d0 0x3f52 0x9cc5 0x3e5 0x414d 0x9c63 0x3e8 0x4347 0x9c08 0x3f6 0x4542 0x9bb0 0x401 0x473c 0x9b58 0x40d 0x4937 0x9b0b 0x435 0x4b31 0x9ab7 0x44a 0x4d2c 0x9a5b 0x45f 0x4f27 0x99f7 0x465 0x5121 0x9980 0x442 0x531c 0x98f5 0x403 0x5516 0x986c 0x3c7 0x5711 0x97fe 0x39d 0x590b 0x97aa 0x39d 0x5b06 0x9763 0x39d 0x5d01 0x9720 0x39d 0x5efb 0x96e0 0x39d 0x60f6 0x96a5 0x398 0x62f0 0x966a 0x384 0x64eb 0x962e 0x384 0x66e5 0x95fb 0x384 0x68e0 0x95c8 0x384 0x6adb 0x9596 0x384 0x6cd5 0x9566 0x38b 0x6ed0 0x953c 0x39a 0x70ca 0x9512 0x385 0x72c5 0x94f0 0x398 0x74bf 0x94c8 0x39d 0x76ba 0x94a2 0x3a9 0x78b5 0x9481 0x3b6 0x7aaf 0x945f 0x3b6 0x7caa 0x943d 0x3b6 0x7ea4 0x941b 0x3b6 0x809f 0x9401 0x3c8 0x8299 0x93e2 0x3dd 0x8494 0x93c0 0x3e8 0x868e 0x9399 0x3e2 0x8889 0x9363 0x3cb 0x8a84 0x930f 0x3a0 0x8c7e 0x92ca 0x39d 0x8e79 0x9299 0x3ad 0x9073 0x926f 0x3b6 0x926e 0x9241 0x3b6 0x9468 0x9210 0x3b6 0x9663 0x91e6 0x3b6 0x985e 0x91bc 0x3a1 0x9a58 0x9199 0x3ae 0x9c53 0x9171 0x3b6 0x9e4d 0x9140 0x3b6 0xa048 0x9105 0x3b6 0xa242 0x90ca 0x3b6 0xa43d 0x908f 0x3b6 0xa638 0x904d 0x3b6 0xa832 0x8ffe 0x399 0xaa2d 0x8fc3 0x38f 0xac27 0x8fa9 0x3a4 0xae22 0x8fa1 0x3bc 0xb01c 0x8f98 0x3e6 0xb217 0x8f80 0x410 0xb411 0x8f60 0x45b 0xb60c 0x8ee1 0x44d 0xb807 0x8dbe 0x412 0xba01 0x8be3 0x413 0xbbfc 0x897b 0x468 0xbdf6 0x85e3 0x4e7 0xbff1 0x7f35 0x863 0xc1eb 0x74a4 0x1469 0xc3e6 0x74a4 0x1469>;
		battery3_profile_t0_col = <0x03>;
		battery3_profile_t0_num = <0x64>;
		battery3_profile_t1 = <0x00 0xab7c 0x65e 0x1fb 0xaaf5 0x65a 0x3f5 0xaa7c 0x659 0x5f0 0xaa05 0x659 0x7ea 0xa98f 0x659 0x9e5 0xa919 0x653 0xbdf 0xa8a3 0x640 0xdda 0xa82d 0x640 0xfd5 0xa7b6 0x640 0x11cf 0xa73a 0x622 0x13ca 0xa6c0 0x60e 0x15c4 0xa647 0x607 0x17bf 0xa5ca 0x5f5 0x19b9 0xa553 0x5f5 0x1bb4 0xa4dc 0x674 0x1dae 0xa460 0x63a 0x1fa9 0xa3e9 0x5dc 0x21a4 0xa379 0x5dc 0x239e 0xa303 0x5dc 0x2599 0xa28d 0x5dc 0x2793 0xa217 0x5dc 0x298e 0xa1a6 0x5dc 0x2b88 0xa134 0x5dc 0x2d83 0xa0c1 0x5dc 0x2f7e 0xa053 0x5dc 0x3178 0x9fe5 0x5dc 0x3373 0x9f78 0x5dc 0x356d 0x9f11 0x5ed 0x3768 0x9eac 0x5f5 0x3962 0x9e48 0x5fd 0x3b5d 0x9de3 0x612 0x3d58 0x9d7d 0x627 0x3f52 0x9d18 0x627 0x414d 0x9cb3 0x627 0x4347 0x9c53 0x635 0x4542 0x9bfa 0x64a 0x473c 0x9ba6 0x65f 0x4937 0x9b50 0x672 0x4b31 0x9af3 0x672 0x4d2c 0x9a97 0x685 0x4f27 0x9a2d 0x67b 0x5121 0x99b6 0x64f 0x531c 0x9934 0x600 0x5516 0x98b0 0x59e 0x5711 0x983a 0x55f 0x590b 0x97dd 0x535 0x5b06 0x978e 0x52d 0x5d01 0x9748 0x52d 0x5efb 0x9704 0x524 0x60f6 0x96c3 0x514 0x62f0 0x9688 0x514 0x64eb 0x9656 0x514 0x66e5 0x9623 0x527 0x68e0 0x95f0 0x51e 0x6adb 0x95be 0x514 0x6cd5 0x958e 0x51b 0x6ed0 0x9564 0x52d 0x70ca 0x953a 0x52d 0x72c5 0x9510 0x52d 0x74bf 0x94ec 0x53d 0x76ba 0x94ca 0x546 0x78b5 0x94a9 0x54e 0x7aaf 0x9487 0x55f 0x7caa 0x9465 0x55f 0x7ea4 0x9443 0x55f 0x809f 0x9429 0x571 0x8299 0x940a 0x578 0x8494 0x93ec 0x578 0x868e 0x93d0 0x578 0x8889 0x93ae 0x576 0x8a84 0x9383 0x561 0x8c7e 0x9361 0x55f 0x8e79 0x9339 0x54f 0x9073 0x930f 0x53a 0x926e 0x92e5 0x52d 0x9468 0x92ba 0x52d 0x9663 0x9290 0x52d 0x985e 0x9266 0x52d 0x9a58 0x9243 0x52d 0x9c53 0x9221 0x53a 0x9e4d 0x91f7 0x54f 0xa048 0x91c3 0x55f 0xa242 0x9188 0x561 0xa43d 0x914d 0x575 0xa638 0x9112 0x58a 0xa832 0x90cc 0x591 0xaa2d 0x9080 0x59c 0xac27 0x9044 0x5b1 0xae22 0x902c 0x5c9 0xb01c 0x901b 0x5f3 0xb217 0x900a 0x631 0xb411 0x8ff3 0x681 0xb60c 0x8fc1 0x6ee 0xb807 0x8f30 0x742 0xba01 0x8df5 0x765 0xbbfc 0x8bed 0x7be 0xbdf6 0x891f 0x8bb 0xbff1 0x84ca 0xa7c 0xc1eb 0x7cab 0x1cb3 0xc3e6 0x7814 0x1c07>;
		battery3_profile_t1_col = <0x03>;
		battery3_profile_t1_num = <0x64>;
		battery3_profile_t2 = <0x00 0xabcc 0xec4 0x728 0x1fb 0xab2c 0xec0 0x728 0x3f5 0xaaa0 0xebf 0x71e 0x5f0 0xaa1e 0xeb2 0x738 0x7ea 0xa99f 0xe8a 0x710 0x9e5 0xa923 0xe50 0x704 0xbdf 0xa8ac 0xe24 0x743 0xdda 0xa82e 0xde5 0x743 0xfd5 0xa7b6 0xdcb 0x69c 0x11cf 0xa73a 0xd98 0x6fd 0x13ca 0xa6c0 0xd64 0x6eb 0x15c4 0xa647 0xd3a 0x66d 0x17bf 0xa5ca 0xd0f 0x68a 0x19b9 0xa553 0xce5 0x68a 0x1bb4 0xa4dc 0xdf3 0x69d 0x1dae 0xa466 0xd6c 0x636 0x1fa9 0xa3ef 0xc86 0x614 0x21a4 0xa37b 0xc62 0x680 0x239e 0xa30d 0xc4c 0x676 0x2599 0xa297 0xc37 0x684 0x2793 0xa221 0xc0f 0x6e5 0x298e 0xa1b0 0xc03 0x663 0x2b88 0xa13e 0xbed 0x65a 0x2d83 0xa0cb 0xbca 0x656 0x2f7e 0xa05e 0xbbb 0x63b 0x3178 0x9ff9 0xbd0 0x631 0x3373 0x9f8c 0xbbd 0x629 0x356d 0x9f25 0xbc9 0x62f 0x3768 0x9ec0 0xbdd 0x625 0x3962 0x9e59 0xbea 0x62e 0x3b5d 0x9deb 0xbe6 0x610 0x3d58 0x9d7d 0xbd1 0x62f 0x3f52 0x9d18 0xbd1 0x61d 0x414d 0x9cac 0xbad 0x636 0x4347 0x9c49 0xb9f 0x653 0x4542 0x9be8 0xb95 0x643 0x473c 0x9b85 0xb80 0x645 0x4937 0x9b28 0xb6b 0x635 0x4b31 0x9acb 0xb56 0x64b 0x4d2c 0x9a67 0xb41 0x634 0x4f27 0x99fb 0xb1c 0x65f 0x5121 0x9989 0xada 0x676 0x531c 0x9916 0xa8e 0x68e 0x5516 0x98a8 0xa4e 0x69e 0x5711 0x983a 0xa0f 0x6be 0x590b 0x97e6 0x9fa 0x6d7 0x5b06 0x9791 0x9e5 0x6cf 0x5d01 0x9742 0x9d0 0x6f6 0x5efb 0x96fa 0x9bb 0x710 0x60f6 0x96b9 0x9ab 0x6ec 0x62f0 0x967e 0x9ab 0x6fc 0x64eb 0x9642 0x9ab 0x71b 0x66e5 0x960f 0x9be 0x723 0x68e0 0x95dc 0x9d3 0x71e 0x6adb 0x95aa 0x9dd 0x71e 0x6cd5 0x957a 0x9e4 0x723 0x6ed0 0x9550 0x9f6 0x71e 0x70ca 0x9526 0x9f6 0x72c 0x72c5 0x94fc 0xa0a 0x72f 0x74bf 0x94d2 0xa0f 0x72d 0x76ba 0x94ac 0xa1b 0x739 0x78b5 0x948b 0xa30 0x726 0x7aaf 0x9469 0xa41 0x73a 0x7caa 0x9447 0xa42 0x73e 0x7ea4 0x9425 0xa57 0x73b 0x809f 0x940b 0xa6c 0x725 0x8299 0x93f1 0xa81 0x73e 0x8494 0x93d8 0xa8c 0x744 0x868e 0x93bf 0xa92 0x748 0x8889 0x93a6 0xaa7 0x745 0x8a84 0x9395 0xabc 0x73b 0x8c7e 0x937d 0xad1 0x733 0x8e79 0x9363 0xae7 0x749 0x9073 0x934a 0xb13 0x756 0x926e 0x932e 0xb43 0x73e 0x9468 0x930c 0xb5c 0x744 0x9663 0x92ea 0xb86 0x72f 0x985e 0x92c0 0xb86 0x73c 0x9a58 0x929d 0xbba 0x732 0x9c53 0x9275 0xc21 0x70c 0x9e4d 0x9247 0xc83 0x718 0xa048 0x9213 0xcc8 0x707 0xa242 0x91d8 0xd1e 0x6e4 0xa43d 0x919d 0xd86 0x6e8 0xa638 0x915b 0xe01 0x6dc 0xa832 0x9112 0xe80 0x6d3 0xaa2d 0x90c6 0xeff 0x6bc 0xac27 0x907f 0xf91 0x698 0xae22 0x9046 0x1055 0x6a6 0xb01c 0x901c 0x113d 0x69a 0xb217 0x8ffa 0x128a 0x69d 0xb411 0x8fd2 0x141c 0x682 0xb60c 0x8f94 0x160c 0x64f 0xb807 0x8f23 0x1849 0x604 0xba01 0x8e5a 0x1ac4 0x5d4 0xbbfc 0x8d13 0x1d9b 0x637 0xbdf6 0x8aee 0x21d0 0x670 0xbff1 0x87c9 0x28cc 0x6bb 0xc1eb 0x832a 0x3219 0x6d1 0xc3e6 0x79c2 0x1fbd 0x65a>;
		battery3_profile_t2_col = <0x04>;
		battery3_profile_t2_num = <0x64>;
		battery3_profile_t3 = <0x00 0xabcc 0x1b76 0x728 0x1fb 0xab0a 0x1b72 0x16d6 0x3f5 0xaa6a 0x1b71 0x16d6 0x5f0 0xa9d2 0x1b56 0x16e9 0x7ea 0xa942 0x1b2c 0x16fd 0x9e5 0xa8b8 0x1afc 0x1723 0xbdf 0xa82a 0x1abf 0x1723 0xdda 0xa7ac 0x1a95 0x174a 0xfd5 0xa725 0x1a57 0x1770 0x11cf 0xa6a4 0x1a18 0x15cf 0x13ca 0xa621 0x19ce 0x145f 0x15c4 0xa59d 0x1980 0x132b 0x17bf 0xa51e 0x1941 0x1226 0x19b9 0xa4a0 0x1902 0x1154 0x1bb4 0xa421 0x1ab2 0x1074 0x1dae 0xa3a8 0x19ca 0xfaa 0x1fa9 0xa331 0x1857 0xf4e 0x21a4 0xa2bb 0x182d 0xeea 0x239e 0xa245 0x1801 0xec4 0x2599 0xa1cf 0x17c2 0xe7d 0x2793 0xa160 0x1795 0xe68 0x298e 0xa0ec 0x176b 0xe4b 0x2b88 0xa07f 0x174c 0xe2a 0x2d83 0xa017 0x1737 0xdfa 0x2f7e 0x9faa 0x1722 0xdd8 0x3178 0x9f45 0x170d 0xde4 0x3373 0x9ed8 0x16f8 0xdb6 0x356d 0x9e6a 0x16d2 0xdaa 0x3768 0x9df8 0x168f 0xda6 0x3962 0x9d83 0x1655 0xd97 0x3b5d 0x9d0f 0x1637 0xd94 0x3d58 0x9ca1 0x15f9 0xd8c 0x3f52 0x9c3c 0x15f9 0xd87 0x414d 0x9bd7 0x15d5 0xd75 0x4347 0x9b71 0x1582 0xd49 0x4542 0x9b10 0x1554 0xd4f 0x473c 0x9ab1 0x1551 0xd48 0x4937 0x9a4c 0x151a 0xd55 0x4b31 0x99ef 0x152f 0xd4f 0x4d2c 0x9983 0x14bc 0xd62 0x4f27 0x991b 0x147c 0xd7d 0x5121 0x98b6 0x1446 0xd94 0x531c 0x9854 0x1416 0xdcc 0x5516 0x97f9 0x13fd 0xdf8 0x5711 0x97a4 0x13d3 0xe10 0x590b 0x9750 0x13be 0xe12 0x5b06 0x9702 0x13a9 0xe47 0x5d01 0x96bc 0x13a1 0xe5b 0x5efb 0x967c 0x13aa 0xe66 0x60f6 0x9641 0x13ba 0xe5a 0x62f0 0x9606 0x13ba 0xe71 0x64eb 0x95ca 0x13ba 0xe69 0x66e5 0x9597 0x13cd 0xe6f 0x68e0 0x956a 0x13e2 0xe74 0x6adb 0x953c 0x13f7 0xe47 0x6cd5 0x950c 0x1405 0xe56 0x6ed0 0x94e3 0x140d 0xe36 0x70ca 0x94c2 0x144d 0xe2f 0x72c5 0x9498 0x1450 0xe2a 0x74bf 0x9474 0x1460 0xe1f 0x76ba 0x9457 0x148e 0xe30 0x78b5 0x943e 0x14bc 0xe27 0x7aaf 0x9425 0x14d6 0xe1c 0x7caa 0x940c 0x1501 0xe26 0x7ea4 0x93fb 0x1556 0xe07 0x809f 0x93ea 0x1598 0xe04 0x8299 0x93d9 0x15e6 0xdf6 0x8494 0x93c4 0x163a 0xdf3 0x868e 0x93ad 0x1695 0xded 0x8889 0x939c 0x16fe 0xde7 0x8a84 0x938b 0x1768 0xde1 0x8c7e 0x9373 0x17e5 0xdf3 0x8e79 0x9359 0x1854 0xde5 0x9073 0x9340 0x18d4 0xdef 0x926e 0x9324 0x1960 0xdf6 0x9468 0x9300 0x19e3 0xe01 0x9663 0x92d6 0x1a77 0xe00 0x985e 0x92b4 0x1b35 0xe13 0x9a58 0x9285 0x1bbf 0xe0a 0x9c53 0x9252 0x1c80 0xe03 0x9e4d 0x921c 0x1d5f 0xde0 0xa048 0x91e1 0x1e3d 0xdcf 0xa242 0x91a5 0x1f3b 0xdac 0xa43d 0x9163 0x2049 0xd79 0xa638 0x9118 0x216e 0xd1d 0xa832 0x90d7 0x22ec 0xc10 0xaa2d 0x9098 0x2492 0xb03 0xac27 0x905a 0x265a 0xb37 0xae22 0x9027 0x2875 0xa05 0xb01c 0x8ff5 0x2ad9 0x8f5 0xb217 0x8fc2 0x2d65 0x862 0xb411 0x8f89 0x3004 0x78c 0xb60c 0x8f3a 0x3282 0x750 0xb807 0x8eb8 0x34c5 0x725 0xba01 0x8ddf 0x36eb 0x67d 0xbbfc 0x8c86 0x3977 0x5ec 0xbdf6 0x8a37 0x3ea9 0x5cd 0xbff1 0x86d3 0x3fb8 0x622 0xc1eb 0x81a6 0x32e6 0x6f2 0xc3e6 0x81a6 0x32e1 0x8ac>;
		battery3_profile_t3_col = <0x04>;
		battery3_profile_t3_num = <0x64>;
		battery3_profile_t4 = <0x00 0xabf4 0x30a2 0x1fb 0xab21 0x30a2 0x3f5 0xaa63 0x30e7 0x5f0 0xa9ae 0x30d1 0x7ea 0xa901 0x3057 0x9e5 0xa85a 0x2fae 0xbdf 0xa7bb 0x2f08 0xdda 0xa72b 0x2e8a 0xfd5 0xa694 0x2dd2 0x11cf 0xa608 0x2d32 0x13ca 0xa581 0x2c9f 0x15c4 0xa4fa 0x2c04 0x17bf 0xa476 0x2b65 0x19b9 0xa3ff 0x2afb 0x1bb4 0xa381 0x2cce 0x1dae 0xa308 0x2b7c 0x1fa9 0xa291 0x297b 0x21a4 0xa21d 0x2907 0x239e 0xa1af 0x28ae 0x2599 0xa139 0x281a 0x2793 0xa0d2 0x27d2 0x298e 0xa066 0x2774 0x2b88 0x9ffd 0x2721 0x2d83 0x9f95 0x26da 0x2f7e 0x9f26 0x2689 0x3178 0x9eb0 0x264a 0x3373 0x9e31 0x25cd 0x356d 0x9db3 0x255f 0x3768 0x9d35 0x24de 0x3962 0x9cbb 0x246d 0x3b5d 0x9c47 0x2425 0x3d58 0x9bd9 0x23be 0x3f52 0x9b74 0x23be 0x414d 0x9b0f 0x230c 0x4347 0x9aaf 0x22e0 0x4542 0x9a56 0x2300 0x473c 0x99ff 0x22fd 0x4937 0x99a2 0x22bd 0x4b31 0x9945 0x227e 0x4d2c 0x98e9 0x228c 0x4f27 0x9892 0x2244 0x5121 0x983d 0x21e6 0x531c 0x97ec 0x21a2 0x5516 0x97a0 0x218b 0x5711 0x9754 0x21ca 0x590b 0x9708 0x21b5 0x5b06 0x96c3 0x21a0 0x5d01 0x9680 0x218b 0x5efb 0x9643 0x2192 0x60f6 0x960f 0x21b1 0x62f0 0x95d4 0x21b3 0x64eb 0x95a2 0x21c8 0x66e5 0x956f 0x21ca 0x68e0 0x9542 0x21e8 0x6adb 0x9518 0x2207 0x6cd5 0x94ee 0x221c 0x6ed0 0x94c5 0x2231 0x70ca 0x94a4 0x2246 0x72c5 0x948a 0x2283 0x74bf 0x9471 0x22c2 0x76ba 0x9457 0x2302 0x78b5 0x9441 0x2349 0x7aaf 0x942f 0x239e 0x7caa 0x9415 0x23f3 0x7ea4 0x93fc 0x245c 0x809f 0x93ea 0x24c6 0x8299 0x93d9 0x253d 0x8494 0x93c4 0x25c6 0x868e 0x93ad 0x264e 0x8889 0x939b 0x26c2 0x8a84 0x9382 0x2795 0x8c7e 0x9369 0x281b 0x8e79 0x934f 0x28c8 0x9073 0x9331 0x294c 0x926e 0x9310 0x29ce 0x9468 0x92ef 0x2a9e 0x9663 0x92d6 0x2b5c 0x985e 0x92ac 0x2c1a 0x9a58 0x9282 0x2cd8 0x9c53 0x9257 0x2da3 0x9e4d 0x9229 0x2e6c 0xa048 0x91f5 0x2f30 0xa242 0x91ba 0x3004 0xa43d 0x917f 0x30e9 0xa638 0x9144 0x31e3 0xa832 0x90fe 0x32c3 0xaa2d 0x90ba 0x33b6 0xac27 0x907f 0x34c8 0xae22 0x9046 0x35e6 0xb01c 0x901c 0x374d 0xb217 0x8ffa 0x38f0 0xb411 0x8fd2 0x3ae7 0xb60c 0x8f9e 0x3d71 0xb807 0x8f45 0x40d9 0xba01 0x8e93 0x4574 0xbbfc 0x8d3c 0x4b72 0xbdf6 0x8b12 0x4a6d 0xbff1 0x87d9 0x4246 0xc1eb 0x87d2 0x421d 0xc3e6 0x87d2 0x421d>;
		battery3_profile_t4_col = <0x03>;
		battery3_profile_t4_num = <0x64>;
		compatible = "mediatek,bat_gm30";
		g_FG_PSEUDO100_T0 = <0x64>;
		g_FG_PSEUDO100_T1 = <0x64>;
		g_FG_PSEUDO100_T2 = <0x64>;
		g_FG_PSEUDO100_T3 = <0x64>;
		g_FG_PSEUDO100_T4 = <0x64>;
		linux,phandle = <0x87>;
		phandle = <0x87>;
	};

	bpi_bsi_slv0@1021e000 {
		compatible = "mediatek,bpi_bsi_slv0";
		reg = <0x00 0x1021e000 0x00 0x1000>;
	};

	bpi_bsi_slv1@1021f000 {
		compatible = "mediatek,bpi_bsi_slv1";
		reg = <0x00 0x1021f000 0x00 0x6000>;
	};

	bpi_bsi_slv2@10225000 {
		compatible = "mediatek,bpi_bsi_slv2";
		reg = <0x00 0x10225000 0x00 0x1000>;
	};

	btif@1100c000 {
		clock-names = "btifc\0apdmac";
		clocks = <0x26 0x1a 0x26 0x26>;
		compatible = "mediatek,btif";
		interrupts = <0x00 0x70 0x08 0x00 0x84 0x08 0x00 0x85 0x08>;
		reg = <0x00 0x1100c000 0x00 0x1000 0x00 0x11000880 0x00 0x80 0x00 0x11000900 0x00 0x80>;
	};

	bus_dbg@10208000 {
		compatible = "mediatek,bus_dbg-v2";
		interrupts = <0x00 0x8d 0x08>;
		mediatek,bus_dbg_con_offset = <0x2fc>;
		reg = <0x00 0x10208000 0x00 0x1000 0x00 0x10001000 0x00 0x1000>;
	};

	cam1@1a003000 {
		compatible = "mediatek,cam1";
		interrupts = <0x00 0xeb 0x08>;
		reg = <0x00 0x1a003000 0x00 0x1000>;
	};

	cam2@1a004000 {
		compatible = "mediatek,cam2";
		interrupts = <0x00 0xec 0x08>;
		reg = <0x00 0x1a004000 0x00 0x1000>;
	};

	cam3@1a005000 {
		compatible = "mediatek,cam3";
		interrupts = <0x00 0xed 0x08>;
		reg = <0x00 0x1a005000 0x00 0x1000>;
	};

	cam_clear@1a01b000 {
		compatible = "mediatek,cam_clear";
		reg = <0x00 0x1a01b000 0x00 0x1000>;
	};

	cam_inner@1a013000 {
		compatible = "mediatek,cam_inner";
		reg = <0x00 0x1a013000 0x00 0x1000>;
	};

	cam_set@1a00b000 {
		compatible = "mediatek,cam_set";
		reg = <0x00 0x1a00b000 0x00 0x1000>;
	};

	cama_clear@1a01c000 {
		compatible = "mediatek,cama_clear";
		reg = <0x00 0x1a01c000 0x00 0x1000>;
	};

	cama_ext@1a024000 {
		compatible = "mediatek,cama_ext";
		reg = <0x00 0x1a024000 0x00 0x1000>;
	};

	cama_inner@1a014000 {
		compatible = "mediatek,cama_inner";
		reg = <0x00 0x1a014000 0x00 0x1000>;
	};

	cama_set@1a00c000 {
		compatible = "mediatek,cama_set";
		reg = <0x00 0x1a00c000 0x00 0x1000>;
	};

	camb_clear@1a01d000 {
		compatible = "mediatek,camb_clear";
		reg = <0x00 0x1a01d000 0x00 0x1000>;
	};

	camb_ext@1a025000 {
		compatible = "mediatek,camb_ext";
		reg = <0x00 0x1a025000 0x00 0x1000>;
	};

	camb_inner@1a015000 {
		compatible = "mediatek,camb_inner";
		reg = <0x00 0x1a015000 0x00 0x1000>;
	};

	camb_set@1a00d000 {
		compatible = "mediatek,camb_set";
		reg = <0x00 0x1a00d000 0x00 0x1000>;
	};

	camsv1@1a050000 {
		compatible = "mediatek,camsv1";
		interrupts = <0x00 0xf3 0x08>;
		reg = <0x00 0x1a050000 0x00 0x1000>;
	};

	camsv2@1a051000 {
		compatible = "mediatek,camsv2";
		interrupts = <0x00 0xf4 0x08>;
		reg = <0x00 0x1a051000 0x00 0x1000>;
	};

	camsv3@1a052000 {
		compatible = "mediatek,camsv3";
		interrupts = <0x00 0xf1 0x08>;
		reg = <0x00 0x1a052000 0x00 0x1000>;
	};

	camsv4@1a053000 {
		compatible = "mediatek,camsv4";
		interrupts = <0x00 0xf2 0x08>;
		reg = <0x00 0x1a053000 0x00 0x1000>;
	};

	camsys@1a000000 {
		#clock-cells = <0x01>;
		compatible = "mediatek,camsys\0syscon";
		linux,phandle = <0x4d>;
		phandle = <0x4d>;
		pwr-regmap = <0x44>;
		reg = <0x00 0x1a000000 0x00 0x1000>;
	};

	ccu@1a0b0000 {
		clock-names = "CCU_CLK_CAM_CCU";
		clocks = <0x4d 0x08>;
		compatible = "mediatek,ccu";
		interrupts = <0x00 0xf6 0x08>;
		reg = <0x00 0x1a0b1000 0x00 0x1000>;
	};

	charger {
		ac_charger_current = <0x1f47d0>;
		ac_charger_input_current = <0x30d400>;
		algorithm_name = "SwitchCharging";
		apple_1_0a_charger_current = <0x9eb10>;
		apple_2_1a_charger_current = "\0\f5";
		battery_cv = <0x426030>;
		bif_cv_under_threshold2 = <0x43e6d0>;
		bif_threshold1 = <0x40d990>;
		bif_threshold2 = <0x419ce0>;
		cable_imp_threshold = <0x2bb>;
		charging_host_charger_current = <0x16e360>;
		chg1_ta_ac_charger_current = <0x16e360>;
		chg2_ta_ac_charger_current = <0x16e360>;
		compatible = "mediatek,charger";
		disable_pd_dual;
		dual_polling_ieoc = <0x6ddd0>;
		enable_dynamic_mivr;
		enable_min_charge_temp;
		enable_pe_2;
		enable_pe_3;
		enable_pe_4;
		enable_pe_plus;
		enable_type_c;
		high_temp_to_enter_pe40 = <0x27>;
		high_temp_to_leave_pe40 = <0x2e>;
		ibus_err = <0x0e>;
		jeita_temp_above_t4_cv = <0x40b280>;
		jeita_temp_below_t0_cv = <0x3da540>;
		jeita_temp_t0_to_t1_cv = <0x3da540>;
		jeita_temp_t1_to_t2_cv = <0x40b280>;
		jeita_temp_t2_to_t3_cv = <0x423920>;
		jeita_temp_t3_to_t4_cv = <0x40b280>;
		linux,phandle = <0xad>;
		low_temp_to_enter_pe40 = <0x10>;
		low_temp_to_leave_pe40 = <0x0a>;
		max_charge_temp = <0x32>;
		max_charge_temp_minus_x_degree = <0x2f>;
		max_charger_voltage = <0x632ea0>;
		max_dmivr_charger_current = <0x155cc0>;
		min_charge_temp = <0x00>;
		min_charge_temp_plus_x_degree = <0x06>;
		min_charger_voltage = <0x4630c0>;
		min_charger_voltage_1 = <0x432380>;
		min_charger_voltage_2 = <0x401640>;
		non_std_ac_charger_current = <0x7a120>;
		pd_ichg_level_threshold = <0xf4240>;
		pd_stop_battery_soc = <0x50>;
		pd_vbus_low_bound = <0x4c4b40>;
		pd_vbus_upper_bound = <0x4c4b40>;
		pe20_ichg_level_threshold = <0xf4240>;
		pe40_dual_charger_chg1_current = <0x1e8480>;
		pe40_dual_charger_chg2_current = <0x1e8480>;
		pe40_dual_charger_input_current = <0x2dc6c0>;
		pe40_r_cable_1a_lower = <0x229>;
		pe40_r_cable_2a_lower = <0x19f>;
		pe40_r_cable_3a_lower = <0x113>;
		pe40_single_charger_current = <0x2dc6c0>;
		pe40_single_charger_input_current = <0x2dc6c0>;
		pe40_stop_battery_soc = <0x50>;
		pe_ichg_level_threshold = <0xf4240>;
		phandle = <0xad>;
		power_path_support;
		slave_mivr_diff = <0x186a0>;
		ta_12v_support;
		ta_9v_support;
		ta_ac_12v_input_current = <0x30d400>;
		ta_ac_7v_input_current = <0x30d400>;
		ta_ac_9v_input_current = <0x30d400>;
		ta_ac_charger_current = <0x2dc6c0>;
		ta_start_battery_soc = <0x00>;
		ta_stop_battery_soc = <0x55>;
		temp_neg_10_thres = <0x00>;
		temp_t0_thres = <0x00>;
		temp_t0_thres_plus_x_degree = <0x00>;
		temp_t1_thres = <0x00>;
		temp_t1_thres_plus_x_degree = <0x06>;
		temp_t2_thres = <0x0a>;
		temp_t2_thres_plus_x_degree = <0x10>;
		temp_t3_thres = <0x2d>;
		temp_t3_thres_minus_x_degree = <0x27>;
		temp_t4_thres = <0x32>;
		temp_t4_thres_minus_x_degree = <0x2f>;
		usb_charger_current = <0x7a120>;
		usb_charger_current_configured = <0x7a120>;
		usb_charger_current_suspend = <0x00>;
		usb_charger_current_unconfigured = <0x11170>;
		vbat_cable_imp_threshold = <0x3b8260>;
		vsys_watt = <0x4c4b40>;
	};

	chipid@08000000 {
		compatible = "mediatek,chipid";
		reg = <0x00 0x8000000 0x00 0x04 0x00 0x8000004 0x00 0x04 0x00 0x8000008 0x00 0x04 0x00 0x800000c 0x00 0x04>;
	};

	chosen {
		bootargs = "console=tty0 console=ttyS0,921600n1 vmalloc=400M slub_debug=OFZPU page_owner=on swiotlb=noforce androidboot.hardware=mt6765 maxcpus=8 loop.max_part=7 firmware_class.path=/vendor/firmware";
		kaslr-seed = <0x00 0x00>;
		linux,phandle = <0x57>;
		phandle = <0x57>;
	};

	clocks {

		clk26m {
			#clock-cells = <0x00>;
			clock-frequency = <0x18cba80>;
			compatible = "fixed-clock";
			linux,phandle = <0x1f>;
			phandle = <0x1f>;
		};

		clk32k {
			#clock-cells = <0x00>;
			clock-frequency = <0x7d00>;
			compatible = "fixed-clock";
			linux,phandle = <0x1d>;
			phandle = <0x1d>;
		};
	};

	consys@18002000 {
		#address-cells = <0x02>;
		#size-cells = <0x02>;
		clock-names = "conn";
		clocks = <0x27 0x01>;
		compatible = "mediatek,mt6765-consys";
		interrupts = <0x00 0x10b 0x08 0x00 0x10d 0x08 0x00 0x10e 0x01>;
		linux,phandle = <0x1b>;
		phandle = <0x1b>;
		reg = <0x00 0x18002000 0x00 0x1000 0x00 0x10007000 0x00 0x100 0x00 0x10001000 0x00 0x1000 0x00 0x10006000 0x00 0x1000 0x00 0x18007000 0x00 0x1000 0x00 0x180b1000 0x00 0x1000 0x00 0x180a3000 0x00 0x1000 0x00 0x180a5000 0x00 0x800 0x00 0x180c1000 0x00 0x1000 0x00 0x18004000 0x00 0x1000 0x00 0x00 0x00 0x00 0x00 0x00 0x00 0x00 0x00 0x1020e000 0x00 0x1000>;
	};

	cpu_dbgapb@0d410000 {
		compatible = "mediatek,hw_dbg";
		linux,phandle = <0x59>;
		num = <0x08>;
		phandle = <0x59>;
		reg = <0x00 0xd410000 0x00 0x1000 0x00 0xd510000 0x00 0x1000 0x00 0xd610000 0x00 0x1000 0x00 0xd710000 0x00 0x1000 0x00 0xd810000 0x00 0x1000 0x00 0xd910000 0x00 0x1000 0x00 0xda10000 0x00 0x1000 0x00 0xdb10000 0x00 0x1000>;
	};

	cpus {
		#address-cells = <0x01>;
		#size-cells = <0x00>;

		cpu-map {

			cluster0 {

				core0 {
					cpu = <0x09>;
				};

				core1 {
					cpu = <0x0a>;
				};

				core2 {
					cpu = <0x0b>;
				};

				core3 {
					cpu = <0x0c>;
				};
			};

			cluster1 {

				core0 {
					cpu = <0x0d>;
				};

				core1 {
					cpu = <0x0e>;
				};

				core2 {
					cpu = <0x0f>;
				};

				core3 {
					cpu = <0x10>;
				};
			};
		};

		cpu@000 {
			clock-frequency = <0x89267940>;
			compatible = "arm,cortex-a53";
			cpu-idle-states = <0x02 0x03 0x04 0x05 0x06 0x07 0x08>;
			device_type = "cpu";
			enable-method = "psci";
			linux,phandle = <0x09>;
			phandle = <0x09>;
			reg = <0x00>;
		};

		cpu@001 {
			clock-frequency = <0x89267940>;
			compatible = "arm,cortex-a53";
			cpu-idle-states = <0x02 0x03 0x04 0x05 0x06 0x07 0x08>;
			device_type = "cpu";
			enable-method = "psci";
			linux,phandle = <0x0a>;
			phandle = <0x0a>;
			reg = <0x01>;
		};

		cpu@002 {
			clock-frequency = <0x89267940>;
			compatible = "arm,cortex-a53";
			cpu-idle-states = <0x02 0x03 0x04 0x05 0x06 0x07 0x08>;
			device_type = "cpu";
			enable-method = "psci";
			linux,phandle = <0x0b>;
			phandle = <0x0b>;
			reg = <0x02>;
		};

		cpu@003 {
			clock-frequency = <0x89267940>;
			compatible = "arm,cortex-a53";
			cpu-idle-states = <0x02 0x03 0x04 0x05 0x06 0x07 0x08>;
			device_type = "cpu";
			enable-method = "psci";
			linux,phandle = <0x0c>;
			phandle = <0x0c>;
			reg = <0x03>;
		};

		cpu@100 {
			clock-frequency = <0x6b49d200>;
			compatible = "arm,cortex-a53";
			cpu-idle-states = <0x02 0x03 0x04 0x05 0x06 0x07 0x08>;
			device_type = "cpu";
			enable-method = "psci";
			linux,phandle = <0x0d>;
			phandle = <0x0d>;
			reg = <0x100>;
		};

		cpu@101 {
			clock-frequency = <0x6b49d200>;
			compatible = "arm,cortex-a53";
			cpu-idle-states = <0x02 0x03 0x04 0x05 0x06 0x07 0x08>;
			device_type = "cpu";
			enable-method = "psci";
			linux,phandle = <0x0e>;
			phandle = <0x0e>;
			reg = <0x101>;
		};

		cpu@102 {
			clock-frequency = <0x6b49d200>;
			compatible = "arm,cortex-a53";
			cpu-idle-states = <0x02 0x03 0x04 0x05 0x06 0x07 0x08>;
			device_type = "cpu";
			enable-method = "psci";
			linux,phandle = <0x0f>;
			phandle = <0x0f>;
			reg = <0x102>;
		};

		cpu@103 {
			clock-frequency = <0x6b49d200>;
			compatible = "arm,cortex-a53";
			cpu-idle-states = <0x02 0x03 0x04 0x05 0x06 0x07 0x08>;
			device_type = "cpu";
			enable-method = "psci";
			linux,phandle = <0x10>;
			phandle = <0x10>;
			reg = <0x103>;
		};

		idle-states {
			entry-method = "arm,psci";

			dpidle {
				arm,psci-suspend-param = <0x1010004>;
				compatible = "arm,idle-state";
				entry-latency-us = <0x320>;
				exit-latency-us = <0x3e8>;
				linux,phandle = <0x07>;
				min-residency-us = <0x7d0>;
				phandle = <0x07>;
			};

			mcdi-cluster {
				arm,psci-suspend-param = <0x1010001>;
				compatible = "arm,idle-state";
				entry-latency-us = <0x258>;
				exit-latency-us = <0x258>;
				linux,phandle = <0x04>;
				min-residency-us = <0x4b0>;
				phandle = <0x04>;
			};

			mcdi-cpu {
				arm,psci-suspend-param = <0x10001>;
				compatible = "arm,idle-state";
				entry-latency-us = <0x258>;
				exit-latency-us = <0x258>;
				linux,phandle = <0x03>;
				min-residency-us = <0x4b0>;
				phandle = <0x03>;
			};

			sodi {
				arm,psci-suspend-param = <0x1010002>;
				compatible = "arm,idle-state";
				entry-latency-us = <0x320>;
				exit-latency-us = <0x3e8>;
				linux,phandle = <0x05>;
				min-residency-us = <0x7d0>;
				phandle = <0x05>;
			};

			sodi3 {
				arm,psci-suspend-param = <0x1010003>;
				compatible = "arm,idle-state";
				entry-latency-us = <0x320>;
				exit-latency-us = <0x3e8>;
				linux,phandle = <0x06>;
				min-residency-us = <0x7d0>;
				phandle = <0x06>;
			};

			standby {
				arm,psci-suspend-param = <0x01>;
				compatible = "arm,idle-state";
				entry-latency-us = <0x258>;
				exit-latency-us = <0x258>;
				linux,phandle = <0x02>;
				min-residency-us = <0x4b0>;
				phandle = <0x02>;
			};

			suspend {
				arm,psci-suspend-param = <0x1010005>;
				compatible = "arm,idle-state";
				entry-latency-us = <0x320>;
				exit-latency-us = <0x3e8>;
				linux,phandle = <0x08>;
				min-residency-us = <0x7d0>;
				phandle = <0x08>;
			};
		};
	};

	cq_dma@10212000 {
		clock-names = "cqdma";
		clocks = <0x26 0x43>;
		compatible = "mediatek,mt-cqdma-v1";
		interrupts = <0x00 0x71 0x08 0x00 0x72 0x08>;
		keep_clock_ao = "yes";
		nr_channel = <0x02>;
		reg = <0x00 0x10212000 0x00 0x80 0x00 0x10212080 0x00 0x80>;
	};

	dbg_apmcu_mp0@0d400000 {
		compatible = "mediatek,dbg_apmcu_mp0";
		reg = <0x00 0xd400000 0x00 0x1000>;
	};

	dbg_apmcu_mp0@0d410000 {
		compatible = "mediatek,dbg_apmcu_mp0";
		reg = <0x00 0xd410000 0x00 0x1000>;
	};

	dbg_apmcu_mp0@0d420000 {
		compatible = "mediatek,dbg_apmcu_mp0";
		reg = <0x00 0xd420000 0x00 0x1000>;
	};

	dbg_apmcu_mp0@0d430000 {
		compatible = "mediatek,dbg_apmcu_mp0";
		reg = <0x00 0xd430000 0x00 0x1000>;
	};

	dbg_apmcu_mp0@0d440000 {
		compatible = "mediatek,dbg_apmcu_mp0";
		reg = <0x00 0xd440000 0x00 0x1000>;
	};

	dbg_apmcu_mp0@0d510000 {
		compatible = "mediatek,dbg_apmcu_mp0";
		reg = <0x00 0xd510000 0x00 0x1000>;
	};

	dbg_apmcu_mp0@0d520000 {
		compatible = "mediatek,dbg_apmcu_mp0";
		reg = <0x00 0xd520000 0x00 0x1000>;
	};

	dbg_apmcu_mp0@0d530000 {
		compatible = "mediatek,dbg_apmcu_mp0";
		reg = <0x00 0xd530000 0x00 0x1000>;
	};

	dbg_apmcu_mp0@0d540000 {
		compatible = "mediatek,dbg_apmcu_mp0";
		reg = <0x00 0xd540000 0x00 0x1000>;
	};

	dbg_apmcu_mp0@0d610000 {
		compatible = "mediatek,dbg_apmcu_mp0";
		reg = <0x00 0xd610000 0x00 0x1000>;
	};

	dbg_apmcu_mp0@0d620000 {
		compatible = "mediatek,dbg_apmcu_mp0";
		reg = <0x00 0xd620000 0x00 0x1000>;
	};

	dbg_apmcu_mp0@0d630000 {
		compatible = "mediatek,dbg_apmcu_mp0";
		reg = <0x00 0xd630000 0x00 0x1000>;
	};

	dbg_apmcu_mp0@0d640000 {
		compatible = "mediatek,dbg_apmcu_mp0";
		reg = <0x00 0xd640000 0x00 0x1000>;
	};

	dbg_apmcu_mp0@0d710000 {
		compatible = "mediatek,dbg_apmcu_mp0";
		reg = <0x00 0xd710000 0x00 0x1000>;
	};

	dbg_apmcu_mp0@0d720000 {
		compatible = "mediatek,dbg_apmcu_mp0";
		reg = <0x00 0xd720000 0x00 0x1000>;
	};

	dbg_apmcu_mp0@0d730000 {
		compatible = "mediatek,dbg_apmcu_mp0";
		reg = <0x00 0xd730000 0x00 0x1000>;
	};

	dbg_apmcu_mp0@0d740000 {
		compatible = "mediatek,dbg_apmcu_mp0";
		reg = <0x00 0xd740000 0x00 0x1000>;
	};

	dbg_apmcu_mp1@0d800000 {
		compatible = "mediatek,dbg_apmcu_mp1";
		reg = <0x00 0xd800000 0x00 0x1000>;
	};

	dbg_apmcu_mp1@0d810000 {
		compatible = "mediatek,dbg_apmcu_mp1";
		reg = <0x00 0xd810000 0x00 0x1000>;
	};

	dbg_apmcu_mp1@0d820000 {
		compatible = "mediatek,dbg_apmcu_mp1";
		reg = <0x00 0xd820000 0x00 0x1000>;
	};

	dbg_apmcu_mp1@0d830000 {
		compatible = "mediatek,dbg_apmcu_mp1";
		reg = <0x00 0xd830000 0x00 0x1000>;
	};

	dbg_apmcu_mp1@0d840000 {
		compatible = "mediatek,dbg_apmcu_mp1";
		reg = <0x00 0xd840000 0x00 0x1000>;
	};

	dbg_apmcu_mp1@0d910000 {
		compatible = "mediatek,dbg_apmcu_mp1";
		reg = <0x00 0xd910000 0x00 0x1000>;
	};

	dbg_apmcu_mp1@0d920000 {
		compatible = "mediatek,dbg_apmcu_mp1";
		reg = <0x00 0xd920000 0x00 0x1000>;
	};

	dbg_apmcu_mp1@0d930000 {
		compatible = "mediatek,dbg_apmcu_mp1";
		reg = <0x00 0xd930000 0x00 0x1000>;
	};

	dbg_apmcu_mp1@0d940000 {
		compatible = "mediatek,dbg_apmcu_mp1";
		reg = <0x00 0xd940000 0x00 0x1000>;
	};

	dbg_apmcu_mp1@0da10000 {
		compatible = "mediatek,dbg_apmcu_mp1";
		reg = <0x00 0xda10000 0x00 0x1000>;
	};

	dbg_apmcu_mp1@0da20000 {
		compatible = "mediatek,dbg_apmcu_mp1";
		reg = <0x00 0xda20000 0x00 0x1000>;
	};

	dbg_apmcu_mp1@0da30000 {
		compatible = "mediatek,dbg_apmcu_mp1";
		reg = <0x00 0xda30000 0x00 0x1000>;
	};

	dbg_apmcu_mp1@0da40000 {
		compatible = "mediatek,dbg_apmcu_mp1";
		reg = <0x00 0xda40000 0x00 0x1000>;
	};

	dbg_apmcu_mp1@0db10000 {
		compatible = "mediatek,dbg_apmcu_mp1";
		reg = <0x00 0xdb10000 0x00 0x1000>;
	};

	dbg_apmcu_mp1@0db20000 {
		compatible = "mediatek,dbg_apmcu_mp1";
		reg = <0x00 0xdb20000 0x00 0x1000>;
	};

	dbg_apmcu_mp1@0db30000 {
		compatible = "mediatek,dbg_apmcu_mp1";
		reg = <0x00 0xdb30000 0x00 0x1000>;
	};

	dbg_apmcu_mp1@0db40000 {
		compatible = "mediatek,dbg_apmcu_mp1";
		reg = <0x00 0xdb40000 0x00 0x1000>;
	};

	dbg_cti@0d020000 {
		compatible = "mediatek,dbg_cti";
		reg = <0x00 0xd020000 0x00 0x10000>;
	};

	dbg_dem@0d0a0000 {
		compatible = "mediatek,dbg_dem";
		interrupts = <0x00 0x8c 0x08>;
		reg = <0x00 0xd0a0000 0x00 0x10000>;
	};

	dbg_etr@0d030000 {
		compatible = "mediatek,dbg_etr";
		reg = <0x00 0xd030000 0x00 0x10000>;
	};

	dbg_funnel@0d040000 {
		compatible = "mediatek,dbg_funnel";
		reg = <0x00 0xd040000 0x00 0x10000>;
	};

	dbg_mdsys1@0d0c0000 {
		compatible = "mediatek,dbg_mdsys1";
		reg = <0x00 0xd0c0000 0x00 0x40000>;
	};

	ddrphy@10015000 {
		compatible = "mediatek,ddrphy";
		reg = <0x00 0x10015000 0x00 0x1000>;
	};

	ddrphy@1001e000 {
		compatible = "mediatek,ddrphy";
		reg = <0x00 0x1001e000 0x00 0x1000>;
	};

	devapc@10207000 {
		clock-names = "devapc-infra-clock";
		clocks = <0x26 0x28>;
		compatible = "mediatek,devapc";
		interrupts = <0x00 0x8e 0x08>;
		reg = <0x00 0x10207000 0x00 0x1000 0x00 0x1000e000 0x00 0x1000>;
	};

	dfd@10200b00 {
		compatible = "mediatek,dfd";
		mediatek,chain_length = <0xc350>;
		mediatek,enabled = <0x01>;
		mediatek,rg_dfd_timeout = <0xa0>;
		reg = <0x00 0x10200b00 0x00 0x10000>;
	};

	dip1@15022000 {
		compatible = "mediatek,dip1";
		interrupts = <0x00 0xff 0x08>;
		reg = <0x00 0x15022000 0x00 0x3000>;
	};

	disp_aal0@14011000 {
		compatible = "mediatek,disp_aal0";
		interrupts = <0x00 0xde 0x08>;
		reg = <0x00 0x14011000 0x00 0x1000>;
	};

	disp_ccorr0@14010000 {
		compatible = "mediatek,disp_ccorr0";
		interrupts = <0x00 0xdd 0x08>;
		reg = <0x00 0x14010000 0x00 0x1000>;
	};

	disp_color0@1400f000 {
		clock-names = "MDP_COLOR";
		clocks = <0x28 0x0c>;
		compatible = "mediatek,disp_color0";
		interrupts = <0x00 0xdc 0x08>;
		linux,phandle = <0x2f>;
		phandle = <0x2f>;
		reg = <0x00 0x1400f000 0x00 0x1000>;
	};

	disp_dither0@14013000 {
		compatible = "mediatek,disp_dither0";
		interrupts = <0x00 0xe0 0x08>;
		reg = <0x00 0x14013000 0x00 0x1000>;
	};

	disp_gamma0@14012000 {
		compatible = "mediatek,disp_gamma0";
		interrupts = <0x00 0xdf 0x08>;
		reg = <0x00 0x14012000 0x00 0x1000>;
	};

	disp_mutex0@14001000 {
		compatible = "mediatek,disp_mutex0";
		interrupts = <0x00 0xd2 0x08>;
		linux,phandle = <0x31>;
		phandle = <0x31>;
		reg = <0x00 0x14001000 0x00 0x1000>;
	};

	disp_ovl0@1400b000 {
		compatible = "mediatek,disp_ovl0";
		interrupts = <0x00 0xd9 0x08>;
		reg = <0x00 0x1400b000 0x00 0x1000>;
	};

	disp_ovl0_2l@1400c000 {
		compatible = "mediatek,disp_ovl0_2l";
		interrupts = <0x00 0xe5 0x08>;
		reg = <0x00 0x1400c000 0x00 0x1000>;
	};

	disp_pwm@1100e000 {
		compatible = "mediatek,disp_pwm";
		reg = <0x00 0x1100e000 0x00 0x1000>;
	};

	disp_rdma0@1400d000 {
		compatible = "mediatek,disp_rdma0";
		interrupts = <0x00 0xda 0x08>;
		reg = <0x00 0x1400d000 0x00 0x1000>;
	};

	disp_rsz0@14015000 {
		compatible = "mediatek,disp_rsz0";
		interrupts = <0x00 0x114 0x08>;
		reg = <0x00 0x14015000 0x00 0x1000>;
	};

	disp_wdma0@1400e000 {
		compatible = "mediatek,disp_wdma0";
		interrupts = <0x00 0xdb 0x08>;
		reg = <0x00 0x1400e000 0x00 0x1000>;
	};

	dispsys {
		clock-names = "MMSYS_MTCMOS\0MMSYS_SMI_COMMON\0MMSYS_SMI_LARB0\0MMSYS_GALS_COMM0\0MMSYS_GALS_COMM1\0MMSYS_DISP_OVL0\0MMSYS_DISP_OVL0_2L\0MMSYS_DISP_RDMA0\0MMSYS_DISP_WDMA0\0MMSYS_DISP_COLOR0\0MMSYS_DISP_CCORR0\0MMSYS_DISP_AAL0\0MMSYS_DISP_GAMMA0\0MMSYS_DISP_DITHER0\0MMSYS_DSI0_MM_CK\0MMSYS_DSI0_IF_CK\0MMSYS_26M\0MMSYS_DISP_RSZ0\0APMIXED_MIPI_26M\0TOP_MUX_DISP_PWM\0DISP_PWM\0TOP_26M\0TOP_UNIVPLL2_D4\0TOP_ULPOSC1_D2\0TOP_ULPOSC1_D8";
		clocks = <0x27 0x03 0x28 0x13 0x28 0x14 0x28 0x15 0x28 0x16 0x28 0x07 0x28 0x08 0x28 0x0a 0x28 0x0b 0x28 0x0c 0x28 0x0d 0x28 0x0e 0x28 0x0f 0x28 0x10 0x28 0x11 0x28 0x1c 0x28 0x1d 0x28 0x09 0x43 0x15 0x1e 0x73 0x26 0x31 0x1f 0x1e 0x1b 0x1e 0x2e 0x1e 0x30>;
		compatible = "mediatek,dispsys";
		mediatek,larb = <0x22>;
	};

	dma-controller@11000580 {
		#dma-cells = <0x01>;
		clock-names = "apdma";
		clocks = <0x26 0x26>;
		compatible = "mediatek,mt6577-uart-dma";
		interrupts = <0x00 0x6d 0x08 0x00 0x6e 0x08 0x00 0x6f 0x08 0x00 0x74 0x08>;
		linux,phandle = <0x33>;
		phandle = <0x33>;
		reg = <0x00 0x11000680 0x00 0x80 0x00 0x11000700 0x00 0x80 0x00 0x11000780 0x00 0x80 0x00 0x11000800 0x00 0x80>;
	};

	dpe@15028000 {
		clock-names = "DPE_CG_IMG_DPE";
		clocks = <0x4c 0x03>;
		compatible = "mediatek,dpe";
		interrupts = <0x00 0x100 0x08>;
		reg = <0x00 0x15028000 0x00 0x1000>;
	};

	dramc0@1001d000 {
		compatible = "mediatek,dramc0";
		reg = <0x00 0x1001d000 0x00 0x1000>;
	};

	dramc@1022a000 {
		compatible = "mediatek,dramc";
		reg = <0x00 0x1022a000 0x00 0x2000 0x00 0x10232000 0x00 0x2000 0x00 0x1022c000 0x00 0x1000 0x00 0x10234000 0x00 0x1000 0x00 0x10228000 0x00 0x2000 0x00 0x10230000 0x00 0x2000 0x00 0x1022e000 0x00 0x1000 0x00 0x10236000 0x00 0x1000>;
	};

	dramc_nao@1021d000 {
		compatible = "mediatek,dramc_nao";
		reg = <0x00 0x1021d000 0x00 0x1000>;
	};

	dsi0@14014000 {
		compatible = "mediatek,dsi0";
		interrupts = <0x00 0xe1 0x08>;
		reg = <0x00 0x14014000 0x00 0x1000>;
	};

	dsi_te {
		compatible = "mediatek, DSI_TE-eint";
		linux,phandle = <0xa7>;
		phandle = <0xa7>;
		status = "disabled";
	};

	dvfsp@00110800 {
		compatible = "mediatek,mt6765-dvfsp";
		reg = <0x00 0x110800 0x00 0x1400 0x00 0x110800 0x00 0x1400>;
	};

	dvfsp@10227000 {
		compatible = "mediatek,dvfsp";
		reg = <0x00 0x10227000 0x00 0x1000>;
	};

	dvfsrc@10012000 {
		compatible = "mediatek,dvfsrc";
		reg = <0x00 0x10012000 0x00 0x1000 0x00 0x110780 0x00 0x80>;
	};

	dxcc_sec@10210000 {
		compatible = "mediatek,dxcc_sec";
		interrupts = <0x00 0xa2 0x04>;
		reg = <0x00 0x10210000 0x00 0x1000>;
	};

	dynamic_options {
		compatible = "mediatek,dynamic_options";
		linux,phandle = <0xbd>;
		phandle = <0xbd>;
	};

	eas {
		eff_turn_point = <0x1d3>;
		tiny = <0x32>;
	};

	eem_fsm@1100b000 {
		compatible = "mediatek,eem_fsm";
		interrupts = <0x00 0x7d 0x08>;
		reg = <0x00 0x1100b000 0x00 0x1000>;
	};

	efuse_dbg@10004000 {
		compatible = "mediatek,efuse_dbg";
		reg = <0x00 0x10004000 0x00 0x1000>;
	};

	efusec@11c50000 {
		compatible = "mediatek,efusec";
		reg = <0x00 0x11c50000 0x00 0x10000>;
	};

	egis_fp {
		compatible = "mediatek,finger-fp";
		linux,phandle = <0x83>;
		phandle = <0x83>;
	};

	emi@10219000 {
		compatible = "mediatek,emi";
		interrupts = <0x00 0x90 0x08>;
		reg = <0x00 0x10219000 0x00 0x1000 0x00 0x10226000 0x00 0x1000 0x00 0x1022d000 0x00 0x1000 0x00 0x10235000 0x00 0x1000>;
	};

	fdvt@1502b000 {
		clock-names = "FD_CLK_IMG_FDVT";
		clocks = <0x4c 0x02>;
		compatible = "mediatek,fdvt";
		interrupts = <0x00 0x102 0x08>;
		reg = <0x00 0x1502b000 0x00 0x1000>;
	};

	fhctl@1000ce00 {
		compatible = "mediatek,fhctl";
		reg = <0x00 0x1000ce00 0x00 0x200>;
	};

	flashlight_core {
		compatible = "mediatek,flashlight_core";
		linux,phandle = <0xa9>;
		phandle = <0xa9>;
	};

	flashlights_pascal {
		compatible = "mediatek,flashlights_pascal";
		decouple = <0x01>;
		linux,phandle = <0xaa>;
		phandle = <0xaa>;

		channel@1 {
			ct = <0x00>;
			part = <0x00>;
			type = <0x00>;
		};
	};

	fpsensor_finger {
		compatible = "mediatek,fingerprint";
		linux,phandle = <0x84>;
		phandle = <0x84>;
	};

	gauge_timer {
		compatible = "mediatek,gauge_timer_service";
	};

	gce@10238000 {
		#clock-cells = <0x01>;
		ap_dma_base = <0x18010000 0x17 0xffff0000>;
		audio_base = <0x17000000 0x12 0xffff0000>;
		buf_underrun_event_0 = <0x8c>;
		camsys1_base = <0x180a0000 0x1c 0xffff0000>;
		camsys2_base = <0x180b0000 0x1d 0xffff0000>;
		camsys_base = <0x18080000 0x1b 0xffff0000>;
		clock-names = "GCE\0GCE_TIMER";
		clocks = <0x26 0x09 0x26 0x18>;
		compatible = "mediatek,gce\0syscon";
		conn_peri_base = <0x18820000 0x07 0xffff0000>;
		dip_cq_thread0_frame_done = <0x101>;
		dip_cq_thread10_frame_done = <0x10b>;
		dip_cq_thread11_frame_done = <0x10c>;
		dip_cq_thread12_frame_done = <0x10d>;
		dip_cq_thread13_frame_done = <0x10e>;
		dip_cq_thread14_frame_done = <0x10f>;
		dip_cq_thread15_frame_done = <0x110>;
		dip_cq_thread16_frame_done = <0x111>;
		dip_cq_thread17_frame_done = <0x112>;
		dip_cq_thread18_frame_done = <0x113>;
		dip_cq_thread1_frame_done = <0x102>;
		dip_cq_thread2_frame_done = <0x103>;
		dip_cq_thread3_frame_done = <0x104>;
		dip_cq_thread4_frame_done = <0x105>;
		dip_cq_thread5_frame_done = <0x106>;
		dip_cq_thread6_frame_done = <0x107>;
		dip_cq_thread7_frame_done = <0x108>;
		dip_cq_thread8_frame_done = <0x109>;
		dip_cq_thread9_frame_done = <0x10a>;
		disp_2l_ovl0_frame_done = <0x1c>;
		disp_2l_ovl0_sof = <0x08>;
		disp_aal0_frame_done = <0x22>;
		disp_aal0_sof = <0x0d>;
		disp_ccorr0_frame_done = <0x21>;
		disp_ccorr0_sof = <0x0c>;
		disp_color0_frame_done = <0x20>;
		disp_color0_sof = <0x0b>;
		disp_dither0_frame_done = <0x24>;
		disp_dither0_sof = <0x0f>;
		disp_dither_base = <0x14010000 0x02 0xffff0000>;
		disp_dsi0_frame_done = <0x25>;
		disp_dsi0_sof = <0x10>;
		disp_gamma0_frame_done = <0x23>;
		disp_gamma0_sof = <0x0e>;
		disp_ovl0_frame_done = <0x1b>;
		disp_ovl0_frame_rst_done_pusle = <0x98>;
		disp_ovl0_sof = <0x07>;
		disp_pwm0_sof = <0x13>;
		disp_rdma0_frame_done = <0x1e>;
		disp_rdma0_sof = <0x09>;
		disp_rsz0_frame_done = <0x1d>;
		disp_rsz0_sof = <0x11>;
		disp_wdma0_frame_done = <0x1f>;
		disp_wdma0_rst_done = <0x93>;
		disp_wdma0_sof = <0x0a>;
		dsi0_done_event = <0x8f>;
		dsi0_irq_event = <0x8e>;
		dsi0_te_event = <0x8d>;
		dve_frame_done = <0x114>;
		g3d_config_base = <0x13000000 0x00 0xffff0000>;
		gce_base = <0x18020000 0x18 0xffff0000>;
		gcpu_base = <0x10050000 0x0f 0xffff0000>;
		img_dl_relay_sof = <0x12>;
		imgsys_base = <0x15020000 0x04 0xffff0000>;
		infra_na3_base = <0x10010000 0x0b 0xffff0000>;
		infra_na4_base = <0x10020000 0x0c 0xffff0000>;
		interrupts = <0x00 0x9a 0x08 0x00 0x9b 0x08>;
		jpgdec_done = <0x123>;
		jpgenc_done = <0x122>;
		kp_base = <0x18840000 0x09 0xffff0000>;
		linux,phandle = <0x88>;
		max_prefetch_cnt = <0x01>;
		mboxes = <0x32 0x00 0x00 0x04 0x32 0x01 0x00 0x04 0x32 0x02 0x00 0x05 0x32 0x03 0x00 0x04 0x32 0x04 0x00 0x04 0x32 0x05 0x00 0x04 0x32 0x06 0x00 0x03 0x32 0x07 0xffffffff 0x02 0x32 0x08 0x00 0x01 0x32 0x09 0x00 0x01 0x32 0x0a 0x00 0x01 0x32 0x0b 0x00 0x01 0x32 0x0c 0x00 0x01 0x32 0x0d 0x00 0x01 0x32 0x0e 0x00 0x01 0x32 0x0f 0x00 0x01>;
		mcucfg_base = <0x10040000 0x0e 0xffff0000>;
		mdp_ccorr0 = <0x30>;
		mdp_ccorr0_frame_done = <0x15>;
		mdp_ccorr0_sof = <0x01>;
		mdp_color0 = <0x2f>;
		mdp_rdma0 = <0x29>;
		mdp_rdma0_frame_done = <0x14>;
		mdp_rdma0_rst_done = <0x97>;
		mdp_rdma0_sof = <0x00>;
		mdp_rsz0 = <0x2a>;
		mdp_rsz0_frame_done = <0x16>;
		mdp_rsz0_sof = <0x02>;
		mdp_rsz1 = <0x2b>;
		mdp_rsz1_frame_done = <0x17>;
		mdp_rsz1_sof = <0x03>;
		mdp_tdshp0 = <0x2e>;
		mdp_tdshp0_frame_done = <0x1a>;
		mdp_tdshp0_sof = <0x06>;
		mdp_wdma0 = <0x2c>;
		mdp_wdma_frame_done = <0x19>;
		mdp_wdma_rst_done = <0x94>;
		mdp_wdma_sof = <0x04>;
		mdp_wrot0 = <0x2d>;
		mdp_wrot0_rst_done = <0x95>;
		mdp_wrot0_sof = <0x05>;
		mdp_wrot0_write_frame_done = <0x18>;
		mediatek,mailbox-gce = <0x32>;
		mipitx0_base = <0x11c80000 0x63 0xffff0000>;
		mm_mutex = <0x31>;
		mm_na_base = <0x14020000 0x03 0xffff0000>;
		mmsys_config = <0x28>;
		mmsys_config_base = <0x14000000 0x01 0xffff0000>;
		msdc2_base = <0x17020000 0x14 0xffff0000>;
		msdc3_base = <0x18000000 0x16 0xffff0000>;
		phandle = <0x88>;
		prefetch_size = <0x60>;
		pwm_sw_base = <0x1100e000 0x63 0xffff0000>;
		reg = <0x00 0x10238000 0x00 0x4000>;
		rsc_frame_done = <0x116>;
		scp_base = <0x10030000 0x0d 0xffff0000>;
		scp_sram_base = <0x10000000 0x0a 0xffff0000>;
		secure_thread = <0x08 0x0a>;
		sram_share_cnt = <0x01>;
		sram_share_engine = <0x0a>;
		sram_share_event = <0x2c6>;
		sram_size_cpr_64 = <0x40>;
		stream_done_0 = <0x82>;
		stream_done_1 = <0x83>;
		stream_done_2 = <0x84>;
		stream_done_3 = <0x85>;
		stream_done_4 = <0x86>;
		stream_done_5 = <0x87>;
		stream_done_6 = <0x88>;
		stream_done_7 = <0x89>;
		stream_done_8 = <0x8a>;
		stream_done_9 = <0x8b>;
		thread_count = <0x10>;
		topckgen_base = <0x18830000 0x08 0xffff0000>;
		usb0_base = <0x10200000 0x10 0xffff0000>;
		usb_sif_base = <0x10280000 0x11 0xffff0000>;
		vdec1_base = <0x17030000 0x15 0xffff0000>;
		vdec2_base = <0x18040000 0x19 0xffff0000>;
		vdec3_base = <0x18050000 0x1a 0xffff0000>;
		vdec_base = <0x17010000 0x13 0xffff0000>;
		vdec_gcon_base = <0x18800000 0x05 0xffff0000>;
		venc_128byte_cnt_done = <0x125>;
		venc_done = <0x121>;
		venc_gcon_base = <0x18810000 0x06 0xffff0000>;
		venc_mb_done = <0x124>;
		wmf_frame_done = <0x115>;
	};

	gce_mbox@10238000 {
		#gce-event-cells = <0x01>;
		#gce-subsys-cells = <0x02>;
		#mbox-cells = <0x03>;
		clock-names = "gce\0GCE_TIMER";
		clocks = <0x26 0x09 0x26 0x18>;
		compatible = "mediatek,mailbox-gce";
		interrupts = <0x00 0x9a 0x08 0x00 0x9b 0x08>;
		linux,phandle = <0x32>;
		phandle = <0x32>;
		reg = <0x00 0x10238000 0x00 0x4000>;
	};

	gce_mbox_svp@10238000 {
		#mbox-cells = <0x03>;
		clock-names = "gce\0GCE_TIMER";
		clocks = <0x26 0x09 0x26 0x18>;
		compatible = "mediatek,mailbox-gce-svp";
		interrupts = <0x00 0x9a 0x08 0x00 0x9b 0x08>;
		linux,phandle = <0x89>;
		phandle = <0x89>;
		reg = <0x00 0x10238000 0x00 0x4000>;
	};

	gic500@0c000000 {
		compatible = "mediatek,gic500";
		reg = <0x00 0xc000000 0x00 0x1000>;
	};

	gic_cpu@0c400000 {
		compatible = "mediatek,gic_cpu";
		reg = <0x00 0xc400000 0x00 0x40000>;
	};

	gpio {
		compatible = "mediatek,gpio_usage_mapping";
		linux,phandle = <0x5b>;
		phandle = <0x5b>;
	};

	gpio@10005000 {
		compatible = "mediatek,gpio";
		linux,phandle = <0x5c>;
		phandle = <0x5c>;
		reg = <0x00 0x10005000 0x00 0x1000>;
	};

	gps {
		compatible = "mediatek,gps";
	};

	gpufreq {
		clock-names = "clk_mux\0clk_main_parent\0clk_sub_parent\0mtcmos_mfg_async\0mtcmos_mfg\0mtcmos_mfg_core0";
		clocks = <0x1e 0x64 0x1e 0x26 0x1f 0x27 0x08 0x27 0x04 0x27 0x07>;
		compatible = "mediatek,mt6765-gpufreq";
	};

	hacc@1000a000 {
		compatible = "mediatek,hacc";
		interrupts = <0x00 0xbd 0x08>;
		reg = <0x00 0x1000a000 0x00 0x1000>;
	};

	i2c0@11007000 {
		aed = <0x1a>;
		clock-div = <0x05>;
		clock-names = "main\0dma";
		clocks = <0x26 0x0b 0x26 0x26>;
		compatible = "mediatek,i2c";
		eh_cfg = <0x20>;
		gpio_start = <0x10002a00>;
		id = <0x00>;
		interrupts = <0x00 0x54 0x08>;
		linux,phandle = <0x8e>;
		mediatek,hs_only;
		mem_len = <0x200>;
		phandle = <0x8e>;
		pu_cfg = <0x50>;
		reg = <0x00 0x11007000 0x00 0x1000 0x00 0x11000080 0x00 0x80>;
		rsel_cfg = <0x70>;
		scl-gpio-id = <0x53>;
		sda-gpio-id = <0x52>;
	};

	i2c1@11008000 {
		aed = <0x1a>;
		clock-div = <0x05>;
		clock-names = "main\0dma";
		clocks = <0x26 0x0b 0x26 0x26>;
		compatible = "mediatek,i2c";
		eh_cfg = <0x20>;
		gpio_start = <0x10002a00>;
		id = <0x01>;
		interrupts = <0x00 0x55 0x08>;
		linux,phandle = <0x8f>;
		mediatek,hs_only;
		mem_len = <0x200>;
		phandle = <0x8f>;
		pu_cfg = <0x50>;
		reg = <0x00 0x11008000 0x00 0x1000 0x00 0x11000100 0x00 0x80>;
		rsel_cfg = <0x70>;
		scl-gpio-id = <0x54>;
		sda-gpio-id = <0x51>;
	};

	i2c2@11009000 {
		aed = <0x1a>;
		ch_offset_ccu = <0x200>;
		ch_offset_default = <0x100>;
		clock-div = <0x05>;
		clock-names = "main\0dma";
		clocks = <0x26 0x0b 0x26 0x26>;
		compatible = "mediatek,i2c";
		eh_cfg = <0x20>;
		gpio_start = <0x10002800>;
		id = <0x02>;
		interrupts = <0x00 0x56 0x08>;
		linux,phandle = <0x90>;
		mediatek,hs_only;
		mem_len = <0x200>;
		phandle = <0x90>;
		pu_cfg = <0x60>;
		reg = <0x00 0x11009000 0x00 0x1000 0x00 0x11000180 0x00 0x180>;
		rsel_cfg = <0xa0>;
		scl-gpio-id = <0x67>;
		sda-gpio-id = <0x68>;
	};

	i2c3@1100f000 {
		#address-cells = <0x01>;
		#size-cells = <0x00>;
		aed = <0x1a>;
		ch_offset_default = <0x100>;
		clock-div = <0x05>;
		clock-names = "main\0dma";
		clocks = <0x26 0x0b 0x26 0x26>;
		compatible = "mediatek,i2c";
		eh_cfg = <0x20>;
		gpio_start = <0x10002600>;
		id = <0x03>;
		interrupts = <0x00 0x57 0x08>;
		linux,phandle = <0x91>;
		mediatek,hs_only;
		mem_len = <0x200>;
		phandle = <0x91>;
		pu_cfg = <0x90>;
		reg = <0x00 0x1100f000 0x00 0x1000 0x00 0x11000300 0x00 0x100>;
		rsel_cfg = <0xb0>;
		scl-gpio-id = <0x32>;
		sda-gpio-id = <0x33>;

		pn553@28 {
			compatible = "mediatek,pn553nfc";
			reg = <0x28>;
			status = "okay";
		};
	};

	i2c4@11011000 {
		aed = <0x1a>;
		ch_offset_ccu = <0x200>;
		ch_offset_default = <0x100>;
		clock-div = <0x05>;
		clock-names = "main\0dma";
		clocks = <0x26 0x0b 0x26 0x26>;
		compatible = "mediatek,i2c";
		eh_cfg = <0x20>;
		gpio_start = <0x10002800>;
		id = <0x04>;
		interrupts = <0x00 0x58 0x08>;
		linux,phandle = <0x92>;
		mediatek,hs_only;
		mem_len = <0x200>;
		phandle = <0x92>;
		pu_cfg = <0x60>;
		reg = <0x00 0x11011000 0x00 0x1000 0x00 0x11000400 0x00 0x180>;
		rsel_cfg = <0xa0>;
		scl-gpio-id = <0x69>;
		sda-gpio-id = <0x6a>;
	};

	i2c5@11016000 {
		#address-cells = <0x01>;
		#size-cells = <0x00>;
		aed = <0x1a>;
		clock-div = <0x05>;
		clock-frequency = <0x61a80>;
		clock-names = "main\0dma";
		clocks = <0x26 0x0b 0x26 0x26>;
		compatible = "mediatek,i2c";
		eh_cfg = <0x20>;
		gpio_start = <0x10002600>;
		id = <0x05>;
		interrupts = <0x00 0x82 0x08>;
		linux,phandle = <0x93>;
		mediatek,hs_only;
		mediatek,use-open-drain;
		mem_len = <0x200>;
		phandle = <0x93>;
		pu_cfg = <0x90>;
		reg = <0x00 0x11016000 0x00 0x1000 0x00 0x11000580 0x00 0x80>;
		rsel_cfg = <0xb0>;
		scl-gpio-id = <0x30>;
		sda-gpio-id = <0x31>;

		sia81xx_i2c@L {
			compatible = "si,sia81xx-i2c";
			linux,phandle = <0x94>;
			phandle = <0x94>;
			reg = <0x58>;
			si,sia81xx-dev = <0x34>;
		};
	};

	i2c6@1100d000 {
		aed = <0x1a>;
		ch_offset_ccu = <0x200>;
		ch_offset_default = <0x100>;
		clock-div = <0x05>;
		clock-names = "main\0dma";
		clocks = <0x26 0x0b 0x26 0x26>;
		compatible = "mediatek,i2c";
		eh_cfg = <0x20>;
		gpio_start = <0x10002c00>;
		id = <0x06>;
		interrupts = <0x00 0x83 0x08>;
		linux,phandle = <0x95>;
		mediatek,hs_only;
		mem_len = <0x200>;
		phandle = <0x95>;
		pu_cfg = <0x50>;
		reg = <0x00 0x1100d000 0x00 0x1000 0x00 0x11000600 0x00 0x80>;
		rsel_cfg = <0x70>;
		scl-gpio-id = <0xa1>;
		sda-gpio-id = <0xa2>;
	};

	i2c7 {
		linux,phandle = <0xb6>;
		phandle = <0xb6>;
	};

	i2c8 {
		linux,phandle = <0xb7>;
		phandle = <0xb7>;
	};

	i2c9 {
		linux,phandle = <0xb8>;
		phandle = <0xb8>;
	};

	i2c_common {
		check_max_freq = [01];
		cnt_constraint = [01];
		compatible = "mediatek,i2c_common";
		dma_support = [02];
		ext_time_config = [18 01];
		idvfs = [01];
		linux,phandle = <0x8d>;
		phandle = <0x8d>;
		set_dt_div = [01];
		set_ltiming = [01];
		ver = [02];
	};

	imgsys@15020000 {
		#clock-cells = <0x01>;
		clock-names = "ISP_SCP_SYS_DIS\0ISP_SCP_SYS_ISP\0ISP_SCP_SYS_CAM\0ISP_CLK_IMG_DIP\0ISP_CLK_CAM\0ISP_CLK_CAMTG\0ISP_CLK_CAM_SENINF\0ISP_CLK_CAMSV0\0ISP_CLK_CAMSV1\0ISP_CLK_CAMSV2";
		clocks = <0x27 0x03 0x27 0x05 0x27 0x09 0x4c 0x01 0x4d 0x02 0x4d 0x03 0x4d 0x04 0x4d 0x05 0x4d 0x06 0x4d 0x07>;
		compatible = "mediatek,imgsys\0syscon";
		linux,phandle = <0x4c>;
		phandle = <0x4c>;
		pwr-regmap = <0x44>;
		reg = <0x00 0x15020000 0x00 0x1000>;
	};

	imp_iic@11017000 {
		compatible = "mediatek,imp_iic";
		reg = <0x00 0x11017000 0x00 0x1000>;
	};

	infra_mbist@1020d000 {
		compatible = "mediatek,infra_mbist";
		reg = <0x00 0x1020d000 0x00 0x1000>;
	};

	infracfg@1020e000 {
		compatible = "mediatek,infracfg";
		reg = <0x00 0x1020e000 0x00 0x1000>;
	};

	infracfg_ao@10001000 {
		#clock-cells = <0x01>;
		compatible = "mediatek,infracfg_ao\0syscon";
		interrupts = <0x00 0x93 0x01>;
		linux,phandle = <0x26>;
		phandle = <0x26>;
		reg = <0x00 0x10001000 0x00 0x1000>;
	};

	interrupt-controller@0c000000 {
		#address-cells = <0x02>;
		#interrupt-cells = <0x03>;
		#redistributor-regions = <0x01>;
		#size-cells = <0x02>;
		compatible = "arm,gic-v3";
		interrupt-controller;
		interrupt-parent = <0x11>;
		interrupts = <0x01 0x09 0x04>;
		linux,phandle = <0x11>;
		phandle = <0x11>;
		reg = <0x00 0xc000000 0x00 0x40000 0x00 0xc100000 0x00 0x200000 0x00 0x10200a80 0x00 0x50>;
	};

	intpol-controller@10200a80 {
		#interrupt-cells = <0x03>;
		compatible = "mediatek,mt6577-sysirq";
		interrupt-controller;
		interrupt-parent = <0x11>;
		linux,phandle = <0x01>;
		phandle = <0x01>;
		reg = <0x00 0x10200a80 0x00 0x50>;
	};

	io_cfg_bl@10002600 {
		compatible = "mediatek,io_cfg_bl";
		reg = <0x00 0x10002600 0x00 0x200>;
	};

	io_cfg_lb@10002400 {
		compatible = "mediatek,io_cfg_lb";
		reg = <0x00 0x10002400 0x00 0x200>;
	};

	io_cfg_lm@10002200 {
		compatible = "mediatek,io_cfg_lm";
		reg = <0x00 0x10002200 0x00 0x200>;
	};

	io_cfg_lt@10002000 {
		compatible = "mediatek,io_cfg_lt";
		reg = <0x00 0x10002000 0x00 0x200>;
	};

	io_cfg_rb@10002a00 {
		compatible = "mediatek,io_cfg_rb";
		reg = <0x00 0x10002a00 0x00 0x200>;
	};

	io_cfg_rr@10002800 {
		compatible = "mediatek,io_cfg_rr";
		reg = <0x00 0x10002800 0x00 0x200>;
	};

	io_cfg_rt@10002c00 {
		compatible = "mediatek,io_cfg_rt";
		reg = <0x00 0x10002c00 0x00 0x200>;
	};

	iocfg_0@10002000 {
		compatible = "mediatek,iocfg_0";
		reg = <0x00 0x10002000 0x00 0x200>;
	};

	iocfg_1@10002200 {
		compatible = "mediatek,iocfg_1";
		reg = <0x00 0x10002200 0x00 0x200>;
	};

	iocfg_2@10002400 {
		compatible = "mediatek,iocfg_2";
		reg = <0x00 0x10002400 0x00 0x200>;
	};

	iocfg_3@10002600 {
		compatible = "mediatek,iocfg_3";
		reg = <0x00 0x10002600 0x00 0x200>;
	};

	iocfg_4@10002800 {
		compatible = "mediatek,iocfg_4";
		reg = <0x00 0x10002800 0x00 0x200>;
	};

	iocfg_5@10002a00 {
		compatible = "mediatek,iocfg_5";
		reg = <0x00 0x10002a00 0x00 0x200>;
	};

	irq_nfc {
		compatible = "mediatek,irq_nfc-eint";
		linux,phandle = <0xa5>;
		phandle = <0xa5>;
	};

	irtx_pwm {
		compatible = "mediatek,irtx-pwm";
		linux,phandle = <0xb2>;
		phandle = <0xb2>;
		pwm_ch = <0x00>;
		pwm_data_invert = <0x00>;
	};

	kd_camera_hw1@1a040000 {
		clock-names = "CLK_TOP_CAMTG_SEL\0CLK_TOP_CAMTG1_SEL\0CLK_TOP_CAMTG2_SEL\0CLK_TOP_CAMTG3_SEL\0CLK_MCLK_6M\0CLK_MCLK_12M\0CLK_MCLK_13M\0CLK_MCLK_48M\0CLK_MCLK_52M\0CLK_MCLK_24M\0CLK_MCLK_26M\0CLK_CAM_SENINF_CG\0CLK_MIPI_C0_26M_CG\0CLK_MIPI_C1_26M_CG\0CLK_MIPI_ANA_0A_CG\0CLK_MIPI_ANA_0B_CG\0CLK_MIPI_ANA_1A_CG\0CLK_MIPI_ANA_1B_CG\0CLK_MIPI_ANA_2A_CG\0CLK_MIPI_ANA_2B_CG\0CLK_TOP_CAMTM_SEL_CG\0CLK_TOP_CAMTM_208_CG\0CLK_SCP_SYS_CAM";
		clocks = <0x1e 0x66 0x1e 0x67 0x1e 0x68 0x1e 0x69 0x1e 0x14 0x1e 0x13 0x1e 0x1d 0x1e 0x11 0x1e 0x1c 0x1e 0x12 0x1f 0x4d 0x04 0x43 0x0e 0x43 0x12 0x4f 0x00 0x50 0x00 0x51 0x00 0x52 0x00 0x53 0x00 0x54 0x00 0x1e 0x7d 0x1e 0x1a 0x27 0x09>;
		compatible = "mediatek,camera_hw";
		linux,phandle = <0xa8>;
		phandle = <0xa8>;
		reg = <0x00 0x1a040000 0x00 0x1000>;
	};

	kp@10010000 {
		compatible = "mediatek,kp";
		interrupts = <0x00 0xb4 0x02>;
		linux,phandle = <0x1a>;
		phandle = <0x1a>;
		reg = <0x00 0x10010000 0x00 0x1000>;
	};

	l2c_parity {
		compatible = "mediatek,l2c_parity-v1";
		interrupts = <0x00 0x18 0x04 0x00 0x19 0x04>;
	};

	lk_charger {
		ac_charger_current = <0x1f47d0>;
		ac_charger_input_current = <0x30d400>;
		charging_host_charger_current = <0x16e360>;
		compatible = "mediatek,lk_charger";
		enable_anime;
		enable_pd20_reset;
		enable_pe_plus;
		fast_charge_voltage = <0x2dc6c0>;
		linux,phandle = <0xac>;
		max_charger_voltage = <0x632ea0>;
		non_std_ac_charger_current = <0x7a120>;
		pd_charger_current = <0x7a120>;
		phandle = <0xac>;
		power_path_support;
		ta_ac_charger_current = <0x2dc6c0>;
		temp_t1_threshold = <0x00>;
		temp_t3_threshold = <0x2d>;
		temp_t4_threshold = <0x32>;
		usb_charger_current = <0x7a120>;
	};

	m4u@10205000 {
		#iommu-cells = <0x01>;
		cell-index = <0x00>;
		compatible = "mediatek,iommu_v0";
		interrupts = <0x00 0x9e 0x08>;
		linux,phandle = <0x55>;
		mediatek,larbs = <0x22 0x23 0x24 0x25>;
		phandle = <0x55>;
		reg = <0x00 0x10205000 0x00 0x1000>;
	};

	mbist@17050000 {
		compatible = "mediatek,mbist";
		reg = <0x00 0x17050000 0x00 0x10000>;
	};

	mbist_ao@10013000 {
		compatible = "mediatek,mbist_ao";
		reg = <0x00 0x10013000 0x00 0x1000>;
	};

	mcdi@0010fc00 {
		compatible = "mediatek,mt6765-mcdi";
		reg = <0x00 0x10fc00 0x00 0x800>;
	};

	mcucfg@10200000 {
		compatible = "mediatek,mcucfg";
		interrupts = <0x00 0x00 0x08>;
		reg = <0x00 0x10200000 0x00 0x1000>;
	};

	mcucfg_mp0_counter@10200000 {
		compatible = "mediatek,mcucfg_mp0_counter";
		reg = <0x00 0x10200000 0x00 0x4000>;
	};

	mcupm_reg@10216000 {
		compatible = "mediatek,mcupm_reg";
		reg = <0x00 0x10216000 0x00 0x1000>;
	};

	mcupm_sram0@10217000 {
		compatible = "mediatek,mcupm_sram0";
		reg = <0x00 0x10217000 0x00 0x1000>;
	};

	mcupm_sram1@10218000 {
		compatible = "mediatek,mcupm_sram1";
		reg = <0x00 0x10218000 0x00 0x1000>;
	};

	mcupm_sram2@10211000 {
		compatible = "mediatek,mcupm_sram2";
		reg = <0x00 0x10211000 0x00 0x1000>;
	};

	mcupm_sram3@10213000 {
		compatible = "mediatek,mcupm_sram3";
		reg = <0x00 0x10213000 0x00 0x1000>;
	};

	md1_sim1_hot_plug_eint {
		linux,phandle = <0xba>;
		phandle = <0xba>;
	};

	md1_sim2_hot_plug_eint {
		linux,phandle = <0xbb>;
		phandle = <0xbb>;
	};

	md_ccif0@1020a000 {
		compatible = "mediatek,md_ccif0";
		reg = <0x00 0x1020a000 0x00 0x1000>;
	};

	md_ccif1@1020c000 {
		compatible = "mediatek,md_ccif1";
		reg = <0x00 0x1020c000 0x00 0x1000>;
	};

	md_ccif2@1023d000 {
		compatible = "mediatek,md_ccif2";
		reg = <0x00 0x1023d000 0x00 0x1000>;
	};

	md_ccif3@1023f000 {
		compatible = "mediatek,md_ccif3";
		reg = <0x00 0x1023f000 0x00 0x1000>;
	};

	mdcldma@10014000 {
		clock-names = "scp-sys-md1-main\0infra-cldma-bclk\0infra-ccif-ap\0infra-ccif-md\0infra-ccif1-ap\0infra-ccif1-md\0infra-ccif2-ap\0infra-ccif2-md";
		clocks = <0x27 0x00 0x26 0x32 0x26 0x29 0x26 0x2c 0x26 0x23 0x26 0x24 0x26 0x51 0x26 0x52>;
		compatible = "mediatek,mdcldma";
		interrupts = <0x00 0xa5 0x04 0x00 0x94 0x08 0x00 0x95 0x08 0x00 0x105 0x02>;
		linux,phandle = <0x1c>;
		mediatek,cldma_capability = <0x06>;
		mediatek,md_id = <0x00>;
		phandle = <0x1c>;
		reg = <0x00 0x10014000 0x00 0x1000 0x00 0x1021b000 0x00 0x1000 0x00 0x10209000 0x00 0x1000 0x00 0x1020a000 0x00 0x1000>;
	};

	mdcldmain@1021c000 {
		compatible = "mediatek,mdcldmain";
		reg = <0x00 0x1021c000 0x00 0x400>;
	};

	mdcldmain_ao@10015000 {
		compatible = "mediatek,mdcldmain_ao";
		reg = <0x00 0x10015000 0x00 0x400>;
	};

	mdcldmamisc@1021c800 {
		compatible = "mediatek,mdcldmamisc";
		reg = <0x00 0x1021c800 0x00 0x1000>;
	};

	mdcldmamisc_ao@10015800 {
		compatible = "mediatek,mdcldmamisc_ao";
		reg = <0x00 0x10015800 0x00 0x400>;
	};

	mdcldmaout@1021c400 {
		compatible = "mediatek,mdcldmaout";
		reg = <0x00 0x1021c400 0x00 0x400>;
	};

	mdcldmaout_ao@10015400 {
		compatible = "mediatek,mdcldmaout_ao";
		reg = <0x00 0x10015400 0x00 0x400>;
	};

	mdp_ccorr0@14005000 {
		clock-names = "MDP_CCORR";
		clocks = <0x28 0x01>;
		compatible = "mediatek,mdp_ccorr0";
		interrupts = <0x00 0xe2 0x08>;
		linux,phandle = <0x30>;
		phandle = <0x30>;
		reg = <0x00 0x14005000 0x00 0x1000>;
	};

	mdp_rdma0@14004000 {
		clock-names = "MDP_RDMA0";
		clocks = <0x28 0x00>;
		compatible = "mediatek,mdp_rdma0";
		interrupts = <0x00 0xd3 0x08>;
		linux,phandle = <0x29>;
		phandle = <0x29>;
		reg = <0x00 0x14004000 0x00 0x1000>;
	};

	mdp_rsz0@14006000 {
		clock-names = "MDP_RSZ0";
		clocks = <0x28 0x02>;
		compatible = "mediatek,mdp_rsz0";
		interrupts = <0x00 0xd4 0x08>;
		linux,phandle = <0x2a>;
		phandle = <0x2a>;
		reg = <0x00 0x14006000 0x00 0x1000>;
	};

	mdp_rsz1@14007000 {
		clock-names = "MDP_RSZ1";
		clocks = <0x28 0x03>;
		compatible = "mediatek,mdp_rsz1";
		interrupts = <0x00 0xd5 0x08>;
		linux,phandle = <0x2b>;
		phandle = <0x2b>;
		reg = <0x00 0x14007000 0x00 0x1000>;
	};

	mdp_tdshp0@1400a000 {
		clock-names = "MDP_TDSHP";
		clocks = <0x28 0x04>;
		compatible = "mediatek,mdp_tdshp0";
		linux,phandle = <0x2e>;
		phandle = <0x2e>;
		reg = <0x00 0x1400a000 0x00 0x1000>;
	};

	mdp_wdma0@14008000 {
		clock-names = "MDP_WDMA";
		clocks = <0x28 0x06>;
		compatible = "mediatek,mdp_wdma0";
		interrupts = <0x00 0xd8 0x08>;
		linux,phandle = <0x2c>;
		phandle = <0x2c>;
		reg = <0x00 0x14008000 0x00 0x1000>;
	};

	mdp_wrot0@14009000 {
		clock-names = "MDP_WROT0";
		clocks = <0x28 0x05>;
		compatible = "mediatek,mdp_wrot0";
		interrupts = <0x00 0xd7 0x08>;
		linux,phandle = <0x2d>;
		phandle = <0x2d>;
		reg = <0x00 0x14009000 0x00 0x1000>;
	};

	memory {
		device_type = "memory";
		reg = <0x00 0x40000000 0x00 0x20000000>;
	};

	memory-ssmr-features {
		2d_fr-size = <0x00 0x8000000>;
		compatible = "mediatek,memory-ssmr-features";
		iris-recognition-size = <0x00 0x10000000>;
		linux,phandle = <0xb4>;
		phandle = <0xb4>;
		prot-sharedmem-size = <0x00 0x8000000>;
		sdsp-firmware-size = <0x00 0x1000000>;
		sdsp-tee-sharedmem-size = <0x00 0x1000000>;
		svp-size = <0x00 0x10000000>;
		ta-elf-size = <0x00 0x1000000>;
		ta-stack-heap-size = <0x00 0x6000000>;
		tui-size = <0x00 0x4000000>;
		wfd-size = <0x00 0x4000000>;
	};

	mfg_cfg@13ffe000 {
		#clock-cells = <0x01>;
		compatible = "mediatek,mfgcfg\0syscon";
		linux,phandle = <0xa3>;
		phandle = <0xa3>;
		reg = <0x00 0x13ffe000 0x00 0x1000>;
	};

	mfg_doma@13000000 {
		clock-frequency = <0x21f98280>;
		compatible = "mediatek,doma";
		interrupt-names = "RGX";
		interrupts = <0x00 0x103 0x08>;
		reg = <0x00 0x13000000 0x00 0x80000>;
	};

	mipi_rx_ana_csi0a@11c10000 {
		#clock-cells = <0x01>;
		compatible = "mediatek,mipi_rx_ana_csi0a\0syscon";
		linux,phandle = <0x4f>;
		phandle = <0x4f>;
		reg = <0x00 0x11c10000 0x00 0x1000>;
	};

	mipi_rx_ana_csi0b@11c11000 {
		#clock-cells = <0x01>;
		compatible = "mediatek,mipi_rx_ana_csi0b\0syscon";
		linux,phandle = <0x50>;
		phandle = <0x50>;
		reg = <0x00 0x11c11000 0x00 0x1000>;
	};

	mipi_rx_ana_csi1a@11c12000 {
		#clock-cells = <0x01>;
		compatible = "mediatek,mipi_rx_ana_csi1a\0syscon";
		linux,phandle = <0x51>;
		phandle = <0x51>;
		reg = <0x00 0x11c12000 0x00 0x1000>;
	};

	mipi_rx_ana_csi1b@11c13000 {
		#clock-cells = <0x01>;
		compatible = "mediatek,mipi_rx_ana_csi1b\0syscon";
		linux,phandle = <0x52>;
		phandle = <0x52>;
		reg = <0x00 0x11c13000 0x00 0x1000>;
	};

	mipi_rx_ana_csi2a@11c14000 {
		#clock-cells = <0x01>;
		compatible = "mediatek,mipi_rx_ana_csi2a\0syscon";
		linux,phandle = <0x53>;
		phandle = <0x53>;
		reg = <0x00 0x11c14000 0x00 0x1000>;
	};

	mipi_rx_ana_csi2b@11c15000 {
		#clock-cells = <0x01>;
		compatible = "mediatek,mipi_rx_ana_csi2b\0syscon";
		linux,phandle = <0x54>;
		phandle = <0x54>;
		reg = <0x00 0x11c15000 0x00 0x1000>;
	};

	mipi_tx0@11c80000 {
		compatible = "mediatek,mipi_tx0";
		reg = <0x00 0x11c80000 0x00 0x10000>;
	};

	mmdvfs_pmqos {
		cam_freq = "mm_step0\0mm_step1\0mm_step2";
		clock-names = "mmdvfs_clk_mm_sel_ck\0mmdvfs_clk_mmpll_ck\0mmdvfs_clk_univpll1_d2_ck\0mmdvfs_clk_mmpll_d2_ck";
		clocks = <0x1e 0x62 0x1e 0x21 0x1e 0x17 0x1e 0x22>;
		compatible = "mediatek,mmdvfs_pmqos";
		disp_freq = "mm_step0\0mm_step1\0mm_step2";
		img_freq = "mm_step0\0mm_step1\0mm_step2";
		mdp_freq = "mm_step0\0mm_step1\0mm_step2";
		mm_step0 = <0x1c9 0x01 0x00 0x01>;
		mm_step1 = <0x138 0x01 0x00 0x02>;
		mm_step2 = <0xe4 0x01 0x00 0x03>;
		vdec_freq = "mm_step0\0mm_step1\0mm_step2";
		venc_freq = "mm_step0\0mm_step1\0mm_step2";
		vopp_steps = <0x00 0x01 0x03>;
	};

	mmsys_config@14000000 {
		#clock-cells = <0x01>;
		clock-names = "CAM_MDP\0IMG_DL_RELAY\0IMG_DL_ASYNC_TOP";
		clocks = <0x28 0x17 0x28 0x1a 0x28 0x1b>;
		compatible = "mediatek,mmsys_config\0syscon";
		interrupts = <0x00 0xe3 0x08>;
		linux,phandle = <0x28>;
		phandle = <0x28>;
		pwr-regmap = <0x44>;
		reg = <0x00 0x14000000 0x00 0x1000>;
	};

	mobicore {
		compatible = "trustonic,mobicore";
		interrupts = <0x00 0x10f 0x01>;
	};

	modem_temp_share@10018000 {
		compatible = "mediatek,modem_temp_share";
		reg = <0x00 0x10018000 0x00 0x1000>;
	};

	mrdump_ext_rst {
		compatible = "mediatek, mrdump_ext_rst-eint";
		force_mode = "EINT";
		linux,phandle = <0x80>;
		mode = "IRQ";
		phandle = <0x80>;
		status = "okay";
	};

	msdc0_pad_macro@11cd0000 {
		compatible = "mediatek,msdc0_pad_macro";
		reg = <0x00 0x11cd0000 0x00 0x10000>;
	};

	msdc0_top@11cd0000 {
		compatible = "mediatek,msdc0_top";
		reg = <0x00 0x11cd0000 0x00 0x1000>;
	};

	msdc1_ins@0 {
		compatible = "mediatek,mt6765-sdcard-ins";
		linux,phandle = <0xa1>;
		phandle = <0xa1>;
	};

	msdc1_pad_macro@11c90000 {
		compatible = "mediatek,msdc1_pad_macro";
		reg = <0x00 0x11c90000 0x00 0x10000>;
	};

	msdc1_top@11c90000 {
		compatible = "mediatek,msdc1_top";
		reg = <0x00 0x11c90000 0x00 0x1000>;
	};

	msdc@11230000 {
		bootable;
		bus-width = <0x08>;
		cap-mmc-highspeed;
		clk_src = [01];
		clock-names = "msdc0-clock\0msdc0-hclock\0msdc0-aes-clock";
		clocks = <0x26 0x4c 0x26 0x1c 0x26 0x44>;
		compatible = "mediatek,msdc";
		host_function = [00];
		index = [00];
		interrupts = <0x00 0x4f 0x08>;
		linux,phandle = <0x9d>;
		max-frequency = <0xbebc200>;
		mmc-ddr-1_8v;
		mmc-hs200-1_8v;
		mmc-hs400-1_8v;
		no-sd;
		no-sdio;
		non-removable;
		phandle = <0x9d>;
		pinctl = <0x35>;
		pinctl_hs200 = <0x37>;
		pinctl_hs400 = <0x36>;
		reg = <0x00 0x11230000 0x00 0x10000>;
		register_setting = <0x38>;
		status = "okay";
		vmmc-supply = <0x39>;
	};

	msdc@11240000 {
		bus-width = <0x04>;
		cap-sd-highspeed;
		cd-gpios = <0x3f 0x01 0x00>;
		cd-ldo-gpio = <0x3f 0xad 0x00>;
		cd_level = [01];
		clk_src = [02];
		clock-names = "msdc1-clock\0msdc1-hclock";
		clocks = <0x26 0x4d 0x26 0x1d>;
		compatible = "mediatek,msdc";
		host_function = [01];
		index = [01];
		interrupts = <0x00 0x50 0x08>;
		linux,phandle = <0x9e>;
		max-frequency = <0xbebc200>;
		no-mmc;
		no-sdio;
		phandle = <0x9e>;
		pinctl = <0x3a>;
		pinctl_ddr50 = <0x3d>;
		pinctl_sdr104 = <0x3b>;
		pinctl_sdr50 = <0x3c>;
		reg = <0x00 0x11240000 0x00 0x10000>;
		register_setting = <0x3e>;
		sd-uhs-ddr50;
		sd-uhs-sdr104;
		sd-uhs-sdr12;
		sd-uhs-sdr25;
		sd-uhs-sdr50;
		status = "okay";
		vqmmc-supply = <0x40>;
	};

	msdc@11250000 {
		compatible = "mediatek,msdc2";
		linux,phandle = <0x9f>;
		phandle = <0x9f>;
		reg = <0x00 0x11250000 0x00 0x10000>;
		status = "disable";
	};

	msdc@11260000 {
		compatible = "mediatek,msdc3";
		linux,phandle = <0xa0>;
		phandle = <0xa0>;
		reg = <0x00 0x11250000 0x00 0x10000>;
		status = "disable";
	};

	mt-pmic {
		compatible = "mediatek,mt_pmic";
		interrupt-controller;
		linux,phandle = <0x5f>;
		phandle = <0x5f>;

		buck_regulators {

			buck_vcore {
				linux,phandle = <0x63>;
				phandle = <0x63>;
				regulator-enable-ramp-delay = <0xdc>;
				regulator-max-microvolt = <0x1406f4>;
				regulator-min-microvolt = <0x7ea5e>;
				regulator-name = "vcore";
				regulator-ramp-delay = <0x186a>;
			};

			buck_vmodem {
				linux,phandle = <0x62>;
				phandle = <0x62>;
				regulator-enable-ramp-delay = <0xdc>;
				regulator-max-microvolt = <0x123716>;
				regulator-min-microvolt = <0x7a120>;
				regulator-name = "vmodem";
				regulator-ramp-delay = <0x186a>;
			};

			buck_vpa {
				linux,phandle = <0x65>;
				phandle = <0x65>;
				regulator-enable-ramp-delay = <0xdc>;
				regulator-max-microvolt = <0x37b1d0>;
				regulator-min-microvolt = <0x7a120>;
				regulator-name = "vpa";
				regulator-ramp-delay = <0xc350>;
			};

			buck_vproc {
				linux,phandle = <0x64>;
				phandle = <0x64>;
				regulator-enable-ramp-delay = <0xdc>;
				regulator-max-microvolt = <0x1406f4>;
				regulator-min-microvolt = <0x7ea5e>;
				regulator-name = "vproc";
				regulator-ramp-delay = <0x186a>;
			};

			buck_vs1 {
				linux,phandle = <0x61>;
				phandle = <0x61>;
				regulator-enable-ramp-delay = <0xdc>;
				regulator-max-microvolt = <0x2191c0>;
				regulator-min-microvolt = <0x124f80>;
				regulator-name = "vs1";
				regulator-ramp-delay = <0x30d4>;
			};
		};

		ldo_regulators {

			ldo_vaud28 {
				compatible = "regulator-fixed";
				linux,phandle = <0x76>;
				phandle = <0x76>;
				regulator-enable-ramp-delay = <0x108>;
				regulator-max-microvolt = <0x2ab980>;
				regulator-min-microvolt = <0x2ab980>;
				regulator-name = "vaud28";
			};

			ldo_vaux18 {
				compatible = "regulator-fixed";
				linux,phandle = <0x75>;
				phandle = <0x75>;
				regulator-enable-ramp-delay = <0x108>;
				regulator-max-microvolt = <0x1b7740>;
				regulator-min-microvolt = <0x1b7740>;
				regulator-name = "vaux18";
			};

			ldo_vcama {
				linux,phandle = <0x6f>;
				phandle = <0x6f>;
				regulator-enable-ramp-delay = <0x108>;
				regulator-max-microvolt = <0x2ab980>;
				regulator-min-microvolt = <0x2625a0>;
				regulator-name = "vcama";
			};

			ldo_vcamd {
				linux,phandle = <0x70>;
				phandle = <0x70>;
				regulator-enable-ramp-delay = <0x108>;
				regulator-max-microvolt = <0x1b7740>;
				regulator-min-microvolt = <0xf4240>;
				regulator-name = "vcamd";
			};

			ldo_vcamio {
				compatible = "regulator-fixed";
				linux,phandle = <0x71>;
				phandle = <0x71>;
				regulator-enable-ramp-delay = <0x108>;
				regulator-max-microvolt = <0x1b7740>;
				regulator-min-microvolt = <0x1b7740>;
				regulator-name = "vcamio";
			};

			ldo_vcn18 {
				compatible = "regulator-fixed";
				linux,phandle = <0x6e>;
				phandle = <0x6e>;
				regulator-enable-ramp-delay = <0x108>;
				regulator-max-microvolt = <0x1b7740>;
				regulator-min-microvolt = <0x1b7740>;
				regulator-name = "vcn18";
			};

			ldo_vcn28 {
				compatible = "regulator-fixed";
				linux,phandle = <0x6d>;
				phandle = <0x6d>;
				regulator-enable-ramp-delay = <0x108>;
				regulator-max-microvolt = <0x2ab980>;
				regulator-min-microvolt = <0x2ab980>;
				regulator-name = "vcn28";
			};

			ldo_vcn33_bt {
				linux,phandle = <0x6b>;
				phandle = <0x6b>;
				regulator-enable-ramp-delay = <0x108>;
				regulator-max-microvolt = <0x3567e0>;
				regulator-min-microvolt = <0x325aa0>;
				regulator-name = "vcn33_bt";
			};

			ldo_vcn33_wifi {
				linux,phandle = <0x6c>;
				phandle = <0x6c>;
				regulator-enable-ramp-delay = <0x108>;
				regulator-max-microvolt = <0x3567e0>;
				regulator-min-microvolt = <0x325aa0>;
				regulator-name = "vcn33_wifi";
			};

			ldo_vdram {
				linux,phandle = <0x79>;
				phandle = <0x79>;
				regulator-enable-ramp-delay = <0xce4>;
				regulator-max-microvolt = <0x124f80>;
				regulator-min-microvolt = <0x10c8e0>;
				regulator-name = "vdram";
			};

			ldo_vefuse {
				linux,phandle = <0x6a>;
				phandle = <0x6a>;
				regulator-enable-ramp-delay = <0x108>;
				regulator-max-microvolt = <0x325aa0>;
				regulator-min-microvolt = <0x124f80>;
				regulator-name = "vefuse";
			};

			ldo_vemc {
				linux,phandle = <0x39>;
				phandle = <0x39>;
				regulator-enable-ramp-delay = <0x2c>;
				regulator-max-microvolt = <0x325aa0>;
				regulator-min-microvolt = <0x2c4020>;
				regulator-name = "vemc";
			};

			ldo_vfe28 {
				compatible = "regulator-fixed";
				linux,phandle = <0x66>;
				phandle = <0x66>;
				regulator-enable-ramp-delay = <0x108>;
				regulator-max-microvolt = <0x2ab980>;
				regulator-min-microvolt = <0x2ab980>;
				regulator-name = "vfe28";
			};

			ldo_vibr {
				linux,phandle = <0x7d>;
				phandle = <0x7d>;
				regulator-enable-ramp-delay = <0x2c>;
				regulator-max-microvolt = <0x325aa0>;
				regulator-min-microvolt = <0x124f80>;
				regulator-name = "vibr";
			};

			ldo_vio18 {
				compatible = "regulator-fixed";
				linux,phandle = <0x78>;
				phandle = <0x78>;
				regulator-enable-ramp-delay = <0x108>;
				regulator-max-microvolt = <0x1b7740>;
				regulator-min-microvolt = <0x1b7740>;
				regulator-name = "vio18";
			};

			ldo_vio28 {
				compatible = "regulator-fixed";
				linux,phandle = <0x77>;
				phandle = <0x77>;
				regulator-enable-ramp-delay = <0x108>;
				regulator-max-microvolt = <0x2ab980>;
				regulator-min-microvolt = <0x2ab980>;
				regulator-name = "vio28";
			};

			ldo_vldo28 {
				linux,phandle = <0x72>;
				phandle = <0x72>;
				regulator-enable-ramp-delay = <0x108>;
				regulator-max-microvolt = <0x2dc6c0>;
				regulator-min-microvolt = <0x2ab980>;
				regulator-name = "vldo28";
			};

			ldo_vmc {
				linux,phandle = <0x40>;
				phandle = <0x40>;
				regulator-enable-ramp-delay = <0x2c>;
				regulator-max-microvolt = <0x325aa0>;
				regulator-min-microvolt = <0x1b7740>;
				regulator-name = "vmc";
			};

			ldo_vmch {
				linux,phandle = <0x7a>;
				phandle = <0x7a>;
				regulator-enable-ramp-delay = <0x2c>;
				regulator-max-microvolt = <0x325aa0>;
				regulator-min-microvolt = <0x2c4020>;
				regulator-name = "vmch";
			};

			ldo_vrf12 {
				compatible = "regulator-fixed";
				linux,phandle = <0x69>;
				phandle = <0x69>;
				regulator-enable-ramp-delay = <0x6e>;
				regulator-max-microvolt = <0x124f80>;
				regulator-min-microvolt = <0x124f80>;
				regulator-name = "vrf12";
			};

			ldo_vrf18 {
				compatible = "regulator-fixed";
				linux,phandle = <0x68>;
				phandle = <0x68>;
				regulator-enable-ramp-delay = <0x6e>;
				regulator-max-microvolt = <0x1b7740>;
				regulator-min-microvolt = <0x1b7740>;
				regulator-name = "vrf18";
			};

			ldo_vsim1 {
				linux,phandle = <0x7b>;
				phandle = <0x7b>;
				regulator-enable-ramp-delay = <0x108>;
				regulator-max-microvolt = <0x2f4d60>;
				regulator-min-microvolt = <0x19f0a0>;
				regulator-name = "vsim1";
			};

			ldo_vsim2 {
				linux,phandle = <0x7c>;
				phandle = <0x7c>;
				regulator-enable-ramp-delay = <0x108>;
				regulator-max-microvolt = <0x2f4d60>;
				regulator-min-microvolt = <0x19f0a0>;
				regulator-name = "vsim2";
			};

			ldo_vsram_others {
				linux,phandle = <0x73>;
				phandle = <0x73>;
				regulator-enable-ramp-delay = <0x6e>;
				regulator-max-microvolt = <0x1406f4>;
				regulator-min-microvolt = <0x7ea5e>;
				regulator-name = "vsram_others";
				regulator-ramp-delay = <0x186a>;
			};

			ldo_vsram_proc {
				linux,phandle = <0x74>;
				phandle = <0x74>;
				regulator-enable-ramp-delay = <0x6e>;
				regulator-max-microvolt = <0x1406f4>;
				regulator-min-microvolt = <0x7ea5e>;
				regulator-name = "vsram_proc";
				regulator-ramp-delay = <0x186a>;
			};

			ldo_vusb33 {
				linux,phandle = <0x7e>;
				phandle = <0x7e>;
				regulator-enable-ramp-delay = <0x108>;
				regulator-max-microvolt = <0x2f4d60>;
				regulator-min-microvolt = <0x2dc6c0>;
				regulator-name = "vusb33";
			};

			ldo_vxo22 {
				linux,phandle = <0x67>;
				phandle = <0x67>;
				regulator-enable-ramp-delay = <0x6e>;
				regulator-max-microvolt = <0x249f00>;
				regulator-min-microvolt = <0x2191c0>;
				regulator-name = "vxo22";
			};
		};

		mt635x-auxadc {
			#io-channel-cells = <0x01>;
			compatible = "mediatek,mt635x-auxadc";
			linux,phandle = <0x60>;
			phandle = <0x60>;

			accdet {
				channel = <0x09>;
			};

			bat_temp {
				channel = <0x03>;
				resistance-ratio = <0x01 0x01>;
			};

			batadc {
				avg-num = <0x80>;
				channel = <0x00>;
				resistance-ratio = <0x03 0x01>;
			};

			chip_temp {
				channel = <0x05>;
			};

			dcxo_temp {
				avg-num = <0x10>;
				channel = <0x0d>;
			};

			hpofs_cal {
				avg-num = <0x100>;
				channel = <0x0c>;
			};

			isense {
				avg-num = <0x80>;
				channel = <0x01>;
				resistance-ratio = <0x03 0x01>;
			};

			tsx_temp {
				avg-num = <0x80>;
				channel = <0x0b>;
			};

			vbif {
				channel = <0x0e>;
				resistance-ratio = <0x01 0x01>;
			};

			vcdt {
				channel = <0x02>;
			};

			vcore_temp {
				channel = <0x06>;
			};

			vproc_temp {
				channel = <0x07>;
			};
		};
	};

	mt6357_gauge {
		alias_name = "mt6357";
		compatible = "mediatek,mt6357_gauge";
		gauge_name = "gauge";
	};

	mt6370_pd_eint {
		linux,phandle = <0xb1>;
		phandle = <0xb1>;
	};

	mt6370_pmu_dts {
		#interrupt-cells = <0x01>;
		interrupt-controller;
		linux,phandle = <0xbe>;
		mt6370,intr_gpio = <0x3f 0x03 0x00>;
		mt6370,intr_gpio_num = <0x03>;
		phandle = <0xbe>;

		bled {
			compatible = "mediatek,mt6370_pmu_bled";
			interrupt-names = "bled_ocp";
			mt,bl_ocp_level = <0x02>;
			mt,bl_ovp_level = <0x03>;
			mt,bled_flash_ramp = <0x01>;
			mt,bled_name = "mt6370_pmu_bled";
			mt,bled_ramptime = <0x03>;
			mt,chan_en = <0x0f>;
			mt,map_linear;
			mt,max_bled_brightness = <0x200>;
			mt,pwm_avg_cycle = <0x00>;
			mt,pwm_deglitch = <0x01>;
			mt,pwm_fsample = <0x02>;
			mt,pwm_hys = <0x00>;
			mt,pwm_hys_en = <0x01>;
			mt,use_pwm;
		};

		charger {
			aicr = <0x7a120>;
			charger_name = "primary_chg";
			compatible = "mediatek,mt6370_pmu_charger";
			cv = <0x426030>;
			dc_wdt = "\0=\t";
			enable_te;
			enable_wdt;
			ichg = <0x1e8480>;
			ieoc = <0x249f0>;
			interrupt-names = "chg_mivr\0chg_aiclmeasi\0attachi\0ovpctrl_uvp_d_evt\0chg_wdtmri\0chg_vbusov\0chg_tmri\0chg_treg";
			ircmp_resistor = <0x61a8>;
			ircmp_vclamp = <0x7d00>;
			load_switch_name = "primary_load_switch";
			mivr = <0x432380>;
			safety_timer = <0x0c>;
		};

		core {
			compatible = "mediatek,mt6370_pmu_core";
			i2cstmr_rst_tmr = <0x00>;
			int_deg = <0x00>;
			int_wdt = <0x00>;
			interrupt-names = "otp\0vdda_ovp\0vdda_uv";
			mrstb_en;
			mrstb_tmr = <0x03>;
		};

		dsv {
			compatible = "mediatek,mt6370_pmu_dsv";
			db_delay = <0x03>;
			db_ext_en = <0x00>;
			db_freq_pm = <0x00>;
			db_periodic_fix = <0x00>;
			db_periodic_mode = <0x00>;
			db_single_pin = <0x00>;
			db_startup = <0x00>;
			db_vbst = <0x1644>;
			db_vneg_20ms = <0x01>;
			db_vneg_disc = <0x00>;
			db_vneg_slew = <0x01>;
			db_vpos_20ms = <0x01>;
			db_vpos_disc = <0x01>;
			db_vpos_slew = <0x01>;
			interrupt-names = "dsv_vneg_ocp\0dsv_vpos_ocp\0dsv_bst_ocp\0dsv_vneg_scp\0dsv_vpos_scp";

			mt6370_dsvn {
				regulator-max-microvolt = <0x5b8d80>;
				regulator-min-microvolt = "\0=\t";
				regulator-name = "dsv_neg";
			};

			mt6370_dsvp {
				regulator-max-microvolt = <0x5b8d80>;
				regulator-min-microvolt = "\0=\t";
				regulator-name = "dsv_pos";
			};
		};

		ldo {
			compatible = "mediatek,mt6370_pmu_ldo";
			interrupt-names = "ldo_oc";
			ldo_oms = <0x01>;
			ldo_vrc_lt = <0x01>;

			mt6370_ldo {
				regulator-max-microvolt = "\0=\t";
				regulator-min-microvolt = <0x186a00>;
				regulator-name = "irtx_ldo";
			};
		};

		mt6370_pmu_fled1 {
			compatible = "mediatek,mt6370_pmu_fled1";
			fled_enable = <0x01>;
			interrupt-names = "fled_lvf\0fled2_short\0fled1_short";
			strobe_cur = <0x124f80>;
			strobe_timeout = <0x960>;
			torch_cur = <0x493e0>;
		};

		mt6370_pmu_fled2 {
			compatible = "mediatek,mt6370_pmu_fled2";
			fled_enable = <0x01>;
			strobe_cur = <0xf4240>;
			strobe_timeout = <0x4b0>;
			torch_cur = <0x30d40>;
		};

		rgbled {
			compatible = "mediatek,mt6370_pmu_rgbled";
			interrupt-names = "isink4_short\0isink3_short\0isink2_short\0isink1_short\0isink4_open\0isink3_open\0isink2_open\0isink1_open";
			mt,led_default_trigger = "cc_mode\0cc_mode\0cc_mode\0none";
			mt,led_name = "mt6370_pmu_led1\0mt6370_pmu_led2\0mt6370_pmu_led3\0mt6370_pmu_led4";
		};
	};

	mt6370_pmu_eint {
		linux,phandle = <0xb0>;
		phandle = <0xb0>;
	};

	mt_charger {
		compatible = "mediatek,mt-charger";
		linux,phandle = <0xab>;
		phandle = <0xab>;
	};

	mt_soc_anc_pcm {
		compatible = "mediatek,mt_soc_pcm_anc";
	};

	mt_soc_codec_dummy_name {
		compatible = "mediatek,mt_soc_codec_dummy";
	};

	mt_soc_codec_name {
		compatible = "mediatek,mt_soc_codec_63xx";
		use_hp_depop_flow = <0x00>;
		use_ul_260k = <0x00>;
	};

	mt_soc_dai_name {
		compatible = "mediatek,mt_soc_dai_stub";
	};

	mt_soc_deep_buffer_dl_pcm {
		compatible = "mediatek,mt_soc_pcm_deep_buffer_dl";
	};

	mt_soc_dl1_awb_pcm {
		compatible = "mediatek,mt_soc_pcm_dl1_awb";
	};

	mt_soc_dl1_pcm@11220000 {
		clock-names = "aud_afe_clk\0aud_dac_clk\0aud_dac_predis_clk\0aud_adc_clk\0aud_apll22m_clk\0aud_apll1_tuner_clk\0aud_tml_clk\0aud_infra_clk\0mtkaif_26m_clk\0top_mux_audio\0top_mux_audio_int\0top_sys_pll1_d4\0top_mux_aud_1\0top_apll1_ck\0top_mux_aud_eng1\0top_apll1_d8\0apmixed_apll1\0top_clk26m_clk";
		clocks = <0x42 0x00 0x42 0x04 0x42 0x05 0x42 0x03 0x42 0x01 0x42 0x02 0x42 0x06 0x26 0x2b 0x26 0x33 0x1e 0x6f 0x1e 0x70 0x1e 0x03 0x1e 0x71 0x1e 0x29 0x1e 0x72 0x1e 0x2c 0x43 0x08 0x1f>;
		compatible = "mediatek,mt_soc_pcm_dl1";
		interrupts = <0x00 0x99 0x08>;
		linux,phandle = <0xa2>;
		phandle = <0xa2>;
		reg = <0x00 0x11220000 0x00 0x1000>;
	};

	mt_soc_dl2_pcm {
		compatible = "mediatek,mt_soc_pcm_dl2";
	};

	mt_soc_dummy_pcm {
		compatible = "mediatek,mt_soc_pcm_dummy";
	};

	mt_soc_fm_i2s_awb_pcm {
		compatible = "mediatek,mt_soc_pcm_fm_i2s_awb";
	};

	mt_soc_fm_i2s_pcm {
		compatible = "mediatek,mt_soc_pcm_fm_i2s";
	};

	mt_soc_fm_mrgtx_pcm {
		compatible = "mediatek,mt_soc_pcm_fmtx";
	};

	mt_soc_hp_impedance_pcm {
		compatible = "mediatek,mt_soc_pcm_hp_impedance";
	};

	mt_soc_i2s0_awb_pcm {
		compatible = "mediatek,mt_soc_pcm_i2s0_awb";
	};

	mt_soc_i2s0_pcm {
		compatible = "mediatek,mt_soc_pcm_dl1_i2s0";
	};

	mt_soc_i2s0dl1_pcm {
		compatible = "mediatek,mt_soc_pcm_dl1_i2s0dl1";
	};

	mt_soc_mrgrx_awb_pcm {
		compatible = "mediatek,mt_soc_pcm_mrgrx_awb";
	};

	mt_soc_mrgrx_pcm {
		compatible = "mediatek,mt_soc_pcm_mrgrx";
	};

	mt_soc_pcm_dl1_scp_spk {
		compatible = "mediatek,mt_soc_pcm_dl1_scp_spk";
	};

	mt_soc_pcm_voice_scp {
		compatible = "mediatek,mt_soc_pcm_voice_scp";
	};

	mt_soc_pcm_voice_ultra {
		compatible = "mediatek,mt_soc_pcm_voice_ultra";
	};

	mt_soc_pcm_voice_usb {
		compatible = "mediatek,mt_soc_pcm_voice_usb";
	};

	mt_soc_pcm_voice_usb_echoref {
		compatible = "mediatek,mt_soc_pcm_voice_usb_echoref";
	};

	mt_soc_routing_dai_name {
		compatible = "mediatek,mt_soc_dai_routing";
	};

	mt_soc_routing_pcm {
		compatible = "mediatek,mt_soc_pcm_routing";
	};

	mt_soc_tdmrx_pcm {
		compatible = "mediatek,mt_soc_tdm_capture";
	};

	mt_soc_ul1_pcm {
		compatible = "mediatek,mt_soc_pcm_capture";
	};

	mt_soc_ul2_pcm {
		compatible = "mediatek,mt_soc_pcm_capture2";
	};

	mt_soc_uldlloopback_pcm {
		compatible = "mediatek,mt_soc_pcm_uldlloopback";
	};

	mt_soc_voice_md1 {
		compatible = "mediatek,mt_soc_pcm_voice_md1";
	};

	mt_soc_voice_md1_bt {
		compatible = "mediatek,mt_soc_pcm_voice_md1_bt";
	};

	mt_soc_voice_md2 {
		compatible = "mediatek,mt_soc_pcm_voice_md2";
	};

	mt_soc_voice_md2_bt {
		compatible = "mediatek,mt_soc_pcm_voice_md2_bt";
	};

	mt_soc_voip_bt_in {
		compatible = "mediatek,mt_soc_pcm_bt_dai";
	};

	mt_soc_voip_bt_out {
		compatible = "mediatek,mt_soc_pcm_dl1_bt";
	};

	mtk-btcvsd-snd@18050000 {
		compatible = "mediatek,mtk-btcvsd-snd";
		interrupts = <0x00 0x10a 0x08>;
		linux,phandle = <0x41>;
		mediatek,infracfg = <0x26>;
		mediatek,offset = <0xf00 0x800 0x140 0x144 0x148>;
		phandle = <0x41>;
		reg = <0x00 0x18050000 0x00 0x1000 0x00 0x18080000 0x00 0x10000>;
	};

	mtkfb@0 {
		compatible = "mediatek,mtkfb";
		linux,phandle = <0xa6>;
		phandle = <0xa6>;
	};

	nfc553 {
		compatible = "mediatek,nfc-gpios";
		gpio-eint = <0x61>;
		gpio-irq = <0x61>;
		gpio-ven = <0x62>;
		linux,phandle = <0xa4>;
		phandle = <0xa4>;
		pinctrl-0 = <0x45>;
		pinctrl-1 = <0x46>;
		pinctrl-2 = <0x47>;
		pinctrl-3 = <0x48>;
		pinctrl-4 = <0x49>;
		pinctrl-5 = <0x4a>;
		pinctrl-6 = <0x4b>;
		pinctrl-names = "nfcdefault\0ven_high\0ven_low\0dwn_high\0dwn_low\0eint_as_int\0clk_req";
		status = "okay";
	};

	nfi@11018000 {
		compatible = "mediatek,nfi";
		reg = <0x00 0x11018000 0x00 0x1000>;
	};

	nfiecc@11019000 {
		compatible = "mediatek,nfiecc";
		reg = <0x00 0x11019000 0x00 0x1000>;
	};

	odm {
		compatible = "simple-bus";
		linux,phandle = <0xb3>;
		phandle = <0xb3>;
	};

	oppo_fp_common {
		compatible = "oppo,fp_common";
		linux,phandle = <0x85>;
		phandle = <0x85>;
	};

	oppo_secure_common {
		compatible = "oppo,secure_common";
		linux,phandle = <0x86>;
		phandle = <0x86>;
	};

	otg_iddig {
		compatible = "mediatek,usb_iddig_bi_eint";
		linux,phandle = <0x7f>;
		phandle = <0x7f>;
		pinctrl-0 = <0x20>;
		pinctrl-1 = <0x21>;
		pinctrl-names = "iddig_high\0iddig_low";
	};

	pd_adapter {
		adapter_name = "pd_adapter";
		compatible = "mediatek,pd_adapter";
		linux,phandle = <0xae>;
		phandle = <0xae>;
	};

	pericfg@10003000 {
		#clock-cells = <0x01>;
		compatible = "mediatek,pericfg\0syscon";
		linux,phandle = <0x5a>;
		phandle = <0x5a>;
		reg = <0x00 0x10003000 0x00 0x1000>;
	};

	pinctrl@1000b000 {
		#gpio-cells = <0x02>;
		#interrupt-cells = <0x04>;
		compatible = "mediatek,mt6765-pinctrl";
		gpio-controller;
		interrupt-controller;
		interrupts = <0x00 0xab 0x04>;
		linux,phandle = <0x3f>;
		mediatek,pctl-regmap = <0x12 0x13 0x14 0x15 0x16 0x17 0x18 0x19>;
		phandle = <0x3f>;
		pins-are-numbered;
		reg = <0x00 0x1000b000 0x00 0x1000>;

		iddig_high {
			linux,phandle = <0x20>;
			phandle = <0x20>;

			pins_cmd_dat {
				bias-pull-up;
				pinmux = <0x2901>;
				slew-rate = <0x00>;
			};
		};

		iddig_low {
			linux,phandle = <0x21>;
			phandle = <0x21>;

			pins_cmd_dat {
				output-low;
				pinmux = <0x2900>;
				slew-rate = <0x01>;
			};
		};

		msdc0@default {
			linux,phandle = <0x35>;
			phandle = <0x35>;

			pins_clk {
				drive-strength = [03];
			};

			pins_cmd {
				drive-strength = [03];
			};

			pins_dat {
				drive-strength = [03];
			};

			pins_ds {
				drive-strength = [03];
			};

			pins_rst {
				drive-strength = [03];
			};
		};

		msdc0@hs200 {
			linux,phandle = <0x37>;
			phandle = <0x37>;

			pins_clk {
				drive-strength = [04];
			};

			pins_cmd {
				drive-strength = [03];
			};

			pins_dat {
				drive-strength = [04];
			};

			pins_ds {
				drive-strength = [04];
			};

			pins_rst {
				drive-strength = [03];
			};
		};

		msdc0@hs400 {
			linux,phandle = <0x36>;
			phandle = <0x36>;

			pins_clk {
				drive-strength = [04];
			};

			pins_cmd {
				drive-strength = [03];
			};

			pins_dat {
				drive-strength = [04];
			};

			pins_ds {
				drive-strength = [04];
			};

			pins_rst {
				drive-strength = [03];
			};
		};

		msdc0@register_default {
			cmd_edge = [00];
			linux,phandle = <0x38>;
			phandle = <0x38>;
			rdata_edge = [00];
			wdata_edge = [00];
		};

		msdc1@ddr50 {
			linux,phandle = <0x3d>;
			phandle = <0x3d>;

			pins_clk {
				drive-strength = [03];
			};

			pins_cmd {
				drive-strength = [03];
			};

			pins_dat {
				drive-strength = [03];
			};
		};

		msdc1@default {
			linux,phandle = <0x3a>;
			phandle = <0x3a>;

			pins_clk {
				drive-strength = [03];
			};

			pins_cmd {
				drive-strength = [03];
			};

			pins_dat {
				drive-strength = [03];
			};
		};

		msdc1@register_default {
			cmd_edge = [00];
			linux,phandle = <0x3e>;
			phandle = <0x3e>;
			rdata_edge = [00];
			wdata_edge = [00];
		};

		msdc1@sdr104 {
			linux,phandle = <0x3b>;
			phandle = <0x3b>;

			pins_clk {
				drive-strength = [03];
			};

			pins_cmd {
				drive-strength = [03];
			};

			pins_dat {
				drive-strength = [03];
			};
		};

		msdc1@sdr50 {
			linux,phandle = <0x3c>;
			phandle = <0x3c>;

			pins_clk {
				drive-strength = [03];
			};

			pins_cmd {
				drive-strength = [03];
			};

			pins_dat {
				drive-strength = [03];
			};
		};

		msdc3@default {
			linux,phandle = <0x5d>;
			phandle = <0x5d>;

			pins_clk {
				drive-strength = [04];
			};

			pins_cmd {
				drive-strength = [04];
			};

			pins_dat {
				drive-strength = [04];
			};
		};

		msdc3@register_default {
			cmd_edge = [01];
			linux,phandle = <0x5e>;
			phandle = <0x5e>;
			rdata_edge = [01];
			wdata_edge = [01];
		};

		nfc_clk_req {
			linux,phandle = <0x4b>;
			phandle = <0x4b>;

			pins_cmd_dat {
				bias-disable;
				pinmux = <0x5900>;
				slew-rate = <0x00>;
			};
		};

		nfc_default {
			linux,phandle = <0x45>;
			phandle = <0x45>;
		};

		nfc_dwn_high {
			linux,phandle = <0x48>;
			phandle = <0x48>;

			pins_cmd_dat {
				output-high;
				pinmux = <0xaa00>;
				slew-rate = <0x01>;
			};
		};

		nfc_dwn_low {
			linux,phandle = <0x49>;
			phandle = <0x49>;

			pins_cmd_dat {
				output-low;
				pinmux = <0xaa00>;
				slew-rate = <0x01>;
			};
		};

		nfc_eint_as_int {
			linux,phandle = <0x4a>;
			phandle = <0x4a>;

			pins_cmd_dat {
				bias-disable;
				pinmux = <0x6100>;
				slew-rate = <0x00>;
			};
		};

		nfc_ven_high {
			linux,phandle = <0x46>;
			phandle = <0x46>;

			pins_cmd_dat {
				output-high;
				pinmux = <0x6200>;
				slew-rate = <0x01>;
			};
		};

		nfc_ven_low {
			linux,phandle = <0x47>;
			phandle = <0x47>;

			pins_cmd_dat {
				output-low;
				pinmux = <0x6200>;
				slew-rate = <0x01>;
			};
		};

		sia81xx_gpio_L {
			linux,phandle = <0x56>;
			phandle = <0x56>;

			pins_cmd_dat {
				bias-disable;
				pinmux = <0x9f00>;
				slew-rate = <0x01>;
			};
		};
	};

	plat_sram_flag@0011db00 {
		compatible = "mediatek,plat_sram_flag";
		reg = <0x00 0x10e5f0 0x00 0x10>;
	};

	pmic_clock_buffer_ctrl {
		compatible = "mediatek,pmic_clock_buffer";
		linux,phandle = <0xb5>;
		mediatek,clkbuf-config = <0x02 0x01 0x01 0x02 0x00 0x00 0x00>;
		mediatek,clkbuf-driving-current = <0x01 0x01 0x01 0x01 0x01 0x01 0x01>;
		mediatek,clkbuf-quantity = <0x07>;
		phandle = <0xb5>;
	};

	pmu {
		compatible = "arm,armv8-pmuv3";
		interrupt-parent = <0x11>;
		interrupts = <0x01 0x07 0x08>;
	};

	psci {
		compatible = "arm,psci-1.0";
		method = "smc";
	};

	pseudo_m4u {
		compatible = "mediatek,mt-pseudo_m4u";
		iommus = <0x55 0x02>;
	};

	pseudo_m4u-larb0 {
		compatible = "mediatek,mt-pseudo_m4u-port";
		iommus = <0x55 0x00 0x55 0x01 0x55 0x02 0x55 0x03 0x55 0x04 0x55 0x05 0x55 0x06 0x55 0x07>;
		mediatek,larbid = <0x00>;
	};

	pseudo_m4u-larb1 {
		compatible = "mediatek,mt-pseudo_m4u-port";
		iommus = <0x55 0x20 0x55 0x21>;
		mediatek,larbid = <0x01>;
	};

	pseudo_m4u-larb2 {
		compatible = "mediatek,mt-pseudo_m4u-port";
		iommus = <0x55 0x40 0x55 0x41>;
		mediatek,larbid = <0x02>;
	};

	pseudo_m4u-larb3 {
		compatible = "mediatek,mt-pseudo_m4u-port";
		iommus = <0x55 0x60 0x55 0x61>;
		mediatek,larbid = <0x03>;
	};

	pwm@11006000 {
		clock-names = "PWM1-main\0PWM2-main\0PWM3-main\0PWM4-main\0PWM5-main\0PWM6-main\0PWM-HCLK-main\0PWM-main";
		clocks = <0x26 0x10 0x26 0x11 0x26 0x12 0x26 0x13 0x26 0x14 0x26 0x30 0x26 0x0f 0x26 0x15>;
		compatible = "mediatek,pwm";
		interrupts = <0x00 0x4d 0x08>;
		linux,phandle = <0x96>;
		phandle = <0x96>;
		reg = <0x00 0x11006000 0x00 0x10000>;
	};

	pwrap@1000d000 {
		compatible = "mediatek,pwrap";
		interrupts = <0x00 0xb3 0x04>;
		reg = <0x00 0x1000d000 0x00 0x1000>;
	};

	radio_md_cfg {
		compatible = "mediatek,radio_md_cfg";
		linux,phandle = <0xbc>;
		phandle = <0xbc>;
	};

	reserved-memory {
		#address-cells = <0x02>;
		#size-cells = <0x02>;
		linux,phandle = <0x58>;
		phandle = <0x58>;
		ranges;

		consys-reserve-memory {
			alignment = <0x00 0x1000000>;
			alloc-ranges = <0x00 0x40000000 0x00 0x80000000>;
			compatible = "mediatek,consys-reserve-memory";
			no-map;
			size = <0x00 0x400000>;
		};

		reserve-memory-scp_share {
			alignment = <0x00 0x1000000>;
			alloc-ranges = <0x00 0x40000000 0x00 0x50000000>;
			compatible = "mediatek,reserve-memory-scp_share";
			no-map;
			size = <0x00 0x300000>;
		};

		reserve-memory-sspm_share {
			alignment = <0x00 0x10000>;
			alloc-ranges = <0x00 0x40000000 0x00 0x60000000>;
			compatible = "mediatek,reserve-memory-sspm_share";
			no-map;
			size = <0x00 0x110000>;
			status = "okay";
		};

		wifi-reserve-memory {
			alignment = <0x00 0x1000000>;
			alloc-ranges = <0x00 0x40000000 0x00 0x80000000>;
			compatible = "mediatek,wifi-reserve-memory";
			no-map;
			size = <0x00 0x300000>;
		};

		zmc-default {
			alignment = <0x00 0x10000000>;
			alloc-ranges = <0x00 0xc0000000 0x01 0x80000000>;
			compatible = "mediatek,zone_movable_cma";
			size = <0x00 0xffc00000>;
		};
	};

	rt-pd-manager {
		compatible = "mediatek,rt-pd-manager";
	};

	rt9465_slave_chr {
		compatible = "richtek,rt9465";
		linux,phandle = <0xaf>;
		phandle = <0xaf>;
		status = "disabled";
	};

	scp@10500000 {
		compatible = "mediatek,scp";
		core_1 = "enable";
		interrupts = <0x00 0xc0 0x04>;
		reg = <0x00 0x10500000 0x00 0x40000 0x00 0x105c0000 0x00 0x3000 0x00 0x105c4000 0x00 0x1000 0x00 0x105d4000 0x00 0x6000>;
		scp_sramSize = <0x40000>;
		status = "okay";
	};

	scp_dvfs {
		clock-names = "clk_mux\0clk_pll_0\0clk_pll_1\0clk_pll_2\0clk_pll_3\0clk_pll_4\0clk_pll_5\0clk_pll_6";
		clocks = <0x1e 0x63 0x1f 0x1e 0x0e 0x1e 0x1a 0x1e 0x02 0x1e 0x17 0x1e 0x06 0x1e 0x19>;
		compatible = "mediatek,scp_dvfs";
	};

	scpsys@10001000 {
		#clock-cells = <0x01>;
		compatible = "mediatek,scpsys\0syscon";
		linux,phandle = <0x27>;
		phandle = <0x27>;
		reg = <0x00 0x10001000 0x00 0x1000 0x00 0x10006000 0x00 0x1000 0x00 0x14002000 0x00 0x1000 0x00 0x1020e000 0x00 0x1000 0x00 0x18004000 0x00 0x1000 0x00 0x18002000 0x00 0x1000>;
	};

	security_ao@1001a000 {
		compatible = "mediatek,security_ao";
		reg = <0x00 0x1001a000 0x00 0x1000>;
	};

	seninf1@1a040000 {
		compatible = "mediatek,seninf1";
		reg = <0x00 0x1a040000 0x00 0x1000>;
	};

	seninf2@1a041000 {
		compatible = "mediatek,seninf2";
		reg = <0x00 0x1a041000 0x00 0x1000>;
	};

	seninf3@1a042000 {
		compatible = "mediatek,seninf3";
		reg = <0x00 0x1a042000 0x00 0x1000>;
	};

	seninf4@1a043000 {
		compatible = "mediatek,seninf4";
		reg = <0x00 0x1a043000 0x00 0x1000>;
	};

	serial@11020000 {
		clock-names = "baud\0bus";
		clocks = <0x1f 0x26 0x16>;
		compatible = "mediatek,mt6758-uart\0mediatek,mt6577-uart";
		dma-names = "tx\0rx";
		dmas = <0x33 0x00 0x33 0x01>;
		interrupts = <0x00 0x5b 0x08>;
		linux,phandle = <0x8b>;
		phandle = <0x8b>;
		reg = <0x00 0x11002000 0x00 0x1000>;
	};

	serial@11030000 {
		clock-names = "baud\0bus";
		clocks = <0x1f 0x26 0x17>;
		compatible = "mediatek,mt6758-uart\0mediatek,mt6577-uart";
		interrupts = <0x00 0x5c 0x08>;
		linux,phandle = <0x8c>;
		phandle = <0x8c>;
		reg = <0x00 0x11003000 0x00 0x1000>;
	};

	sia81xx@L {
		channel_num = <0x00>;
		compatible = "si,sia81xx";
		dynamic_updata_vdd_port = <0x02>;
		en_dynamic_updata_vdd = <0x00>;
		en_x_filter = <0x01>;
		linux,phandle = <0x34>;
		owi_mode = <0x01>;
		phandle = <0x34>;
		pinctrl-0 = <0x56>;
		pinctrl-names = "sia81xx_gpio";
		si,sia81xx_disable_pin = <0x00>;
		si,sia81xx_owi = <0x3f 0x9f 0x00>;
		si,sia81xx_reset = <0x3f 0x9f 0x00>;
		si,sia81xx_type = "sia8101";
		timer_task_hdl = <0x00>;
	};

	sleep@10006000 {
		compatible = "mediatek,sleep\0syscon";
		interrupts = <0x00 0xb5 0x08>;
		linux,phandle = <0x44>;
		phandle = <0x44>;
		reg = <0x00 0x10006000 0x00 0x1000>;
		wakeup-source = <0x1a 0x00 0x04 0x1b 0x01 0x20 0x1c 0x03 0x2000000>;
	};

	sleep_reg_md@1000f000 {
		compatible = "mediatek,sleep_reg_md";
		reg = <0x00 0x1000f000 0x00 0x1000>;
	};

	smart_pa {
		linux,phandle = <0xb9>;
		phandle = <0xb9>;
	};

	smi_common@14002000 {
		clock-names = "mtcmos-mm\0smi-common-gals-comm0\0smi-common-gals-comm1\0smi-common\0mmdvfs_clk_mm_sel_ck\0mmdvfs_clk_mmpll_ck\0mmdvfs_clk_univpll1_d2_ck\0mmdvfs_clk_mmpll_d2_ck";
		clocks = <0x27 0x03 0x28 0x15 0x28 0x16 0x28 0x13 0x1e 0x62 0x1e 0x21 0x1e 0x17 0x1e 0x22>;
		compatible = "mediatek,smi_common";
		larbs = <0x22 0x23 0x24 0x25>;
		mmsys_config = <0x28>;
		nr_larbs = <0x04>;
		reg = <0x00 0x14002000 0x00 0x1000>;
	};

	smi_larb0@14003000 {
		cell-index = <0x00>;
		clock-names = "mtcmos-mm\0mm-larb0";
		clocks = <0x27 0x03 0x28 0x14>;
		compatible = "mediatek,smi_larb0\0mediatek,smi_larb";
		linux,phandle = <0x22>;
		phandle = <0x22>;
		reg = <0x00 0x14003000 0x00 0x1000>;
	};

	smi_larb1@17010000 {
		cell-index = <0x01>;
		clock-names = "mtcmos-vcodec\0venc-larb1";
		clocks = <0x27 0x0a 0x4e 0x01>;
		compatible = "mediatek,smi_larb1\0mediatek,smi_larb";
		linux,phandle = <0x23>;
		phandle = <0x23>;
		reg = <0x00 0x17010000 0x00 0x1000>;
	};

	smi_larb2@15021000 {
		cell-index = <0x02>;
		clock-names = "mtcmos-isp\0gals-img2mm\0img-larb2";
		clocks = <0x27 0x05 0x28 0x18 0x4c 0x00>;
		compatible = "mediatek,smi_larb2\0mediatek,smi_larb";
		linux,phandle = <0x24>;
		phandle = <0x24>;
		reg = <0x00 0x15021000 0x00 0x1000>;
	};

	smi_larb3@1a002000 {
		cell-index = <0x03>;
		clock-names = "mtcmos-cam\0gals-cam2mm\0cam-larb3";
		clocks = <0x27 0x09 0x28 0x19 0x4d 0x00>;
		compatible = "mediatek,smi_larb3\0mediatek,smi_larb";
		linux,phandle = <0x25>;
		phandle = <0x25>;
		reg = <0x00 0x1a002000 0x00 0x1000>;
	};

	spi@1100a000 {
		clock-names = "parent-clk\0sel-clk\0spi-clk";
		clocks = <0x1e 0x0b 0x1e 0x6b 0x26 0x1b>;
		compatible = "mediatek,mt6765-spi";
		interrupts = <0x00 0x76 0x08>;
		linux,phandle = <0x97>;
		mediatek,pad-select = <0x00>;
		phandle = <0x97>;
		reg = <0x00 0x1100a000 0x00 0x1000>;
	};

	spi@11010000 {
		clock-names = "parent-clk\0sel-clk\0spi-clk";
		clocks = <0x1e 0x0b 0x1e 0x6b 0x26 0x34>;
		compatible = "mediatek,mt6765-spi";
		interrupts = <0x00 0x7a 0x08>;
		linux,phandle = <0x98>;
		mediatek,pad-select = <0x00>;
		phandle = <0x98>;
		reg = <0x00 0x11010000 0x00 0x1000>;
	};

	spi@11012000 {
		clock-names = "parent-clk\0sel-clk\0spi-clk";
		clocks = <0x1e 0x0b 0x1e 0x6b 0x26 0x37>;
		compatible = "mediatek,mt6765-spi";
		interrupts = <0x00 0x80 0x08>;
		linux,phandle = <0x99>;
		mediatek,pad-select = <0x00>;
		phandle = <0x99>;
		reg = <0x00 0x11012000 0x00 0x1000>;
	};

	spi@11013000 {
		clock-names = "parent-clk\0sel-clk\0spi-clk";
		clocks = <0x1e 0x0b 0x1e 0x6b 0x26 0x38>;
		compatible = "mediatek,mt6765-spi";
		interrupts = <0x00 0x81 0x08>;
		linux,phandle = <0x9a>;
		mediatek,pad-select = <0x00>;
		phandle = <0x9a>;
		reg = <0x00 0x11013000 0x00 0x1000>;
	};

	spi@11014000 {
		clock-names = "parent-clk\0sel-clk\0spi-clk";
		clocks = <0x1e 0x0b 0x1e 0x6b 0x26 0x41>;
		compatible = "mediatek,mt6765-spi";
		interrupts = <0x00 0x5f 0x08>;
		linux,phandle = <0x9b>;
		mediatek,pad-select = <0x00>;
		phandle = <0x9b>;
		reg = <0x00 0x11014000 0x00 0x1000>;
	};

	spi@11015000 {
		clock-names = "parent-clk\0sel-clk\0spi-clk";
		clocks = <0x1e 0x0b 0x1e 0x6b 0x26 0x42>;
		compatible = "mediatek,mt6765-spi";
		interrupts = <0x00 0x60 0x08>;
		linux,phandle = <0x9c>;
		mediatek,pad-select = <0x00>;
		phandle = <0x9c>;
		reg = <0x00 0x11015000 0x00 0x1000>;
	};

	sramrom@10214000 {
		compatible = "mediatek,sramrom";
		reg = <0x00 0x10214000 0x00 0x1000>;
	};

	sspm@10440000 {
		compatible = "mediatek,sspm";
		interrupt-names = "ipc\0mbox0\0mbox1\0mbox2\0mbox3\0mbox4";
		interrupts = <0x00 0xca 0x04 0x00 0xcd 0x04 0x00 0xce 0x04 0x00 0xcf 0x04 0x00 0xd0 0x04 0x00 0xd1 0x04>;
		reg = <0x00 0x10440000 0x00 0x10000 0x00 0x10450000 0x00 0x100 0x00 0x10451000 0x00 0x08 0x00 0x10460000 0x00 0x100 0x00 0x10461000 0x00 0x08 0x00 0x10470000 0x00 0x100 0x00 0x10471000 0x00 0x08 0x00 0x10480000 0x00 0x100 0x00 0x10481000 0x00 0x08 0x00 0x10490000 0x00 0x100 0x00 0x10491000 0x00 0x08>;
		reg-names = "cfgreg\0mbox0_base\0mbox0_ctrl\0mbox1_base\0mbox1_ctrl\0mbox2_base\0mbox2_ctrl\0mbox3_base\0mbox3_ctrl\0mbox4_base\0mbox4_ctrl";
	};

	sys_cirq@10204000 {
		compatible = "mediatek,sys_cirq";
		interrupts = <0x00 0x118 0x08>;
		mediatek,cirq_num = <0xd1>;
		mediatek,spi_start_offset = <0x48>;
		reg = <0x00 0x10204000 0x00 0x1000>;
	};

	sys_timer@10017000 {
		compatible = "mediatek,sys_timer";
		interrupts = <0x00 0xc2 0x04>;
		reg = <0x00 0x10017000 0x00 0x1000>;
		reg-names = "sys_timer_base";
	};

	syscfg_pctl_0@10005000 {
		compatible = "mediatek,mt6765-pctl-0-syscfg\0syscon";
		linux,phandle = <0x12>;
		phandle = <0x12>;
		reg = <0x00 0x10005000 0x00 0x1000>;
	};

	syscfg_pctl_1@0x10002000 {
		compatible = "mediatek,mt6765-pctl-1-syscfg\0syscon";
		linux,phandle = <0x13>;
		phandle = <0x13>;
		reg = <0x00 0x10002000 0x00 0x1000>;
	};

	syscfg_pctl_2@0x10002200 {
		compatible = "mediatek,mt6765-pctl-2-syscfg\0syscon";
		linux,phandle = <0x14>;
		phandle = <0x14>;
		reg = <0x00 0x10002200 0x00 0x1000>;
	};

	syscfg_pctl_3@0x10002400 {
		compatible = "mediatek,mt6765-pctl-3-syscfg\0syscon";
		linux,phandle = <0x15>;
		phandle = <0x15>;
		reg = <0x00 0x10002400 0x00 0x1000>;
	};

	syscfg_pctl_4@0x10002600 {
		compatible = "mediatek,mt6765-pctl-4-syscfg\0syscon";
		linux,phandle = <0x16>;
		phandle = <0x16>;
		reg = <0x00 0x10002600 0x00 0x1000>;
	};

	syscfg_pctl_5@0x10002800 {
		compatible = "mediatek,mt6765-pctl-5-syscfg\0syscon";
		linux,phandle = <0x17>;
		phandle = <0x17>;
		reg = <0x00 0x10002800 0x00 0x1000>;
	};

	syscfg_pctl_6@0x10002a00 {
		compatible = "mediatek,mt6765-pctl-6-syscfg\0syscon";
		linux,phandle = <0x18>;
		phandle = <0x18>;
		reg = <0x00 0x10002a00 0x00 0x1000>;
	};

	syscfg_pctl_7@0x10002c00 {
		compatible = "mediatek,mt6765-pctl-7-syscfg\0syscon";
		linux,phandle = <0x19>;
		phandle = <0x19>;
		reg = <0x00 0x10002c00 0x00 0x1000>;
	};

	therm_ctrl@1100b000 {
		clock-names = "therm-main";
		clocks = <0x26 0x0a>;
		compatible = "mediatek,therm_ctrl";
		interrupts = <0x00 0x4e 0x08>;
		reg = <0x00 0x1100b000 0x00 0x1000>;
	};

	timer {
		clock-frequency = <0xc65d40>;
		compatible = "arm,armv8-timer";
		interrupt-parent = <0x11>;
		interrupts = <0x01 0x0d 0x08 0x01 0x0e 0x08 0x01 0x0b 0x08 0x01 0x0a 0x08>;
	};

	tkcore {
		compatible = "trustkernel,tkcore";
		interrupts = <0x00 0xf8 0x01>;
	};

	topckgen@10000000 {
		#clock-cells = <0x01>;
		compatible = "mediatek,topckgen\0syscon";
		linux,phandle = <0x1e>;
		phandle = <0x1e>;
		reg = <0x00 0x10000000 0x00 0x1000>;
	};

	topckgen_ao@1001b000 {
		compatible = "mediatek,topckgen_ao";
		reg = <0x00 0x1001b000 0x00 0x1000>;
	};

	topmisc@10011000 {
		compatible = "mediatek,topmisc";
		reg = <0x00 0x10011000 0x00 0x1000>;
	};

	toprgu@10007000 {
		compatible = "mediatek,mt6765-toprgu";
		interrupts = <0x00 0x8b 0x00>;
		reg = <0x00 0x10007000 0x00 0x1000>;
	};

	touch {
		compatible = "mediatek,touch";
		linux,phandle = <0x81>;
		phandle = <0x81>;
	};

	trng@1020f000 {
		compatible = "mediatek,trng";
		interrupts = <0x00 0xa1 0x08>;
		reg = <0x00 0x1020f000 0x00 0x1000>;
	};

	type_c_port0 {
		linux,phandle = <0xbf>;
		mt-tcpc,name = "type_c_port0";
		mt-tcpc,role_def = <0x04>;
		mt-tcpc,rp_level = <0x00>;
		mt-tcpc,vconn_supply = <0x01>;
		mt6370pd,intr_gpio = <0x3f 0x18 0x00>;
		mt6370pd,intr_gpio_num = <0x18>;
		phandle = <0xbf>;
		tcpc-dual,supported_modes = <0x00>;

		dpm_caps {
			attemp_discover_cable;
			attemp_discover_id;
			attemp_enter_dp_mode;
			dr_check = <0x00>;
			local_dr_data;
			local_dr_power;
			local_no_suspend;
			local_usb_comm;
			local_vconn_supply;
			pr_check = <0x00>;
			pr_check_gp_source;
		};

		pd-data {
			bat,nr = <0x01>;
			pd,charging_policy = <0x21>;
			pd,country_nr = <0x00>;
			pd,id-vdo-data = <0xd10029cf 0x00 0x10000>;
			pd,id-vdo-size = <0x03>;
			pd,mfrs = "RichtekTCPC";
			pd,pid = <0x5081>;
			pd,sink-pdo-data = <0x190c8 0xc0761e3c>;
			pd,sink-pdo-size = <0x02>;
			pd,source-cap-ext = <0x171129cf 0x00 0x102 0x00 0x00 0x2000000>;
			pd,source-pdo-data = <0x19032>;
			pd,source-pdo-size = <0x01>;
			pd,vid = <0x29cf>;

			bat-info0 {
				bat,design_cap = <0xbb8>;
				bat,mfrs = "bat1";
				bat,pid = <0x1711>;
				bat,vid = <0x29cf>;
			};
		};
	};

	usb0@11200000 {
		clock-names = "usb0\0usb0_clk_top_sel\0usb0_clk_univpll3_d4";
		clocks = <0x26 0x08 0x1e 0x76 0x1e 0x20>;
		compatible = "mediatek,mt6765-usb20";
		interrupts = <0x00 0x49 0x08>;
		mode = <0x02>;
		multipoint = <0x01>;
		num_eps = <0x10>;
		reg = <0x00 0x11200000 0x00 0x10000 0x00 0x11cc0000 0x00 0x10000>;
	};

	usb1p_sif@11210000 {
		compatible = "mediatek,usb1p_sif";
		reg = <0x00 0x11210000 0x00 0x10000>;
	};

	usb_sif@11210000 {
		compatible = "mediatek,usb_sif";
		reg = <0x00 0x11210000 0x00 0x10000>;
	};

	utos {
		compatible = "microtrust,utos";
		interrupts = <0x00 0xf9 0x01 0x00 0xfa 0x01>;
	};

	utos_tester {
		compatible = "microtrust,tester-v1";
	};

	vdec@17040000 {
		compatible = "mediatek,vdec";
		interrupts = <0x00 0xe9 0x08>;
		reg = <0x00 0x17040000 0x00 0x10000>;
	};

	venc@17020000 {
		compatible = "mediatek,venc";
		interrupts = <0x00 0xe6 0x08>;
		reg = <0x00 0x17020000 0x00 0x10000>;
	};

	venc_gcon@17000000 {
		#clock-cells = <0x01>;
		clock-names = "MT_SCP_SYS_DIS\0MT_SCP_SYS_VCODEC\0MT_CG_MM_SMI_COMM0\0MT_CG_MM_SMI_COMM1\0MT_CG_MM_SMI_COMMON\0MT_CG_VDEC\0MT_CG_VENC";
		clocks = <0x27 0x03 0x27 0x0a 0x28 0x15 0x28 0x16 0x28 0x13 0x4e 0x03 0x4e 0x01>;
		compatible = "mediatek,venc_gcon\0syscon";
		linux,phandle = <0x4e>;
		phandle = <0x4e>;
		pwr-regmap = <0x44>;
		reg = <0x00 0x17000000 0x00 0x10000>;
	};

	venc_jpg@17030000 {
		clock-names = "MT_CG_VENC_JPGENC";
		clocks = <0x4e 0x02>;
		compatible = "mediatek,venc_jpg";
		interrupts = <0x00 0xe8 0x08>;
		reg = <0x00 0x17030000 0x00 0x10000>;
	};

	wifi@18000000 {
		compatible = "mediatek,wifi";
		interrupts = <0x00 0x10c 0x08>;
		reg = <0x00 0x18000000 0x00 0x100000>;
	};
};
